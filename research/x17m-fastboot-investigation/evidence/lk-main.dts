/dts-v1/;

/ {
	model = "MediaTek evb6890v1_64_cpe";
	compatible = "mediatek,evb6890v1_64_cpe", "mediatek,mt6890";
	interrupt-parent = <0x01>;
	#address-cells = <0x02>;
	#size-cells = <0x02>;

	chosen {
		bootargs = "console=tty0 console=ttyS0,921600n1 \t\tinit=/etc/preinit root=/dev/mtdblock31 \t\tloglevel=8 \t\tandroidboot.selinux=permissive androidboot.hardware=mt6890 \t\tinitcall_debug=1 page_owner=on";
	};

	psci {
		compatible = "arm,psci-0.2";
		method = "smc";
	};

	pwmleds {
		compatible = "mediatek,pwm-leds";

		backlight {
			label = "lcd-backlight";
			pwms = <0x02 0x00 0x99d9>;
			max-brightness = <0xff>;
			pwm-names = "lcd-backlight";
		};
	};

	cpus {
		#address-cells = <0x01>;
		#size-cells = <0x00>;

		cpu@0 {
			device_type = "cpu";
			compatible = "arm,cortex-a55";
			reg = <0x00>;
			enable-method = "psci";
			performance-domains = <0x03 0x00>;
			clock-frequency = <0x65633340>;
			cpu-idle-states = <0x04 0x05 0x06>;
			#cooling-cells = <0x02>;
			phandle = <0x07>;
		};

		cpu@001 {
			device_type = "cpu";
			compatible = "arm,cortex-a55";
			reg = <0x100>;
			enable-method = "psci";
			performance-domains = <0x03 0x00>;
			clock-frequency = <0x65633340>;
			cpu-idle-states = <0x04 0x05 0x06>;
			#cooling-cells = <0x02>;
			phandle = <0x08>;
		};

		cpu@002 {
			device_type = "cpu";
			compatible = "arm,cortex-a55";
			reg = <0x200>;
			enable-method = "psci";
			performance-domains = <0x03 0x00>;
			clock-frequency = <0x65633340>;
			cpu-idle-states = <0x04 0x05 0x06>;
			#cooling-cells = <0x02>;
			phandle = <0x09>;
		};

		cpu@003 {
			device_type = "cpu";
			compatible = "arm,cortex-a55";
			reg = <0x300>;
			enable-method = "psci";
			performance-domains = <0x03 0x00>;
			clock-frequency = <0x65633340>;
			cpu-idle-states = <0x04 0x05 0x06>;
			#cooling-cells = <0x02>;
			phandle = <0x0a>;
		};

		cpu-map {

			cluster0 {

				core0 {
					cpu = <0x07>;
				};

				core1 {
					cpu = <0x08>;
				};

				core2 {
					cpu = <0x09>;
				};

				core3 {
					cpu = <0x0a>;
				};
			};
		};

		idle-states {
			entry-method = "arm,psci";

			cpuoff_l {
				compatible = "arm,idle-state";
				arm,psci-suspend-param = <0x10001>;
				local-timer-stop;
				entry-latency-us = <0x32>;
				exit-latency-us = <0x64>;
				min-residency-us = <0x640>;
				phandle = <0x04>;
			};

			clusteroff_l {
				compatible = "arm,idle-state";
				arm,psci-suspend-param = <0x1010001>;
				local-timer-stop;
				entry-latency-us = <0x64>;
				exit-latency-us = <0xfa>;
				min-residency-us = <0x834>;
				phandle = <0x05>;
			};

			mcusysoff {
				compatible = "arm,idle-state";
				arm,psci-suspend-param = <0x1010002>;
				local-timer-stop;
				entry-latency-us = <0x12c>;
				exit-latency-us = <0x4b0>;
				min-residency-us = <0xa28>;
				phandle = <0x06>;
			};
		};
	};

	pmu {
		compatible = "arm,armv8-pmuv3";
		interrupt-parent = <0x01>;
		interrupts = <0x01 0x07 0x04>;
	};

	dsu-pmu-0 {
		compatible = "arm,dsu-pmu";
		interrupts = <0x00 0x12 0x04>;
		cpus = <0x07 0x08 0x09 0x0a>;
	};

	performance-controller@0011bc00 {
		compatible = "mediatek,cpufreq-hw";
		reg = <0x00 0x11bc10 0x00 0x120>;
		#performance-domain-cells = <0x01>;
		phandle = <0x03>;
	};

	dvfsp@0011bc00 {
		compatible = "mediatek,mcupm-dvfsp";
		reg = <0x00 0x11bc00 0x00 0x1400>;
		nvmem = <0x0b>;
		nvmem-names = "mtk_efuse";
		nvmem-cells = <0x0c>;
		nvmem-cell-names = "efuse_segment_cell";
	};

	leakage {
		compatible = "mediatek,mtk-static-power";
		nvmem = <0x0b>;
		nvmem-names = "mtk_efuse";
		nvmem-cells = <0x0c>;
		nvmem-cell-names = "efuse_segment_cell";
		n-domain = <0x07>;
		domain = "LL", "CCI", "VCORE", "MODEM_NR", "VSRAM_CPULL", "VSRAM_MODEM", "VCORE_OFF";
		LL = <0x224 0xff 0x2ee 0x1e 0x01 0x00>;
		CCI = <0x220 0xff000000 0x2ee 0x1e 0x01 0x00>;
		VCORE = <0x21c 0xff0000 0x2ee 0x1e 0x01 0x00>;
		MODEM_NR = <0x21c 0xff00 0x339 0x1e 0x01 0x00>;
		VSRAM_CPULL = <0x228 0xff0000 0x2ee 0x1e 0x01 0x00>;
		VSRAM_MODEM = <0x22c 0xff 0x339 0x1e 0x01 0x00>;
		VCORE_OFF = <0x224 0xff0000 0x226 0x1e 0x01 0x00>;
	};

	lastbus {
		compatible = "mediatek,lastbus";
		enabled = <0x01>;
		sw_version = <0x01>;
		timeout_ms = <0xc8>;
		timeout_type = <0x00>;

		monitors {

			monitor1 {
				monitor_name = "debug_ctrl_ao_INFRA_AO";
				base = <0x10023000>;
				num_ports = <0x1b>;
				bus_freq_mhz = <0x4e>;
			};

			monitor2 {
				monitor_name = "debug_ctrl_ao_PERI_AO";
				base = <0x1002b000>;
				num_ports = <0x1f>;
				bus_freq_mhz = <0x4e>;
			};

			monitor3 {
				monitor_name = "debug_ctrl_ao_PERI_AO2";
				base = <0x1002e000>;
				num_ports = <0x15>;
				bus_freq_mhz = <0x4e>;
			};

			monitor4 {
				monitor_name = "debug_ctrl_ao_PERI_PAR_AO";
				base = <0x10040000>;
				num_ports = <0x14>;
				bus_freq_mhz = <0x4e>;
			};

			monitor5 {
				monitor_name = "debug_ctrl_ao_FMEM_AO";
				base = <0x10042000>;
				num_ports = <0x15>;
				bus_freq_mhz = <0x4e>;
			};
		};
	};

	memory {
		device_type = "memory";
		reg = <0x00 0x40000000 0x00 0x3e605000>;
	};

	wed@15010000 {
		compatible = "mediatek,wed";
		wed_num = <0x02>;
		pci_slot_map = <0x00 0x01>;
		reg = <0x00 0x15010000 0x00 0x1000 0x00 0x15011000 0x00 0x1000>;
		interrupt-parent = <0x01>;
		interrupts = <0x00 0x196 0x04 0x00 0x197 0x04>;
	};

	wed2@15011000 {
		compatible = "mediatek,wed2";
		wed_num = <0x02>;
		reg = <0x00 0x15010000 0x00 0x1000 0x00 0x15011000 0x00 0x1000>;
		interrupt-parent = <0x01>;
		interrupts = <0x00 0x196 0x04 0x00 0x197 0x04>;
	};

	wdma@15102800 {
		compatible = "mediatek,wed-wdma";
		reg = <0x00 0x15102800 0x00 0x400 0x00 0x15102c00 0x00 0x400>;
		interrupt-parent = <0x01>;
		interrupts = <0x00 0xd8 0x04 0x00 0xd9 0x04 0x00 0xda 0x04 0x00 0xdb 0x04 0x00 0xdc 0x04 0x00 0xdd 0x04>;
	};

	ap2woccif@151A9000 {
		compatible = "mediatek,ap2woccif";
		reg = <0x00 0x151a9000 0x00 0x1000 0x00 0x151ab000 0x00 0x1000>;
		interrupt-parent = <0x01>;
		interrupts = <0x00 0x19e 0x04 0x00 0x19f 0x04>;
	};

	wocpu@15180000 {
		compatible = "mediatek,wocpu_sysram";
		reg = <0x00 0x15180000 0x00 0x8000>;
		shared = <0x01>;
	};

	wocpu_dlm@1518E000 {
		compatible = "mediatek,wocpu_dlm";
		reg = <0x00 0x1518e000 0x00 0x2000 0x00 0x15192000 0x00 0x2000>;
		resets = <0x0d 0x00>;
		reset-names = "wocpu_rst";
	};

	wocpu_boot@15194000 {
		compatible = "mediatek,wocpu_boot";
		reg = <0x00 0x15194000 0x00 0x1000>;
	};

	pcie_mirror@10201000 {
		compatible = "mediatek,pcie-mirror";
		reg = <0x00 0x10201000 0x00 0x1000>;
	};

	reserved-memory {
		#address-cells = <0x02>;
		#size-cells = <0x02>;
		ranges;

		reserve-memory-medmcu_share {
			compatible = "mediatek,reserve-memory-medmcu_share";
			no-map;
			size = <0x00 0x328700>;
			alignment = <0x00 0x10000>;
			alloc-ranges = <0x00 0x60000000 0x00 0x10000000>;
		};

		gps-reserve-memory {
			compatible = "mediatek,gps-reserve-memory";
			no-map;
			size = <0x00 0x60000>;
			alignment = <0x00 0x10000>;
			alloc-ranges = <0x00 0x40000000 0x00 0x80000000>;
			phandle = <0x80>;
		};

		reserve-memory-mcupm_share {
			compatible = "mediatek,reserve-memory-mcupm_share";
			no-map;
			status = "okay";
			size = <0x00 0x210000>;
			alignment = <0x00 0x10000>;
			alloc-ranges = <0x00 0x40000000 0x00 0x60000000>;
		};

		reserve-memory-sspm_share {
			compatible = "mediatek,reserve-memory-sspm_share";
			no-map;
			status = "okay";
			size = <0x00 0x210000>;
			alignment = <0x00 0x10000>;
			alloc-ranges = <0x00 0x40000000 0x00 0x60000000>;
		};

		wocpu0_emi@50000000 {
			compatible = "mediatek,wocpu0_emi";
			no-map;
			reg = <0x00 0x50000000 0x00 0x80000>;
			shared = <0x00>;
		};

		wocpu1_emi@50040000 {
			compatible = "mediatek,wocpu1_emi";
			no-map;
			reg = <0x00 0x50080000 0x00 0x80000>;
			shared = <0x00>;
		};

		wocpu_data@50100000 {
			compatible = "mediatek,wocpu_data";
			no-map;
			reg = <0x00 0x50100000 0x00 0x180000>;
			shared = <0x01>;
		};

		wocpu0_msg@50280000 {
			compatible = "mediatek,wocpu0_msg";
			no-map;
			reg = <0x00 0x50280000 0x00 0x180000>;
		};

		wocpu1_msg@50400000 {
			compatible = "mediatek,wocpu1_msg";
			no-map;
			reg = <0x00 0x50400000 0x00 0x180000>;
		};
	};

	cache_parity {
		compatible = "mediatek,mt6890-cache-parity";
		arm_dsu_ecc_hwirq = <0x20>;
		interrupts = <0x00 0x00 0x04 0x00 0x01 0x04 0x00 0x02 0x04 0x00 0x03 0x04 0x00 0x04 0x04>;
	};

	interrupt-controller {
		compatible = "arm,gic-v3";
		#interrupt-cells = <0x03>;
		#address-cells = <0x02>;
		#size-cells = <0x02>;
		#redistributor-regions = <0x01>;
		interrupt-parent = <0x01>;
		interrupt-controller;
		reg = <0x00 0xc000000 0x00 0x40000 0x00 0xc040000 0x00 0x200000>;
		interrupts = <0x01 0x09 0x04>;
		phandle = <0x01>;
	};

	clkao {
		compatible = "simple-bus";
		status = "okay";

		bring-up {
			compatible = "mediatek,clk-bring-up";
			clocks = <0x0e 0x6c 0x0e 0x34 0x0e 0x65 0x0e 0x66 0x0e 0x67 0x0e 0x75 0x0e 0x61 0x0e 0x2d 0x0e 0x5c>;
		};
	};

	clocks {

		clk_null {
			compatible = "fixed-clock";
			#clock-cells = <0x00>;
			clock-frequency = <0x00>;
		};

		clk10m {
			compatible = "fixed-clock";
			#clock-cells = <0x00>;
			clock-frequency = <0x989680>;
		};

		clk26m {
			compatible = "fixed-clock";
			#clock-cells = <0x00>;
			clock-frequency = <0x18cba80>;
			phandle = <0x39>;
		};

		clk12m {
			compatible = "fixed-clock";
			#clock-cells = <0x00>;
			clock-frequency = <0xb71b00>;
		};

		clk32k {
			compatible = "fixed-clock";
			#clock-cells = <0x00>;
			clock-frequency = <0x7d00>;
			phandle = <0x7d>;
		};

		clk13m {
			compatible = "fixed-clock";
			#clock-cells = <0x00>;
			clock-frequency = <0xc65d40>;
			phandle = <0x45>;
		};

		ulposc {
			compatible = "fixed-clock";
			#clock-cells = <0x00>;
			clock-frequency = <0xf7f4900>;
		};
	};

	syscon@10000000 {
		compatible = "mediatek,mt6890-topckgen", "syscon";
		reg = <0x00 0x10000000 0x00 0x1000>;
		#clock-cells = <0x01>;
		phandle = <0x0f>;
	};

	syscon@1000c000 {
		compatible = "mediatek,mt6890-apmixedsys", "syscon";
		reg = <0x00 0x1000c000 0x00 0xe00>;
		#clock-cells = <0x01>;
	};

	syscon@0d0a0000 {
		compatible = "mediatek,mt6890-dbgsys_dem", "syscon";
		reg = <0x00 0xd0a0000 0x00 0x1000>;
		#clock-cells = <0x01>;
	};

	syscon@10001000 {
		compatible = "mediatek,mt6890-infracfg_ao", "syscon";
		reg = <0x00 0x10001000 0x00 0x1000>;
		#clock-cells = <0x01>;
		phandle = <0x0e>;
	};

	syscon@10003000 {
		compatible = "mediatek,mt6890-pericfg", "syscon";
		reg = <0x00 0x10003000 0x00 0x1000>;
		#clock-cells = <0x01>;
	};

	power-controller@10006000 {
		compatible = "mediatek,mt6890-scpsys", "syscon";
		reg = <0x00 0x10006000 0x00 0x1000>;
		#power-domain-cells = <0x01>;
		infracfg = <0x0e>;
		clocks = <0x0f 0xa7 0x0f 0xa9 0x0f 0xcf 0x0f 0xd0 0x0f 0xd1 0x0f 0xd2 0x0f 0xce 0x0e 0x35 0x10 0x11>;
		clock-names = "disp", "mfg", "eth1", "eth2", "eth3", "eth4", "eip97", "audio", "disp-0";
		phandle = <0x4b>;
	};

	syscon@10228000 {
		compatible = "mediatek,mt6890-gce", "syscon";
		reg = <0x00 0x10228000 0x00 0x1000>;
		#clock-cells = <0x01>;
	};

	syscon@11210000 {
		compatible = "mediatek,mt6890-audsys", "syscon";
		reg = <0x00 0x11210000 0x00 0x1000>;
		#clock-cells = <0x01>;
		phandle = <0x8b>;
	};

	syscon@11c46000 {
		compatible = "mediatek,mt6890-imp_iic_wrap_e", "syscon";
		reg = <0x00 0x11c46000 0x00 0x1000>;
		#clock-cells = <0x01>;
		phandle = <0x52>;
	};

	syscon@13fbf000 {
		compatible = "mediatek,mt6890-mfgsys", "syscon";
		reg = <0x00 0x13fbf000 0x00 0x1000>;
		#clock-cells = <0x01>;
		phandle = <0x66>;
	};

	syson@14000000 {
		compatible = "mediatek,mt6890-mmsys_config", "syscon";
		reg = <0x00 0x14000000 0x00 0x1000>;
		#clock-cells = <0x01>;
		phandle = <0x10>;
	};

	mtk_lpm {
		compatible = "mediatek,mtk-lpm";
		#address-cells = <0x02>;
		#size-cells = <0x02>;
		ranges;
		suspend-method = "enable";
		logger-enable-states = "mcusysoff", "system_mem", "system_pll", "system_bus";
		mcusys-cnt-chk = <0x01>;
		irq-remain = <0x11 0x12>;
		resource-ctrl = <0x13 0x14 0x15 0x16 0x17>;
		constraints = <0x18 0x19 0x1a 0x1b>;
		spm-cond = <0x1c 0x1d>;
		cg-shift = <0x00>;
		pll-shift = <0x10>;
		power-gs = <0x1e>;

		cpupm-sysram@0011b000 {
			compatible = "mediatek,cpupm-sysram";
			reg = <0x00 0x11b000 0x00 0x500>;
		};

		mcusys-ctrl@0c53a000 {
			compatible = "mediatek,mcusys-ctrl";
			reg = <0x00 0xc53a000 0x00 0x1000>;
		};

		lpm_sysram@0011b500 {
			compatible = "mediatek,lpm-sysram";
			reg = <0x00 0x11b500 0x00 0x300>;
		};

		irq-remain-list {

			edge_keypad {
				target = <0x1f>;
				value = <0x01 0x00 0x00 0x04>;
				phandle = <0x11>;
			};

			edge_mdwdt {
				target = <0x20>;
				value = <0x01 0x00 0x00 0x2000000>;
				phandle = <0x12>;
			};
		};

		resource-ctrl-list {

			bus26m {
				id = <0x00>;
				value = <0x00>;
				phandle = <0x13>;
			};

			infra {
				id = <0x01>;
				value = <0x00>;
				phandle = <0x14>;
			};

			syspll {
				id = <0x02>;
				value = <0x00>;
				phandle = <0x15>;
			};

			dram_s0 {
				id = <0x03>;
				value = <0x00>;
				phandle = <0x16>;
			};

			dram_s1 {
				id = <0x04>;
				value = <0x00>;
				phandle = <0x17>;
			};
		};

		constraint-list {

			rc_bus26m {
				rc-name = "bus26m";
				id = <0x00>;
				value = <0x01>;
				cond-info = <0x01>;
				phandle = <0x18>;
			};

			rc_syspll {
				rc-name = "syspll";
				id = <0x01>;
				value = <0x01>;
				cond-info = <0x01>;
				phandle = <0x19>;
			};

			rc_dram {
				rc-name = "dram";
				id = <0x02>;
				value = <0x01>;
				cond-info = <0x01>;
				phandle = <0x1a>;
			};

			rc_cpu_buck_ldo {
				rc-name = "cpu-buck-ldo";
				id = <0x03>;
				value = <0x01>;
				cond-info = <0x00>;
				phandle = <0x1b>;
			};
		};

		spm-cond-list {

			spm_cond_cg {
				cg-name = "MTCMOS_0", "INFRA_0", "INFRA_1", "INFRA_2", "INFRA_3", "INFRA_4", "INFRA_5", "MMSYS_0", "MMSYS_1", "MMSYS_2";
				phandle = <0x1c>;
			};

			spm_cond_pll {
				pll-name = "UNIVPLL", "MFGPLL", "MSDCPLL", "MMPLL", "NET1PLL", "NET2PLL", "WEDMCUPLL", "MEDMCUPLL", "SGMIIPLL";
				phandle = <0x1d>;
			};
		};

		power-gs-list {

			gs_6330 {
				target = <0x21>;
				value = "mediatek,mt6330-regulator";
				phandle = <0x1e>;
			};
		};
	};

	thermal-ntc1 {
		compatible = "mediatek,mt6880-board-ntc";
		#thermal-sensor-cells = <0x00>;
		reg = <0x00 0x1001c0d4 0x00 0x04>;
		pmic_auxadc = <0x22>;
		temperature-lookup-table = <0xffff63c0 0x43183f 0xffff67a8 0x3e73ca 0xffff6b90 0x3a2985 0xffff6f78 0x363205 0xffff7360 0x328684 0xffff7748 0x2f20d7 0xffff7b30 0x2bfb5c 0xffff7f18 0x2910ee 0xffff8300 0x265cd9 0xffff86e8 0x23dad2 0xffff8ad0 0x2186e9 0xffff8eb8 0x1f5d86 0xffff92a0 0x1d5b5c 0xffff9688 0x1b7d65 0xffff9a70 0x19c0dd 0xffff9e58 0x182339 0xffffa240 0x16a15c 0xffffa628 0x153a09 0xffffaa10 0x13eb45 0xffffadf8 0x12b33b 0xffffb1e0 0x11903d 0xffffb5c8 0x1080bf 0xffffb9b0 0xf8355 0xffffbd98 0xe96b0 0xffffc180 0xdb999 0xffffc568 0xceaf3 0xffffc950 0xc29b7 0xffffcd38 0xb74f2 0xffffd120 0xacbc4 0xffffd508 0xa2d5c 0xffffd8f0 0x998fc 0xffffdcd8 0x90dbe 0xffffe0c0 0x88b3b 0xffffe4a8 0x810da 0xffffe890 0x79e0c 0xffffec78 0x73250 0xfffff060 0x6cd4c 0xfffff448 0x66e68 0xfffff830 0x6153c 0xfffffc18 0x5c169 0x00 0x57294 0x3e8 0x52856 0x7d0 0x4e27a 0xbb8 0x4a0b7 0xfa0 0x462ca 0x1388 0x42874 0x1770 0x3f17a 0x1b58 0x3bda8 0x1f40 0x38cc9 0x2328 0x35eaf 0x2710 0x3332e 0x2af8 0x30a1c 0x2ee0 0x2e354 0x32c8 0x2beb2 0x36b0 0x29c13 0x3a98 0x27b5b 0x3e80 0x25c66 0x4268 0x23f20 0x4650 0x2236e 0x4a38 0x20938 0x4e20 0x1f068 0x5208 0x1d8ea 0x55f0 0x1c2a8 0x59d8 0x1ad92 0x5dc0 0x19994 0x61a8 0x186a0 0x6590 0x174a6 0x6978 0x16398 0x6d60 0x15369 0x7148 0x1440c 0x7530 0x13576 0x7918 0x1279b 0x7d00 0x11a72 0x80e8 0x10df0 0x84d0 0x1020d 0x88b8 0xf6bf 0x8ca0 0xebff 0x9088 0xe1c5 0x9470 0xd80a 0x9858 0xcec6 0x9c40 0xc5f5 0xa028 0xbd90 0xa410 0xb592 0xa7f8 0xadf5 0xabe0 0xa6b3 0xafc8 0x9fc8 0xb3b0 0x992d 0xb798 0x92e1 0xbb80 0x8cdf 0xbf68 0x8723 0xc350 0x81ab 0xc738 0x7c73 0xcb20 0x7778 0xcf08 0x72b6 0xd2f0 0x6e2b 0xd6d8 0x69d3 0xdac0 0x65ac 0xdea8 0x61b5 0xe290 0x5dea 0xe678 0x5a49 0xea60 0x56d0 0xee48 0x537e 0xf230 0x5050 0xf618 0x4d46 0xfa00 0x4a5c 0xfde8 0x4792 0x101d0 0x44e8 0x105b8 0x425a 0x109a0 0x3fe8 0x10d88 0x3d8f 0x11170 0x3b50 0x11558 0x3927 0x11940 0x3714 0x11d28 0x3517 0x12110 0x332f 0x124f8 0x315b 0x128e0 0x2f9b 0x12cc8 0x2dec 0x130b0 0x2c4f 0x13498 0x2ac2 0x13880 0x2945 0x13c68 0x27d7 0x14050 0x2677 0x14438 0x2525 0x14820 0x23e0 0x14c08 0x22a8 0x14ff0 0x217c 0x153d8 0x205b 0x157c0 0x1f45 0x15ba8 0x1e3a 0x15f90 0x1d39 0x16378 0x1c42 0x16760 0x1b55 0x16b48 0x1a71 0x16f30 0x1994 0x17318 0x18c1 0x17700 0x17f4 0x17ae8 0x172e 0x17ed0 0x1670 0x182b8 0x15b9 0x186a0 0x1508 0x18a88 0x145e 0x18e70 0x13bb 0x19258 0x131d 0x19640 0x1285 0x19a28 0x11f2 0x19e10 0x1165 0x1a1f8 0x10dc 0x1a5e0 0x1058 0x1a9c8 0xfd9 0x1adb0 0xf5e 0x1b198 0xee8 0x1b580 0xe75 0x1b968 0xe07 0x1bd50 0xd9c 0x1c138 0xd34 0x1c520 0xcd1 0x1c908 0xc71 0x1ccf0 0xc15 0x1d0d8 0xbbb 0x1d4c0 0xb64 0x1d8a8 0xb10 0x1dc90 0xabf 0x1e078 0xa70 0x1e460 0xa24 0x1e848 0x9da>;
		phandle = <0x25>;
	};

	thermal-ntc2 {
		compatible = "mediatek,mt6880-board-ntc";
		#thermal-sensor-cells = <0x00>;
		reg = <0x00 0x1001c0d8 0x00 0x04>;
		pmic_auxadc = <0x22>;
		temperature-lookup-table = <0xffff63c0 0x43183f 0xffff67a8 0x3e73ca 0xffff6b90 0x3a2985 0xffff6f78 0x363205 0xffff7360 0x328684 0xffff7748 0x2f20d7 0xffff7b30 0x2bfb5c 0xffff7f18 0x2910ee 0xffff8300 0x265cd9 0xffff86e8 0x23dad2 0xffff8ad0 0x2186e9 0xffff8eb8 0x1f5d86 0xffff92a0 0x1d5b5c 0xffff9688 0x1b7d65 0xffff9a70 0x19c0dd 0xffff9e58 0x182339 0xffffa240 0x16a15c 0xffffa628 0x153a09 0xffffaa10 0x13eb45 0xffffadf8 0x12b33b 0xffffb1e0 0x11903d 0xffffb5c8 0x1080bf 0xffffb9b0 0xf8355 0xffffbd98 0xe96b0 0xffffc180 0xdb999 0xffffc568 0xceaf3 0xffffc950 0xc29b7 0xffffcd38 0xb74f2 0xffffd120 0xacbc4 0xffffd508 0xa2d5c 0xffffd8f0 0x998fc 0xffffdcd8 0x90dbe 0xffffe0c0 0x88b3b 0xffffe4a8 0x810da 0xffffe890 0x79e0c 0xffffec78 0x73250 0xfffff060 0x6cd4c 0xfffff448 0x66e68 0xfffff830 0x6153c 0xfffffc18 0x5c169 0x00 0x57294 0x3e8 0x52856 0x7d0 0x4e27a 0xbb8 0x4a0b7 0xfa0 0x462ca 0x1388 0x42874 0x1770 0x3f17a 0x1b58 0x3bda8 0x1f40 0x38cc9 0x2328 0x35eaf 0x2710 0x3332e 0x2af8 0x30a1c 0x2ee0 0x2e354 0x32c8 0x2beb2 0x36b0 0x29c13 0x3a98 0x27b5b 0x3e80 0x25c66 0x4268 0x23f20 0x4650 0x2236e 0x4a38 0x20938 0x4e20 0x1f068 0x5208 0x1d8ea 0x55f0 0x1c2a8 0x59d8 0x1ad92 0x5dc0 0x19994 0x61a8 0x186a0 0x6590 0x174a6 0x6978 0x16398 0x6d60 0x15369 0x7148 0x1440c 0x7530 0x13576 0x7918 0x1279b 0x7d00 0x11a72 0x80e8 0x10df0 0x84d0 0x1020d 0x88b8 0xf6bf 0x8ca0 0xebff 0x9088 0xe1c5 0x9470 0xd80a 0x9858 0xcec6 0x9c40 0xc5f5 0xa028 0xbd90 0xa410 0xb592 0xa7f8 0xadf5 0xabe0 0xa6b3 0xafc8 0x9fc8 0xb3b0 0x992d 0xb798 0x92e1 0xbb80 0x8cdf 0xbf68 0x8723 0xc350 0x81ab 0xc738 0x7c73 0xcb20 0x7778 0xcf08 0x72b6 0xd2f0 0x6e2b 0xd6d8 0x69d3 0xdac0 0x65ac 0xdea8 0x61b5 0xe290 0x5dea 0xe678 0x5a49 0xea60 0x56d0 0xee48 0x537e 0xf230 0x5050 0xf618 0x4d46 0xfa00 0x4a5c 0xfde8 0x4792 0x101d0 0x44e8 0x105b8 0x425a 0x109a0 0x3fe8 0x10d88 0x3d8f 0x11170 0x3b50 0x11558 0x3927 0x11940 0x3714 0x11d28 0x3517 0x12110 0x332f 0x124f8 0x315b 0x128e0 0x2f9b 0x12cc8 0x2dec 0x130b0 0x2c4f 0x13498 0x2ac2 0x13880 0x2945 0x13c68 0x27d7 0x14050 0x2677 0x14438 0x2525 0x14820 0x23e0 0x14c08 0x22a8 0x14ff0 0x217c 0x153d8 0x205b 0x157c0 0x1f45 0x15ba8 0x1e3a 0x15f90 0x1d39 0x16378 0x1c42 0x16760 0x1b55 0x16b48 0x1a71 0x16f30 0x1994 0x17318 0x18c1 0x17700 0x17f4 0x17ae8 0x172e 0x17ed0 0x1670 0x182b8 0x15b9 0x186a0 0x1508 0x18a88 0x145e 0x18e70 0x13bb 0x19258 0x131d 0x19640 0x1285 0x19a28 0x11f2 0x19e10 0x1165 0x1a1f8 0x10dc 0x1a5e0 0x1058 0x1a9c8 0xfd9 0x1adb0 0xf5e 0x1b198 0xee8 0x1b580 0xe75 0x1b968 0xe07 0x1bd50 0xd9c 0x1c138 0xd34 0x1c520 0xcd1 0x1c908 0xc71 0x1ccf0 0xc15 0x1d0d8 0xbbb 0x1d4c0 0xb64 0x1d8a8 0xb10 0x1dc90 0xabf 0x1e078 0xa70 0x1e460 0xa24 0x1e848 0x9da>;
		phandle = <0x26>;
	};

	thermal-ntc3 {
		compatible = "mediatek,mt6880-board-ntc";
		#thermal-sensor-cells = <0x00>;
		reg = <0x00 0x1001c0dc 0x00 0x04>;
		pmic_auxadc = <0x22>;
		temperature-lookup-table = <0xffff63c0 0x43183f 0xffff67a8 0x3e73ca 0xffff6b90 0x3a2985 0xffff6f78 0x363205 0xffff7360 0x328684 0xffff7748 0x2f20d7 0xffff7b30 0x2bfb5c 0xffff7f18 0x2910ee 0xffff8300 0x265cd9 0xffff86e8 0x23dad2 0xffff8ad0 0x2186e9 0xffff8eb8 0x1f5d86 0xffff92a0 0x1d5b5c 0xffff9688 0x1b7d65 0xffff9a70 0x19c0dd 0xffff9e58 0x182339 0xffffa240 0x16a15c 0xffffa628 0x153a09 0xffffaa10 0x13eb45 0xffffadf8 0x12b33b 0xffffb1e0 0x11903d 0xffffb5c8 0x1080bf 0xffffb9b0 0xf8355 0xffffbd98 0xe96b0 0xffffc180 0xdb999 0xffffc568 0xceaf3 0xffffc950 0xc29b7 0xffffcd38 0xb74f2 0xffffd120 0xacbc4 0xffffd508 0xa2d5c 0xffffd8f0 0x998fc 0xffffdcd8 0x90dbe 0xffffe0c0 0x88b3b 0xffffe4a8 0x810da 0xffffe890 0x79e0c 0xffffec78 0x73250 0xfffff060 0x6cd4c 0xfffff448 0x66e68 0xfffff830 0x6153c 0xfffffc18 0x5c169 0x00 0x57294 0x3e8 0x52856 0x7d0 0x4e27a 0xbb8 0x4a0b7 0xfa0 0x462ca 0x1388 0x42874 0x1770 0x3f17a 0x1b58 0x3bda8 0x1f40 0x38cc9 0x2328 0x35eaf 0x2710 0x3332e 0x2af8 0x30a1c 0x2ee0 0x2e354 0x32c8 0x2beb2 0x36b0 0x29c13 0x3a98 0x27b5b 0x3e80 0x25c66 0x4268 0x23f20 0x4650 0x2236e 0x4a38 0x20938 0x4e20 0x1f068 0x5208 0x1d8ea 0x55f0 0x1c2a8 0x59d8 0x1ad92 0x5dc0 0x19994 0x61a8 0x186a0 0x6590 0x174a6 0x6978 0x16398 0x6d60 0x15369 0x7148 0x1440c 0x7530 0x13576 0x7918 0x1279b 0x7d00 0x11a72 0x80e8 0x10df0 0x84d0 0x1020d 0x88b8 0xf6bf 0x8ca0 0xebff 0x9088 0xe1c5 0x9470 0xd80a 0x9858 0xcec6 0x9c40 0xc5f5 0xa028 0xbd90 0xa410 0xb592 0xa7f8 0xadf5 0xabe0 0xa6b3 0xafc8 0x9fc8 0xb3b0 0x992d 0xb798 0x92e1 0xbb80 0x8cdf 0xbf68 0x8723 0xc350 0x81ab 0xc738 0x7c73 0xcb20 0x7778 0xcf08 0x72b6 0xd2f0 0x6e2b 0xd6d8 0x69d3 0xdac0 0x65ac 0xdea8 0x61b5 0xe290 0x5dea 0xe678 0x5a49 0xea60 0x56d0 0xee48 0x537e 0xf230 0x5050 0xf618 0x4d46 0xfa00 0x4a5c 0xfde8 0x4792 0x101d0 0x44e8 0x105b8 0x425a 0x109a0 0x3fe8 0x10d88 0x3d8f 0x11170 0x3b50 0x11558 0x3927 0x11940 0x3714 0x11d28 0x3517 0x12110 0x332f 0x124f8 0x315b 0x128e0 0x2f9b 0x12cc8 0x2dec 0x130b0 0x2c4f 0x13498 0x2ac2 0x13880 0x2945 0x13c68 0x27d7 0x14050 0x2677 0x14438 0x2525 0x14820 0x23e0 0x14c08 0x22a8 0x14ff0 0x217c 0x153d8 0x205b 0x157c0 0x1f45 0x15ba8 0x1e3a 0x15f90 0x1d39 0x16378 0x1c42 0x16760 0x1b55 0x16b48 0x1a71 0x16f30 0x1994 0x17318 0x18c1 0x17700 0x17f4 0x17ae8 0x172e 0x17ed0 0x1670 0x182b8 0x15b9 0x186a0 0x1508 0x18a88 0x145e 0x18e70 0x13bb 0x19258 0x131d 0x19640 0x1285 0x19a28 0x11f2 0x19e10 0x1165 0x1a1f8 0x10dc 0x1a5e0 0x1058 0x1a9c8 0xfd9 0x1adb0 0xf5e 0x1b198 0xee8 0x1b580 0xe75 0x1b968 0xe07 0x1bd50 0xd9c 0x1c138 0xd34 0x1c520 0xcd1 0x1c908 0xc71 0x1ccf0 0xc15 0x1d0d8 0xbbb 0x1d4c0 0xb64 0x1d8a8 0xb10 0x1dc90 0xabf 0x1e078 0xa70 0x1e460 0xa24 0x1e848 0x9da>;
		phandle = <0x27>;
	};

	thermal-ntc4 {
		compatible = "mediatek,mt6880-board-ntc";
		#thermal-sensor-cells = <0x00>;
		reg = <0x00 0x1001c0e0 0x00 0x04>;
		pmic_auxadc = <0x22>;
		temperature-lookup-table = <0xffff63c0 0x43183f 0xffff67a8 0x3e73ca 0xffff6b90 0x3a2985 0xffff6f78 0x363205 0xffff7360 0x328684 0xffff7748 0x2f20d7 0xffff7b30 0x2bfb5c 0xffff7f18 0x2910ee 0xffff8300 0x265cd9 0xffff86e8 0x23dad2 0xffff8ad0 0x2186e9 0xffff8eb8 0x1f5d86 0xffff92a0 0x1d5b5c 0xffff9688 0x1b7d65 0xffff9a70 0x19c0dd 0xffff9e58 0x182339 0xffffa240 0x16a15c 0xffffa628 0x153a09 0xffffaa10 0x13eb45 0xffffadf8 0x12b33b 0xffffb1e0 0x11903d 0xffffb5c8 0x1080bf 0xffffb9b0 0xf8355 0xffffbd98 0xe96b0 0xffffc180 0xdb999 0xffffc568 0xceaf3 0xffffc950 0xc29b7 0xffffcd38 0xb74f2 0xffffd120 0xacbc4 0xffffd508 0xa2d5c 0xffffd8f0 0x998fc 0xffffdcd8 0x90dbe 0xffffe0c0 0x88b3b 0xffffe4a8 0x810da 0xffffe890 0x79e0c 0xffffec78 0x73250 0xfffff060 0x6cd4c 0xfffff448 0x66e68 0xfffff830 0x6153c 0xfffffc18 0x5c169 0x00 0x57294 0x3e8 0x52856 0x7d0 0x4e27a 0xbb8 0x4a0b7 0xfa0 0x462ca 0x1388 0x42874 0x1770 0x3f17a 0x1b58 0x3bda8 0x1f40 0x38cc9 0x2328 0x35eaf 0x2710 0x3332e 0x2af8 0x30a1c 0x2ee0 0x2e354 0x32c8 0x2beb2 0x36b0 0x29c13 0x3a98 0x27b5b 0x3e80 0x25c66 0x4268 0x23f20 0x4650 0x2236e 0x4a38 0x20938 0x4e20 0x1f068 0x5208 0x1d8ea 0x55f0 0x1c2a8 0x59d8 0x1ad92 0x5dc0 0x19994 0x61a8 0x186a0 0x6590 0x174a6 0x6978 0x16398 0x6d60 0x15369 0x7148 0x1440c 0x7530 0x13576 0x7918 0x1279b 0x7d00 0x11a72 0x80e8 0x10df0 0x84d0 0x1020d 0x88b8 0xf6bf 0x8ca0 0xebff 0x9088 0xe1c5 0x9470 0xd80a 0x9858 0xcec6 0x9c40 0xc5f5 0xa028 0xbd90 0xa410 0xb592 0xa7f8 0xadf5 0xabe0 0xa6b3 0xafc8 0x9fc8 0xb3b0 0x992d 0xb798 0x92e1 0xbb80 0x8cdf 0xbf68 0x8723 0xc350 0x81ab 0xc738 0x7c73 0xcb20 0x7778 0xcf08 0x72b6 0xd2f0 0x6e2b 0xd6d8 0x69d3 0xdac0 0x65ac 0xdea8 0x61b5 0xe290 0x5dea 0xe678 0x5a49 0xea60 0x56d0 0xee48 0x537e 0xf230 0x5050 0xf618 0x4d46 0xfa00 0x4a5c 0xfde8 0x4792 0x101d0 0x44e8 0x105b8 0x425a 0x109a0 0x3fe8 0x10d88 0x3d8f 0x11170 0x3b50 0x11558 0x3927 0x11940 0x3714 0x11d28 0x3517 0x12110 0x332f 0x124f8 0x315b 0x128e0 0x2f9b 0x12cc8 0x2dec 0x130b0 0x2c4f 0x13498 0x2ac2 0x13880 0x2945 0x13c68 0x27d7 0x14050 0x2677 0x14438 0x2525 0x14820 0x23e0 0x14c08 0x22a8 0x14ff0 0x217c 0x153d8 0x205b 0x157c0 0x1f45 0x15ba8 0x1e3a 0x15f90 0x1d39 0x16378 0x1c42 0x16760 0x1b55 0x16b48 0x1a71 0x16f30 0x1994 0x17318 0x18c1 0x17700 0x17f4 0x17ae8 0x172e 0x17ed0 0x1670 0x182b8 0x15b9 0x186a0 0x1508 0x18a88 0x145e 0x18e70 0x13bb 0x19258 0x131d 0x19640 0x1285 0x19a28 0x11f2 0x19e10 0x1165 0x1a1f8 0x10dc 0x1a5e0 0x1058 0x1a9c8 0xfd9 0x1adb0 0xf5e 0x1b198 0xee8 0x1b580 0xe75 0x1b968 0xe07 0x1bd50 0xd9c 0x1c138 0xd34 0x1c520 0xcd1 0x1c908 0xc71 0x1ccf0 0xc15 0x1d0d8 0xbbb 0x1d4c0 0xb64 0x1d8a8 0xb10 0x1dc90 0xabf 0x1e078 0xa70 0x1e460 0xa24 0x1e848 0x9da>;
		phandle = <0x28>;
	};

	thermal_risk_monitor {
		compatible = "mediatek,mt6880-trm";
	};

	pmic_temp {
		compatible = "mediatek,mt6330-pmic-temp";
		io-channels = <0x22 0x05>;
		io-channel-names = "pmic_chip_temp";
		#thermal-sensor-cells = <0x00>;
		nvmem-cells = <0x23>;
		nvmem-cell-names = "t_e_data1@6c";
		pmic_temp,cali_factor = <0x691>;
		pmic_temp,iio_chan = <0x00>;
		phandle = <0x29>;
	};

	pmic_vcore {
		compatible = "mediatek,mt6330-pmic-temp";
		io-channels = <0x22 0x06>;
		io-channel-names = "pmic_buck1_temp";
		#thermal-sensor-cells = <0x00>;
		nvmem-cells = <0x23>;
		nvmem-cell-names = "t_e_data1@6c";
		pmic_temp,cali_factor = <0x747>;
		pmic_temp,iio_chan = <0x01>;
		phandle = <0x2a>;
	};

	pmic_vproc {
		compatible = "mediatek,mt6330-pmic-temp";
		io-channels = <0x22 0x07>;
		io-channel-names = "pmic_buck2_temp";
		#thermal-sensor-cells = <0x00>;
		nvmem-cells = <0x23>;
		nvmem-cell-names = "t_e_data1@6c";
		pmic_temp,cali_factor = <0x747>;
		pmic_temp,iio_chan = <0x02>;
		phandle = <0x2b>;
	};

	pmic_vgpu {
		compatible = "mediatek,mt6330-pmic-temp";
		io-channels = <0x22 0x08>;
		io-channel-names = "pmic_buck3_temp";
		#thermal-sensor-cells = <0x00>;
		nvmem-cells = <0x23>;
		nvmem-cell-names = "t_e_data1@6c";
		pmic_temp,cali_factor = <0x747>;
		pmic_temp,iio_chan = <0x03>;
		phandle = <0x2c>;
	};

	md-rf-ic {
		compatible = "mediatek,md-rf";
		#thermal-sensor-cells = <0x00>;
		phandle = <0x2d>;
	};

	mutt {
		compatible = "mediatek,mt6297-md-cooler-mutt";

		mutt-pa1 {
			id = <0x00>;
			#cooling-cells = <0x02>;
		};

		mutt-pa1-no-ims {
			id = <0x00>;
			#cooling-cells = <0x02>;
		};

		mutt-pa2 {
			id = <0x01>;
			#cooling-cells = <0x02>;
		};

		mutt-pa2-no-ims {
			id = <0x01>;
			#cooling-cells = <0x02>;
		};
	};

	tx-pwr {
		compatible = "mediatek,md-cooler-tx-pwr";

		tx-pwr-pa1 {
			id = <0x00>;
			#cooling-cells = <0x02>;
		};

		tx-pwr-pa2 {
			id = <0x01>;
			#cooling-cells = <0x02>;
		};
	};

	scg-off {
		compatible = "mediatek,md-cooler-scg-off";

		scg-off-pa2 {
			id = <0x01>;
			#cooling-cells = <0x02>;
		};
	};

	thermal-zones {

		soc_max {
			polling-delay = <0x00>;
			polling-delay-passive = <0x00>;
			thermal-sensors = <0x24 0x00>;
		};

		cpu_little0 {
			polling-delay = <0x00>;
			polling-delay-passive = <0x00>;
			thermal-sensors = <0x24 0x01>;
		};

		cpu_little1 {
			polling-delay = <0x00>;
			polling-delay-passive = <0x00>;
			thermal-sensors = <0x24 0x02>;
		};

		cpu_little2 {
			polling-delay = <0x00>;
			polling-delay-passive = <0x00>;
			thermal-sensors = <0x24 0x03>;
		};

		cpu_little3 {
			polling-delay = <0x00>;
			polling-delay-passive = <0x00>;
			thermal-sensors = <0x24 0x04>;
		};

		gpu0 {
			polling-delay = <0x00>;
			polling-delay-passive = <0x00>;
			thermal-sensors = <0x24 0x05>;
		};

		gpu1 {
			polling-delay = <0x00>;
			polling-delay-passive = <0x00>;
			thermal-sensors = <0x24 0x06>;
		};

		dramc {
			polling-delay = <0x00>;
			polling-delay-passive = <0x00>;
			thermal-sensors = <0x24 0x07>;
		};

		mmsys {
			polling-delay = <0x00>;
			polling-delay-passive = <0x00>;
			thermal-sensors = <0x24 0x08>;
		};

		md_5g {
			polling-delay = <0x00>;
			polling-delay-passive = <0x00>;
			thermal-sensors = <0x24 0x09>;
		};

		md_4g {
			polling-delay = <0x00>;
			polling-delay-passive = <0x00>;
			thermal-sensors = <0x24 0x0a>;
		};

		md_3g {
			polling-delay = <0x00>;
			polling-delay-passive = <0x00>;
			thermal-sensors = <0x24 0x0b>;
		};

		soc_dram_ntc {
			polling-delay = <0x00>;
			polling-delay-passive = <0x00>;
			thermal-sensors = <0x25>;
		};

		nrpa_ntc {
			polling-delay = <0x00>;
			polling-delay-passive = <0x00>;
			thermal-sensors = <0x26>;
		};

		ltepa_ntc {
			polling-delay = <0x00>;
			polling-delay-passive = <0x00>;
			thermal-sensors = <0x27>;
		};

		rf_ntc {
			polling-delay = <0x00>;
			polling-delay-passive = <0x00>;
			thermal-sensors = <0x28>;
		};

		pmic {
			polling-delay = <0x00>;
			polling-delay-passive = <0x00>;
			thermal-sensors = <0x29>;
		};

		pmic_vcore {
			polling-delay = <0x00>;
			polling-delay-passive = <0x00>;
			thermal-sensors = <0x2a>;
		};

		pmic_vproc {
			polling-delay = <0x00>;
			polling-delay-passive = <0x00>;
			thermal-sensors = <0x2b>;
		};

		pmic_vgpu {
			polling-delay = <0x00>;
			polling-delay-passive = <0x00>;
			thermal-sensors = <0x2c>;
		};

		md_rf {
			polling-delay = <0x00>;
			polling-delay-passive = <0x00>;
			thermal-sensors = <0x2d>;
		};

		conn_gps {
			polling-delay = <0x00>;
			polling-delay-passive = <0x00>;
			thermal-sensors = <0x2e>;
		};
	};

	chipid@08000000 {
		compatible = "mediatek,chipid";
		reg = <0x00 0x8000000 0x00 0x04 0x00 0x8000004 0x00 0x04 0x00 0x8000008 0x00 0x04 0x00 0x800000c 0x00 0x04>;
	};

	dbgtop@1000d000 {
		compatible = "mediatek,dbgtop-drm";
		reg = <0x00 0x1000d000 0x00 0x1000>;
	};

	mcupm@0C540000 {
		compatible = "mediatek,mcupm";
		reg = <0x00 0xc540000 0x00 0x22000 0x00 0xc55fb00 0x00 0xa0 0x00 0xc562004 0x00 0x04 0x00 0xc562018 0x00 0x04 0x00 0xc562000 0x00 0x04 0x00 0xc562010 0x00 0x04 0x00 0xc55fba0 0x00 0xa0 0x00 0xc562004 0x00 0x04 0x00 0xc562018 0x00 0x04 0x00 0xc562000 0x00 0x04 0x00 0xc562010 0x00 0x04 0x00 0xc55fc40 0x00 0xa0 0x00 0xc562004 0x00 0x04 0x00 0xc562018 0x00 0x04 0x00 0xc562000 0x00 0x04 0x00 0xc562010 0x00 0x04 0x00 0xc55fce0 0x00 0xa0 0x00 0xc562004 0x00 0x04 0x00 0xc562018 0x00 0x04 0x00 0xc562000 0x00 0x04 0x00 0xc562010 0x00 0x04 0x00 0xc55fd80 0x00 0xa0 0x00 0xc562004 0x00 0x04 0x00 0xc562018 0x00 0x04 0x00 0xc562000 0x00 0x04 0x00 0xc562010 0x00 0x04 0x00 0xc55fe20 0x00 0xa0 0x00 0xc562004 0x00 0x04 0x00 0xc562018 0x00 0x04 0x00 0xc562000 0x00 0x04 0x00 0xc562010 0x00 0x04 0x00 0xc55fec0 0x00 0xa0 0x00 0xc562004 0x00 0x04 0x00 0xc562018 0x00 0x04 0x00 0xc562000 0x00 0x04 0x00 0xc562010 0x00 0x04 0x00 0xc55ff60 0x00 0xa0 0x00 0xc562004 0x00 0x04 0x00 0xc562018 0x00 0x04 0x00 0xc562000 0x00 0x04 0x00 0xc562010 0x00 0x04>;
		reg-names = "mcupm_base", "mbox0_base", "mbox0_set", "mbox0_clr", "mbox0_send", "mbox0_recv", "mbox1_base", "mbox1_set", "mbox1_clr", "mbox1_send", "mbox1_recv", "mbox2_base", "mbox2_set", "mbox2_clr", "mbox2_send", "mbox2_recv", "mbox3_base", "mbox3_set", "mbox3_clr", "mbox3_send", "mbox3_recv", "mbox4_base", "mbox4_set", "mbox4_clr", "mbox4_send", "mbox4_recv", "mbox5_base", "mbox5_set", "mbox5_clr", "mbox5_send", "mbox5_recv", "mbox6_base", "mbox6_set", "mbox6_clr", "mbox6_send", "mbox6_recv", "mbox7_base", "mbox7_set", "mbox7_clr", "mbox7_send", "mbox7_recv";
		interrupts = <0x00 0x21 0x04 0x00 0x22 0x04 0x00 0x23 0x04 0x00 0x24 0x04 0x00 0x25 0x04 0x00 0x26 0x04 0x00 0x27 0x04 0x00 0x28 0x04>;
		interrupt-names = "mbox0", "mbox1", "mbox2", "mbox3", "mbox4", "mbox5", "mbox6", "mbox7";
	};

	topckgen@10000000 {
		compatible = "mediatek,topckgen", "syscon";
		reg = <0x00 0x10000000 0x00 0x1000>;
	};

	dcm@10001000 {
		compatible = "mediatek,mt6880-dcm";
		reg = <0x00 0x10001000 0x00 0x1000 0x00 0x10002000 0x00 0x1000 0x00 0x10022000 0x00 0x1000 0x00 0x10219000 0x00 0x1000 0x00 0x10230000 0x00 0x2000 0x00 0x10235000 0x00 0x1000 0x00 0x10238000 0x00 0x1000 0x00 0x10240000 0x00 0x2000 0x00 0x10248000 0x00 0x1000 0x00 0xc538000 0x00 0x5000 0x00 0xc53a800 0x00 0x1000>;
		reg-names = "infracfg_ao", "infracfg_ao_mem", "infra_ao_bcrm", "emi", "dramc_ch0_top0", "chn0_emi", "dramc_ch0_top5", "dramc_ch1_top0", "dramc_ch1_top5", "mp_cpusys_top", "cpccfg_reg";
	};

	infracfg_ao@10001000 {
		compatible = "mediatek,infracfg_ao", "syscon", "simple-mfd";
		reg = <0x00 0x10001000 0x00 0x1000>;
		phandle = <0x4e>;

		reset-controller {
			compatible = "ti,syscon-reset";
			#reset-cells = <0x01>;
			ti,reset-bits = <0x120 0x00 0x124 0x00 0x00 0x00 0x1c 0x730 0x0c 0x734 0x0c 0x00 0x00 0x1c>;
			phandle = <0x6d>;
		};
	};

	infracfg_ao_mem@10002000 {
		compatible = "mediatek,infracfg_ao_mem";
		reg = <0x00 0x10002000 0x00 0x1000>;
	};

	pericfg@10003000 {
		compatible = "mediatek,pericfg";
		reg = <0x00 0x10003000 0x00 0x1000>;
	};

	gpio_usage_mapping {
		compatible = "mediatek,gpio_usage_mapping";
		GPIO_SIM1_HOT_PLUG = <0x2f 0x53 0x00>;
		GPIO_SIM2_HOT_PLUG = <0x2f 0x54 0x00>;
		GPIO_SIM1_SIO = <0x2f 0x55 0x00>;
		GPIO_SIM1_SRST = <0x2f 0x56 0x00>;
		GPIO_SIM1_SCLK = <0x2f 0x57 0x00>;
		GPIO_SIM2_SCLK = <0x2f 0x58 0x00>;
		GPIO_SIM2_SRST = <0x2f 0x59 0x00>;
		GPIO_SIM2_SIO = <0x2f 0x5a 0x00>;
		GPIO_FDD_BAND_SUPPORT_DETECT_1ST_PIN = <0x2f 0x8e 0x00>;
		GPIO_FDD_BAND_SUPPORT_DETECT_2ND_PIN = <0x2f 0x8f 0x00>;
	};

	gpio@10005000 {
		compatible = "mediatek,gpio";
		reg = <0x00 0x10005000 0x00 0x1000>;
		gpio_init_default = <0x00 0x00 0x00 0x00 0x01 0x00 0x01 0x01 0x00 0x00 0x00 0x01 0x00 0x01 0x02 0x00 0x00 0x00 0x01 0x00 0x01 0x03 0x00 0x00 0x00 0x01 0x00 0x01 0x04 0x00 0x01 0x00 0x01 0x00 0x00 0x05 0x00 0x00 0x00 0x01 0x00 0x00 0x06 0x00 0x00 0x00 0x01 0x00 0x00 0x07 0x00 0x00 0x00 0x01 0x00 0x00 0x08 0x00 0x01 0x00 0x01 0x00 0x01 0x09 0x00 0x00 0x00 0x01 0x00 0x01 0x0a 0x00 0x01 0x00 0x01 0x00 0x01 0x0b 0x00 0x01 0x00 0x01 0x00 0x01 0x0c 0x00 0x01 0x00 0x01 0x00 0x01 0x0d 0x00 0x01 0x00 0x01 0x00 0x01 0x0e 0x00 0x00 0x00 0x01 0x01 0x01 0x0f 0x00 0x00 0x00 0x01 0x00 0x01 0x10 0x00 0x01 0x00 0x01 0x00 0x01 0x11 0x00 0x01 0x01 0x01 0x00 0x00 0x12 0x00 0x01 0x01 0x01 0x00 0x00 0x13 0x00 0x01 0x00 0x01 0x00 0x00 0x14 0x00 0x00 0x00 0x01 0x01 0x00 0x15 0x00 0x01 0x00 0x01 0x00 0x00 0x16 0x00 0x01 0x00 0x01 0x00 0x00 0x17 0x00 0x01 0x01 0x01 0x00 0x00 0x18 0x00 0x00 0x00 0x01 0x01 0x00 0x19 0x00 0x01 0x00 0x01 0x00 0x00 0x1a 0x00 0x00 0x00 0x01 0x00 0x00 0x1b 0x00 0x01 0x00 0x01 0x00 0x00 0x1c 0x00 0x00 0x00 0x01 0x00 0x00 0x1d 0x00 0x01 0x00 0x01 0x00 0x00 0x1e 0x00 0x01 0x00 0x01 0x00 0x00 0x1f 0x00 0x01 0x00 0x01 0x00 0x00 0x20 0x00 0x00 0x00 0x01 0x00 0x01 0x21 0x00 0x00 0x00 0x01 0x00 0x01 0x22 0x00 0x00 0x00 0x01 0x00 0x01 0x23 0x00 0x00 0x00 0x01 0x00 0x01 0x24 0x00 0x00 0x00 0x01 0x00 0x01 0x25 0x00 0x00 0x00 0x01 0x00 0x01 0x26 0x00 0x00 0x00 0x01 0x00 0x01 0x27 0x00 0x00 0x00 0x01 0x00 0x01 0x28 0x00 0x00 0x00 0x01 0x01 0x00 0x29 0x00 0x00 0x00 0x01 0x00 0x00 0x2a 0x00 0x00 0x00 0x01 0x00 0x00 0x37 0x01 0x00 0x00 0x00 0x00 0x01 0x38 0x01 0x00 0x00 0x01 0x01 0x01 0x39 0x01 0x00 0x00 0x01 0x01 0x01 0x3a 0x01 0x00 0x00 0x01 0x01 0x01 0x3b 0x01 0x00 0x00 0x01 0x01 0x01 0x3c 0x01 0x00 0x00 0x01 0x01 0x01 0x3d 0x00 0x00 0x00 0x01 0x00 0x00 0x3e 0x00 0x00 0x00 0x01 0x00 0x00 0x3f 0x00 0x00 0x01 0x00 0x00 0x00 0x40 0x00 0x01 0x01 0x01 0x01 0x00 0x41 0x00 0x00 0x01 0x00 0x00 0x01 0x42 0x00 0x01 0x01 0x01 0x01 0x00 0x43 0x01 0x00 0x00 0x01 0x00 0x01 0x44 0x01 0x00 0x00 0x01 0x00 0x01 0x45 0x01 0x00 0x00 0x01 0x00 0x01 0x46 0x01 0x00 0x00 0x01 0x00 0x01 0x47 0x01 0x00 0x00 0x01 0x00 0x01 0x48 0x01 0x00 0x00 0x01 0x00 0x01 0x49 0x01 0x00 0x00 0x01 0x00 0x01 0x4a 0x01 0x00 0x00 0x01 0x00 0x01 0x4b 0x01 0x00 0x00 0x01 0x00 0x01 0x4c 0x01 0x00 0x00 0x01 0x00 0x01 0x4d 0x01 0x00 0x00 0x01 0x00 0x01 0x4e 0x01 0x00 0x00 0x01 0x00 0x01 0x4f 0x01 0x00 0x00 0x01 0x01 0x01 0x50 0x01 0x00 0x00 0x01 0x01 0x01 0x51 0x01 0x00 0x00 0x01 0x01 0x01 0x52 0x01 0x00 0x00 0x01 0x01 0x01 0x53 0x01 0x00 0x00 0x01 0x01 0x01 0x54 0x01 0x00 0x00 0x01 0x01 0x01 0x55 0x01 0x00 0x00 0x01 0x01 0x00 0x56 0x01 0x00 0x00 0x01 0x00 0x00 0x57 0x01 0x00 0x00 0x01 0x00 0x00 0x58 0x01 0x00 0x00 0x01 0x00 0x00 0x59 0x01 0x00 0x00 0x01 0x00 0x00 0x5a 0x01 0x00 0x00 0x01 0x01 0x00 0x5b 0x01 0x00 0x00 0x01 0x00 0x01 0x5c 0x01 0x00 0x00 0x01 0x00 0x01 0x5d 0x01 0x00 0x00 0x01 0x00 0x01 0x5e 0x01 0x00 0x00 0x01 0x00 0x01 0x5f 0x01 0x00 0x00 0x01 0x00 0x01 0x60 0x01 0x00 0x00 0x01 0x00 0x01 0x61 0x01 0x00 0x00 0x01 0x00 0x01 0x62 0x01 0x00 0x00 0x01 0x00 0x01 0x63 0x01 0x00 0x00 0x01 0x00 0x01 0x64 0x01 0x00 0x00 0x01 0x00 0x01 0x65 0x01 0x00 0x00 0x01 0x00 0x01 0x66 0x01 0x00 0x00 0x01 0x00 0x01 0x67 0x01 0x00 0x00 0x01 0x00 0x01 0x68 0x01 0x00 0x00 0x01 0x00 0x01 0x69 0x01 0x00 0x00 0x01 0x01 0x00 0x6a 0x01 0x00 0x00 0x01 0x01 0x00 0x6b 0x01 0x00 0x00 0x01 0x01 0x00 0x6c 0x01 0x00 0x00 0x01 0x01 0x00 0x6d 0x01 0x00 0x00 0x01 0x01 0x00 0x6e 0x01 0x00 0x00 0x01 0x01 0x00 0x6f 0x01 0x00 0x00 0x01 0x00 0x01 0x70 0x01 0x00 0x00 0x01 0x00 0x01 0x71 0x01 0x00 0x00 0x01 0x00 0x01 0x72 0x01 0x00 0x00 0x01 0x00 0x01 0x73 0x01 0x00 0x00 0x01 0x00 0x01 0x74 0x01 0x00 0x00 0x01 0x00 0x01 0x75 0x01 0x00 0x00 0x01 0x00 0x01 0x76 0x01 0x00 0x00 0x01 0x00 0x00 0x77 0x01 0x00 0x00 0x01 0x01 0x01 0x78 0x01 0x00 0x00 0x01 0x00 0x01 0x79 0x01 0x00 0x00 0x00 0x00 0x01 0x7a 0x01 0x00 0x00 0x00 0x00 0x01 0x7b 0x01 0x00 0x00 0x00 0x00 0x01 0x7c 0x01 0x00 0x00 0x00 0x00 0x01 0x7d 0x01 0x00 0x00 0x01 0x00 0x00 0x7e 0x01 0x00 0x00 0x01 0x00 0x00 0x7f 0x00 0x00 0x00 0x01 0x00 0x00 0x80 0x00 0x00 0x00 0x01 0x00 0x00 0x81 0x00 0x00 0x00 0x01 0x00 0x00 0x82 0x01 0x00 0x00 0x01 0x00 0x00 0x83 0x01 0x00 0x00 0x01 0x00 0x00 0x84 0x01 0x00 0x00 0x01 0x00 0x00 0x85 0x01 0x00 0x00 0x01 0x01 0x00 0x86 0x00 0x01 0x00 0x01 0x00 0x00 0x87 0x00 0x01 0x00 0x01 0x00 0x00 0x88 0x01 0x00 0x00 0x01 0x00 0x00 0x89 0x01 0x00 0x00 0x01 0x00 0x00 0x8a 0x01 0x00 0x00 0x00 0x00 0x00 0x8b 0x01 0x00 0x00 0x01 0x00 0x00 0x8c 0x01 0x00 0x00 0x00 0x00 0x00 0x8d 0x01 0x00 0x00 0x01 0x00 0x00 0x8e 0x00 0x00 0x00 0x01 0x00 0x00 0x8f 0x00 0x00 0x00 0x01 0x00 0x00 0x90 0x01 0x00 0x00 0x00 0x00 0x00 0x91 0x01 0x00 0x00 0x00 0x00 0x00 0x92 0x01 0x00 0x00 0x00 0x00 0x00 0x93 0x01 0x00 0x00 0x00 0x00 0x00 0x94 0x01 0x00 0x00 0x00 0x00 0x00 0x95 0x01 0x00 0x00 0x00 0x00 0x00 0x96 0x00 0x01 0x01 0x01 0x00 0x00 0x97 0x01 0x00 0x00 0x00 0x00 0x00 0x98 0x01 0x00 0x00 0x00 0x00 0x00 0x99 0x01 0x00 0x00 0x00 0x00 0x00 0x9a 0x01 0x00 0x00 0x00 0x00 0x00 0x9b 0x01 0x00 0x00 0x00 0x00 0x00 0x9c 0x01 0x00 0x00 0x00 0x00 0x00 0x9d 0x01 0x00 0x00 0x00 0x00 0x00 0x9e 0x01 0x00 0x00 0x00 0x00 0x00 0x9f 0x01 0x00 0x00 0x00 0x00 0x00 0xa0 0x01 0x00 0x00 0x00 0x00 0x00 0xa1 0x01 0x00 0x00 0x00 0x00 0x00 0xa2 0x01 0x00 0x00 0x00 0x00 0x00 0xa3 0x01 0x00 0x00 0x00 0x00 0x00 0xa4 0x01 0x00 0x00 0x00 0x00 0x00 0xa5 0x01 0x00 0x00 0x01 0x00 0x00 0xa6 0x01 0x00 0x00 0x01 0x00 0x00 0xa7 0x01 0x00 0x00 0x01 0x00 0x00 0xa8 0x01 0x00 0x00 0x01 0x00 0x00 0xa9 0x01 0x00 0x00 0x01 0x01 0x00 0xaa 0x01 0x00 0x00 0x01 0x01 0x00 0xab 0x01 0x00 0x00 0x01 0x01 0x00 0xac 0x01 0x00 0x00 0x01 0x01 0x00 0xad 0x01 0x00 0x00 0x01 0x00 0x00 0xae 0x01 0x00 0x00 0x01 0x00 0x00 0xaf 0x01 0x00 0x00 0x01 0x00 0x00 0xb0 0x01 0x00 0x00 0x01 0x00 0x00 0xb1 0x01 0x00 0x00 0x01 0x00 0x00 0xb2 0x01 0x00 0x00 0x01 0x00 0x00 0xb3 0x01 0x00 0x00 0x01 0x00 0x00 0xb4 0x01 0x00 0x00 0x01 0x00 0x00 0xb5 0x07 0x00 0x00 0x01 0x01 0x00 0xb6 0x07 0x00 0x00 0x01 0x01 0x00 0xb7 0x01 0x00 0x00 0x01 0x00 0x00 0xb8 0x01 0x00 0x00 0x01 0x00 0x00 0xb9 0x07 0x00 0x00 0x00 0x00 0x00 0xba 0x07 0x00 0x00 0x01 0x00 0x00 0xbb 0x07 0x00 0x00 0x01 0x00 0x00 0xbc 0x07 0x00 0x00 0x01 0x00 0x00 0xbd 0x07 0x00 0x00 0x00 0x00 0x00 0xbe 0x07 0x00 0x00 0x01 0x00 0x00 0xbf 0x07 0x00 0x00 0x01 0x00 0x00 0xc0 0x07 0x00 0x00 0x01 0x00 0x00 0xc1 0x01 0x00 0x00 0x01 0x00 0x00 0xc2 0x01 0x00 0x00 0x01 0x00 0x00 0xc3 0x01 0x00 0x00 0x01 0x00 0x00 0xc4 0x01 0x00 0x00 0x01 0x00 0x00 0xc5 0x01 0x00 0x00 0x01 0x01 0x00 0xc6 0x01 0x00 0x00 0x01 0x01 0x00 0xc7 0x00 0x00 0x00 0x01 0x00 0x00 0xc8 0x00 0x00 0x00 0x01 0x00 0x00 0xc9 0x00 0x00 0x00 0x01 0x00 0x00 0xca 0x00 0x00 0x00 0x01 0x00 0x00 0xcb 0x07 0x00 0x00 0x01 0x00 0x00 0xcc 0x07 0x00 0x00 0x01 0x00 0x00 0xcd 0x07 0x00 0x00 0x01 0x00 0x00 0xce 0x01 0x00 0x00 0x01 0x00 0x01 0xcf 0x01 0x00 0x00 0x01 0x00 0x01 0xd0 0x01 0x00 0x00 0x01 0x00 0x01 0xd1 0x00 0x01 0x00 0x00 0x00 0x00 0xd2 0x00 0x01 0x00 0x00 0x00 0x00 0xd3 0x00 0x01 0x00 0x00 0x00 0x00 0xd4 0x00 0x01 0x00 0x00 0x00 0x00 0xd5 0x00 0x01 0x00 0x00 0x00 0x00 0xd6 0x01 0x00 0x00 0x01 0x00 0x00 0xd7 0x01 0x00 0x00 0x01 0x00 0x00 0xd8 0x01 0x00 0x00 0x01 0x00 0x00 0xd9 0x01 0x00 0x00 0x01 0x00 0x00 0xda 0x01 0x00 0x00 0x01 0x00 0x00 0xdb 0x01 0x00 0x00 0x01 0x00 0x00 0xdc 0x01 0x00 0x00 0x01 0x00 0x00 0xdd 0x01 0x00 0x00 0x01 0x00 0x00 0xde 0x01 0x00 0x00 0x01 0x00 0x00 0xdf 0x01 0x00 0x00 0x01 0x00 0x00 0xe0 0x01 0x00 0x00 0x01 0x01 0x00 0xe1 0x01 0x00 0x00 0x01 0x01 0x00 0xe2 0x01 0x00 0x00 0x01 0x01 0x00 0xe3 0x01 0x00 0x00 0x01 0x01 0x00 0xe4 0x01 0x00 0x00 0x01 0x00 0x00 0xe5 0x01 0x00 0x00 0x01 0x00 0x00 0xe6 0x01 0x01 0x00 0x01 0x00 0x01 0xe7 0x02 0x01 0x00 0x01 0x00 0x01 0xe8 0x02 0x01 0x00 0x01 0x00 0x01 0xe9 0x02 0x00 0x00 0x01 0x00 0x01 0xea 0x02 0x01 0x00 0x01 0x00 0x01>;
	};

	pinctrl@10005000 {
		compatible = "mediatek,mt68xx-pinctrl";
		reg = <0x00 0x10005000 0x00 0x1000 0x00 0x11c10000 0x00 0x1000 0x00 0x11c20000 0x00 0x1000 0x00 0x11d00000 0x00 0x1000 0x00 0x11d10000 0x00 0x1000 0x00 0x11d20000 0x00 0x1000 0x00 0x11e00000 0x00 0x1000 0x00 0x11f00000 0x00 0x1000 0x00 0x1000b000 0x00 0x1000>;
		reg-names = "gpio", "iocfg_rm", "iocfg_rb", "iocfg_bl", "iocfg_bm", "iocfg_br", "iocfg_lt", "iocfg_tl", "eint";
		gpio-controller;
		#gpio-cells = <0x02>;
		gpio-ranges = <0x2f 0x00 0x00 0xeb>;
		interrupt-controller;
		#interrupt-cells = <0x02>;
		interrupts = <0x00 0xd4 0x04>;
		interrupt-parent = <0x01>;
		phandle = <0x2f>;

		mmc0default {
			phandle = <0x67>;

			pins_cmd_dat {
				pinmux = <0x3501 0x3401 0x3301 0x3201 0x2e01 0x2d01 0x2c01 0x2b01 0x3001>;
				input-enable;
				mediatek,pull-up-adv = <0x65>;
			};

			pins_clk {
				pinmux = <0x3101>;
				mediatek,pull-down-adv = <0x66>;
			};

			pins_rst {
				pinmux = <0x2f01>;
				mediatek,pull-up-adv = <0x64>;
			};
		};

		mmc0@0 {
			phandle = <0x68>;

			pins_cmd_dat {
				pinmux = <0x3501 0x3401 0x3301 0x3201 0x2e01 0x2d01 0x2c01 0x2b01 0x3001>;
				input-enable;
				drive-strength = <0x0a>;
				mediatek,pull-up-adv = <0x65>;
			};

			pins_clk {
				pinmux = <0x3101>;
				drive-strength = <0x0a>;
				mediatek,pull-down-adv = <0x66>;
			};

			pins_ds {
				pinmux = <0x3601>;
				drive-strength = <0x0a>;
				mediatek,pull-down-adv = <0x66>;
			};

			pins_rst {
				pinmux = <0x2f01>;
				drive-strength = <0x0a>;
				mediatek,pull-up-adv = <0x64>;
			};
		};

		mmc1default {
			phandle = <0x6a>;

			pins_cmd_dat {
				pinmux = <0x3a01 0x3c01 0x3b01 0x3901 0x3801>;
				input-enable;
				drive-strength = <0x04>;
				mediatek,pull-up-adv = <0x65>;
			};

			pins_clk {
				pinmux = <0x3701>;
				drive-strength = <0x04>;
				mediatek,pull-down-adv = <0x66>;
			};
		};

		mmc1@0 {
			phandle = <0x6b>;

			pins_cmd_dat {
				pinmux = <0x3a01 0x3c01 0x3b01 0x3901 0x3801>;
				input-enable;
				drive-strength = <0x03>;
				mediatek,pull-up-adv = <0x65>;
			};

			pins_clk {
				pinmux = <0x3701>;
				drive-strength = <0x03>;
				mediatek,pull-down-adv = <0x66>;
			};
		};

		aud_dat_mosi_off {
			phandle = <0x8c>;
		};

		aud_dat_mosi_on {
			phandle = <0x8d>;
		};

		aud_dat_miso_off {
			phandle = <0x8e>;
		};

		aud_dat_miso_on {
			phandle = <0x8f>;
		};

		vow_dat_miso_off {
			phandle = <0x9e>;
		};

		vow_dat_miso_on {
			phandle = <0x9f>;
		};

		vow_clk_miso_off {
			phandle = <0xa0>;
		};

		vow_clk_miso_on {
			phandle = <0xa1>;
		};

		aud_gpio_i2s0_off {
			phandle = <0x90>;

			pins_cmd_dat {
				pinmux = <0xe600 0xe700 0xe800 0xe900 0xea00>;
			};
		};

		aud_gpio_i2s0_on {
			phandle = <0x91>;

			pins_cmd_dat {
				pinmux = <0xe601 0xe701 0xe801 0xe901 0xea01>;
			};
		};

		aud_gpio_i2s1_off {
			phandle = <0x92>;
		};

		aud_gpio_i2s1_on {
			phandle = <0x93>;
		};

		aud_gpio_i2s2_off {
			phandle = <0x94>;

			pins_cmd_dat {
				pinmux = <0x5b00 0x5c00 0x5d00 0x5e00>;
			};
		};

		aud_gpio_i2s2_on {
			phandle = <0x95>;

			pins_cmd_dat {
				pinmux = <0x5b01 0x5c01 0x5d01 0x5e01>;
			};
		};

		aud_gpio_i2s3_off {
			phandle = <0x96>;
		};

		aud_gpio_i2s3_on {
			phandle = <0x97>;
		};

		aud_gpio_i2s4_off {
			phandle = <0x98>;
		};

		aud_gpio_i2s4_on {
			phandle = <0x99>;
		};

		aud_gpio_i2s5_off {
			phandle = <0x9a>;
		};

		aud_gpio_i2s5_on {
			phandle = <0x9b>;
		};

		aud_gpio_i2s6_off {
			phandle = <0x9c>;
		};

		aud_gpio_i2s6_on {
			phandle = <0x9d>;
		};

		aud_gpio_proslic_off {
			phandle = <0xa2>;

			pins_cmd_dat {
				pinmux = <0xe700 0xe800 0xe900 0xea00>;
			};
		};

		aud_gpio_proslic_on {
			phandle = <0xa3>;

			pins_cmd_dat {
				pinmux = <0xe702 0xe802 0xe902 0xea02>;
			};
		};

		aud_gpio_tdm_off {
			phandle = <0xa4>;

			pins_cmd_dat {
				pinmux = <0xc700 0xc800 0xc900 0xca00 0xcb00 0xcc00 0xcd00>;
			};
		};

		aud_gpio_tdm_on {
			phandle = <0xa5>;

			pins_cmd_dat {
				pinmux = <0xc701 0xc801 0xc901 0xca01 0xcb01 0xcc01 0xcd01>;
			};
		};

		tz_leds_pin {
			phandle = <0xb6>;

			pins_led {
				pinmux = <0x600 0x500 0x800 0xd300 0xd500 0xaf00 0xd200>;
				output-low;
			};
		};

		tz_keys_pin {
			phandle = <0xb7>;

			pins_key {
				pinmux = <0x700 0x1400>;
				bias-pull-up;
				input-enable;
			};
		};

		mdio_default {
			phandle = <0x61>;

			mux {
				pinmux = <0x3d00>;
			};
		};

		eth_smi_mdio_pinctl {
			phandle = <0x62>;

			mux {
				pinmux = <0x3d01>;
			};
		};

		eth_smi_mdc_pinctl {
			phandle = <0x63>;

			mux {
				pinmux = <0x3e01>;
			};
		};

		eth_default {

			txd_pins {
				pinmux = <0x802 0x902 0xa02 0xb02>;
				drive-strength = <0x08>;
			};

			cc_pins {
				pinmux = <0x1202 0x1502 0x1402 0x1302>;
				drive-strength = <0x08>;
			};

			rxd_pins {
				pinmux = <0xe02 0xf02 0x1002 0x1102>;
			};

			mdio_pins {
				pinmux = <0xc02 0xd02>;
				input-enable;
			};
		};

		eth_sleep {

			txd_pins {
				pinmux = <0x800 0x900 0xa00 0xb00>;
			};

			cc_pins {
				pinmux = <0x1200 0x1500 0x1400 0x1300>;
			};

			rxd_pins {
				pinmux = <0xe00 0xf00 0x1000 0x1100>;
			};

			mdio_pins {
				pinmux = <0xc00 0xd00>;
				input-disable;
				bias-disable;
			};
		};

		pcie0-default {
			phandle = <0x71>;

			mux {
				pinmux = <0x4301 0x4401 0x4501>;
				bias-pull-up;
			};
		};

		pcie1-default {
			phandle = <0x74>;

			mux {
				pinmux = <0x4601 0x4701 0x4801>;
				bias-pull-up;
			};
		};

		pcie2-default {
			phandle = <0x77>;

			mux {
				pinmux = <0x4901 0x4a01 0x4b01>;
				bias-pull-up;
			};
		};

		pcie3-default {
			phandle = <0x7a>;

			mux {
				pinmux = <0x4c01 0x4d01 0x4e01>;
				bias-pull-up;
			};
		};

		gps_default {
			phandle = <0x82>;
		};

		gps_l1_lna@0 {
			phandle = <0x83>;

			pins_cmd_dat {
				pinmux = <0x7d00>;
				output-low;
			};
		};

		gps_l1_lna@1 {
			phandle = <0x84>;

			pins_cmd_dat {
				pinmux = <0x7d01>;
			};
		};

		gps_l1_lna@2 {
			phandle = <0x85>;

			pins_cmd_dat {
				pinmux = <0x7d00>;
				output-high;
			};
		};

		gps_l5_lna@0 {
			phandle = <0x86>;

			pins_cmd_dat {
				pinmux = <0x7e00>;
				output-low;
			};
		};

		gps_l5_lna@1 {
			phandle = <0x87>;

			pins_cmd_dat {
				pinmux = <0x7e01>;
			};
		};

		gps_l5_lna@2 {
			phandle = <0x88>;

			pins_cmd_dat {
				pinmux = <0x7e00>;
				output-high;
			};
		};

		c1_high {
			phandle = <0xb2>;

			pins_cmd_dat {
				pinmux = <0x5f00>;
				output-high;
			};
		};

		c2_highz {
			phandle = <0xb4>;

			pins_cmd_dat {
				pinmux = <0x5e00>;
				input-enable;
				bias-disable;
			};
		};

		c1_low {
			phandle = <0xb3>;

			pins_cmd_dat {
				pinmux = <0x5f00>;
				output-low;
			};
		};

		c2_low {
			phandle = <0xb5>;

			pins_cmd_dat {
				pinmux = <0x5e00>;
				output-low;
			};
		};

		sel_high {
			phandle = <0xae>;

			pins_cmd_dat {
				pinmux = <0x5d00>;
				output-high;
			};
		};

		sel_low {
			phandle = <0xaf>;

			pins_cmd_dat {
				pinmux = <0x5d00>;
				output-low;
			};
		};

		sw_enable {
			phandle = <0xb0>;

			pins_cmd_dat {
				pinmux = <0x5c00>;
				output-low;
			};
		};

		sw_disable {
			phandle = <0xb1>;

			pins_cmd_dat {
				pinmux = <0x5c00>;
				output-low;
			};
		};

		kpdgpiodefault {
			phandle = <0x3a>;

			pins_cmd_dat {
				pinmux = <0x7201 0x7301>;
				mediatek,pull-down-adv = <0x65>;
				output-low;
				input-schmitt-enable;
			};
		};

		nandcdefault {
			phandle = <0x5a>;

			pins0 {
				pinmux = <0xd701 0xd801 0xd901 0xda01 0xdb01 0xdc01 0xdd01 0xde01 0xe401 0xe501>;
				drive-strength = <0x04>;
				bias-pull-down;
			};

			pins1 {
				pinmux = <0xdf01 0xe001 0xe101 0xe201 0xe301>;
				drive-strength = <0x04>;
				bias-pull-up;
			};
		};

		pcb_pin_1st_pullup-config {
			phandle = <0x30>;

			pins_cmd_dat {
				pinmux = <0x9700>;
				bias-pull-up;
			};
		};

		pcb_pin_1st_pulldown-config {
			phandle = <0x31>;

			pins_cmd_dat {
				pinmux = <0x9700>;
				bias-pull-down;
			};
		};

		pcb_pin_2nd_pullup-config {
			phandle = <0x32>;

			pins_cmd_dat {
				pinmux = <0xa300>;
				bias-pull-up;
			};
		};

		pcb_pin_2nd_pulldown-config {
			phandle = <0x33>;

			pins_cmd_dat {
				pinmux = <0xa300>;
				bias-pull-down;
			};
		};

		rf_set_pin_1st_pullup-config {
			phandle = <0x34>;

			pins_cmd_dat {
				pinmux = <0x8e00>;
				bias-pull-up;
			};
		};

		rf_set_pin_1st_pulldown-config {
			phandle = <0x35>;

			pins_cmd_dat {
				pinmux = <0x8e00>;
				bias-pull-down;
			};
		};

		rf_set_pin_2nd_pullup-config {
			phandle = <0x36>;

			pins_cmd_dat {
				pinmux = <0x8f00>;
				bias-pull-up;
			};
		};

		rf_set_pin_2nd_pulldown-config {
			phandle = <0x37>;

			pins_cmd_dat {
				pinmux = <0x8f00>;
				bias-pull-down;
			};
		};
	};

	demo_interrupt_pin {
		compatible = "mediatek,demo_interrupt_pin";
		reserved;
		status = "okay";
	};

	fibocom_pcb_version_ctrl_pin {
		compatible = "mediatek,fibocom_pcb_version";
		pcb_gpio_1st_id = <0x2f 0x97 0x00>;
		pcb_gpio_2nd_id = <0x2f 0xa3 0x00>;
		status = "okay";
		pinctrl-names = "pcb_pin_1st_pullup", "pcb_pin_1st_pulldown", "pcb_pin_2nd_pullup", "pcb_pin_2nd_pulldown";
		pinctrl-0 = <0x30>;
		pinctrl-1 = <0x31>;
		pinctrl-2 = <0x32>;
		pinctrl-3 = <0x33>;
	};

	fibocom_rf_set_ctrl_pin {
		compatible = "mediatek,fibocom_rf_set";
		rf_gpio_1st_id = <0x2f 0x8e 0x00>;
		rf_gpio_2nd_id = <0x2f 0x8f 0x00>;
		status = "okay";
		pinctrl-names = "rf_set_pin_1st_pullup", "rf_set_pin_1st_pulldown", "rf_set_pin_2nd_pullup", "rf_set_pin_2nd_pulldown";
		pinctrl-0 = <0x34>;
		pinctrl-1 = <0x35>;
		pinctrl-2 = <0x36>;
		pinctrl-3 = <0x37>;
	};

	sleep@10006000 {
		compatible = "mediatek,sleep", "syscon";
		reg = <0x00 0x10006000 0x00 0x1000>;
		phandle = <0x8a>;
	};

	spmtwam@10006000 {
		compatible = "mediatek,spmtwam";
		reg = <0x00 0x10006000 0x00 0x1000>;
		interrupts = <0x00 0xde 0x04>;
		spm_twam_con = <0xa0>;
		spm_twam_window_len = <0xa4>;
		spm_twam_idle_sel = <0xa8>;
		spm_irq_mask = <0xb4>;
		spm_irq_sta = <0x128>;
		spm_twam_last_sta0 = <0x1d0>;
		spm_twam_last_sta1 = <0x1d4>;
		spm_twam_last_sta2 = <0x1d8>;
		spm_twam_last_sta3 = <0x1dc>;
	};

	srclken@10006500 {
		compatible = "mediatek,srclken";
		reg = <0x00 0x10006500 0x00 0x1000 0x00 0x105c4000 0x00 0x1000 0x00 0x10005000 0x00 0x1000>;
		reg-names = "srclken", "scpdvfs", "gpio";
		srclken-mode = "bringup";
		srclken-rst-cfg = <0x00>;
		srclken-central-cfg = <0x04 0x08 0x1c>;
		srclken-cmd-cfg = <0x0c>;
		srclken-pmic-cfg = <0x10 0x14>;
		srclken-dcxo-fpm-cfg = <0x18>;
		srclken-subsys-cfg = <0x20>;
		srclken-misc-cfg = <0xb4>;
		srclken-spm-cfg = <0xb8>;
		srclken-subsys-if-cfg = <0xbc>;
		srclken-fsm-sta = <0x60>;
		srclken-cmd-sta = <0x64 0x68>;
		srclken-spi-sta = <0x6c>;
		srclken-pipo-sta = <0x70>;
		srclken-subsys-sta = <0x80>;
		srclken-dbg-trace-sta = <0xc0 0xc4>;
		srclken-scp-enable = "n";
		scp-vreq-cfg = <0x54>;
		scp-rc-vreq-bit = <0x1b 0x1c>;
		srclken-gpio-enable = "n";
		gpio-dir-cfg = <0x00>;
		gpio-dout-cfg = <0x100>;
		gpio-pull-bit = <0x06>;
	};

	watchdog@10007000 {
		compatible = "mediatek,mt6880-wdt", "mediatek,mt6589-wdt", "syscon", "simple-mfd";
		reg = <0x00 0x10007000 0x00 0x1000>;

		reboot-mode {
			compatible = "syscon-reboot-mode";
			offset = <0x24>;
			mask = <0x0f>;
			mode-charger = <0x01>;
			mode-recovery = <0x02>;
			mode-bootloader = <0x03>;
			mode-dm-verity-dev-corrupt = <0x04>;
			mode-kpoc = <0x05>;
			mode-ddr-reserve = <0x06>;
			mode-meta = <0x07>;
			mode-download = <0x09>;
			mode-pcie = <0x0a>;
		};
	};

	apxgpt@10008000 {
		compatible = "mediatek,apxgpt";
		reg = <0x00 0x10008000 0x00 0x1000>;
		interrupts = <0x00 0x113 0x04>;
	};

	sej@1000a000 {
		compatible = "mediatek,sej";
		reg = <0x00 0x1000a000 0x00 0x1000>;
		interrupts = <0x00 0x126 0x04>;
	};

	apmixed@1000c000 {
		compatible = "mediatek,apmixed";
		reg = <0x00 0x1000c000 0x00 0xe00>;
		phandle = <0x38>;
	};

	fhctl@1000ce00 {
		compatible = "mediatek,mt6890-fhctl";
		reg = <0x00 0x1000ce00 0x00 0x200>;
		mediatek,apmixed = <0x38>;

		armpll_ll {
			mediatek,fh-id = <0x00>;
			mediatek,fh-pll-id = <0x00>;
			mediatek,fh-cpu-pll;
		};

		mainpll {
			mediatek,fh-id = <0x01>;
			mediatek,fh-pll-id = <0x03>;
		};

		mpll {
			mediatek,fh-id = <0x02>;
			mediatek,fh-pll-id = <0x02>;
		};

		msdcpll {
			mediatek,fh-id = <0x04>;
			mediatek,fh-pll-id = <0x05>;
		};

		mfgpll {
			mediatek,fh-id = <0x05>;
			mediatek,fh-pll-id = <0x07>;
		};

		mmpll {
			mediatek,fh-id = <0x06>;
			mediatek,fh-pll-id = <0x06>;
		};
	};

	pwrap@1000d000 {
		compatible = "mediatek,pwrap";
		reg = <0x00 0x1000d000 0x00 0x1000>;
	};

	kp@10010000 {
		compatible = "mediatek,kp";
		reg = <0x00 0x10010000 0x00 0x1000>;
		interrupts = <0x00 0x4a 0x01>;
		clocks = <0x39>;
		clock-names = "kpd";
		mediatek,key-debounce-ms = <0x400>;
		mediatek,hw-map-num = <0x48>;
		mediatek,hw-init-map = <0x00 0x00 0x72 0x00 0x00 0x00 0x00 0x00 0x00 0x00 0x00 0x00 0x00 0x00 0x00 0x73 0x00 0x00 0x00 0x00 0x00 0x00 0x00 0x00 0x00 0x00 0x00 0x00 0x70 0x00 0x00 0x00 0x00 0x00 0x00 0x00 0x00 0x00 0x00 0x00 0x00 0x00 0x00 0x00 0x00 0x00 0x00 0x00 0x00 0x00 0x00 0x00 0x00 0x00 0x00 0x00 0x00 0x00 0x00 0x00 0x00 0x00 0x00 0x00 0x00 0x00 0x00 0x00 0x00 0x00 0x00 0x00>;
		status = "okay";
		pinctrl-names = "default";
		pinctrl-0 = <0x3a>;
		mediatek,kpd-key-debounce = <0x400>;
		mediatek,kpd-sw-pwrkey = <0x6b>;
		mediatek,kpd-hw-pwrkey = <0x08>;
		mediatek,kpd-use-extend-type = <0x00>;
		mediatek,kpd-hw-map-num = <0x48>;
		mediatek,kpd-hw-init-map = <0x00 0x00 0x00 0x00 0x00 0x00 0x00 0x00 0x00 0x00 0x00 0x00 0x00 0x00 0x00 0x00 0x00 0x00 0x00 0x00 0x00 0x00 0x00 0x00 0x00 0x00 0x00 0x00 0x00 0x00 0x00 0x00 0x00 0x00 0x00 0x00 0x00 0x00 0x00 0x00 0x00 0x00 0x00 0x00 0x00 0x00 0x00 0x00 0x00 0x00 0x00 0x00 0x00 0x00 0x00 0x00 0x00 0x00 0x00 0x00 0x00 0x00 0x00 0x00 0x00 0x00 0x00 0x00 0x00 0x00 0x00 0x00>;
		mediatek,kpd-pwrkey-eint-gpio = <0x00>;
		mediatek,kpd-pwkey-gpio-din = <0x00>;
		phandle = <0x1f>;
	};

	topmisc@10011000 {
		compatible = "mediatek,topmisc";
		reg = <0x00 0x10011000 0x00 0x1000>;
	};

	dvfsrc@10012000 {
		compatible = "mediatek,mt6890-dvfsrc";
		reg = <0x00 0x10012000 0x00 0x1000 0x00 0x10006000 0x00 0x1000>;
		reg-names = "dvfsrc", "spm";
		#interconnect-cells = <0x01>;
		phandle = <0x3d>;

		dvfsrc-vcore {
			regulator-name = "dvfsrc-vcore";
			regulator-min-microvolt = <0x86470>;
			regulator-max-microvolt = <0xb71b0>;
			regulator-always-on;
			phandle = <0x3c>;
		};

		opp6 {
			opp-peak-KBps = <0x00>;
			phandle = <0x44>;
		};

		opp5 {
			opp-peak-KBps = <0x2625a0>;
			phandle = <0x43>;
		};

		opp4 {
			opp-peak-KBps = <0x39fbc0>;
			phandle = <0x42>;
		};

		opp3 {
			opp-peak-KBps = <0x4dd1e0>;
			phandle = <0x41>;
		};

		opp2 {
			opp-peak-KBps = <0x5a06e0>;
			phandle = <0x40>;
		};

		opp1 {
			opp-peak-KBps = <0x73f780>;
			phandle = <0x3f>;
		};

		opp0 {
			opp-peak-KBps = <0x9ba3c0>;
			phandle = <0x3e>;
		};

		dvfsrc-helper {
			compatible = "mediatek,dvfsrc-helper";
			vcore-supply = <0x3b>;
			rc-vcore-supply = <0x3c>;
			interconnects = <0x3d 0x13 0x3d 0x00>;
			interconnect-names = "icc-perf-bw";
			required-opps = <0x3e 0x3f 0x40 0x41 0x42 0x43 0x44>;
		};

		dvfsrc-met {
			compatible = "mediatek,dvfsrc-met";
		};
	};

	mbist_ao@10013000 {
		compatible = "mediatek,mbist_ao";
		reg = <0x00 0x10013000 0x00 0x1000>;
	};

	dpmaif_ao@10014000 {
		compatible = "mediatek,dpmaif_ao";
		reg = <0x00 0x10014000 0x00 0x1000>;
	};

	aes_top0@10016000 {
		compatible = "mediatek,aes_top0";
		reg = <0x00 0x10016000 0x00 0x1000>;
	};

	timer {
		compatible = "arm,armv8-timer";
		interrupt-parent = <0x01>;
		interrupts = <0x01 0x0d 0x04 0x01 0x0e 0x04 0x01 0x0b 0x04 0x01 0x0a 0x04>;
		clock-frequency = <0xc65d40>;
	};

	sys_timer@10017000 {
		compatible = "mediatek,sys_timer", "mediatek,mt6765-timer";
		reg = <0x00 0x10017000 0x00 0x1000>;
		interrupts = <0x00 0xe9 0x04>;
		clocks = <0x45>;
	};

	modem_temp_share@10018000 {
		compatible = "mediatek,modem_temp_share";
		reg = <0x00 0x10018000 0x00 0x1000>;
	};

	security_ao@1001a000 {
		compatible = "mediatek,security_ao";
		reg = <0x00 0x1001a000 0x00 0x1000>;
	};

	topckgen_ao@1001b000 {
		compatible = "mediatek,topckgen_ao";
		reg = <0x00 0x1001b000 0x00 0x1000>;
	};

	devapc_ao_mm@1001c000 {
		compatible = "mediatek,devapc_ao_mm";
		reg = <0x00 0x1001c000 0x00 0x1000>;
	};

	sleep_sram@1001e000 {
		compatible = "mediatek,sleep_sram";
		reg = <0x00 0x1001e000 0x00 0x4000>;
	};

	bcrm_ao_peri@10022000 {
		compatible = "mediatek,bcrm_ao_peri";
		reg = <0x00 0x10022000 0x00 0x1000>;
	};

	debug_ao_peri@10023000 {
		compatible = "mediatek,debug_ao_peri";
		reg = <0x00 0x10023000 0x00 0x1000>;
	};

	mhccif@10024000 {
		compatible = "mediatek,mt6880-mhccif";
		#interrupt-cells = <0x03>;
		interrupt-controller;
		reg = <0x00 0x10024000 0x00 0x1000 0x00 0x10025000 0x00 0x1000>;
		reg-names = "mhccif_rc", "mhccif_ep";
		interrupts = <0x00 0x13d 0x04>;
		status = "disabled";
	};

	spmi@10026000 {
		compatible = "mediatek,mt6880-pmif-m", "syscon";
		reg = <0x00 0x10026000 0x00 0x8f0 0x00 0x10029000 0x00 0x110>;
		reg-names = "pmif", "spmimst";
		interrupts-extended = <0x01 0x00 0xdc 0x04 0x2f 0xd8 0x04>;
		interrupt-names = "pmif_irq", "rcs_irq";
		interrupt-controller;
		#interrupt-cells = <0x01>;
		irq_event_en = <0x00 0x180000 0x00 0x00 0x00>;
		clocks = <0x0e 0x02 0x0e 0x01 0x0f 0xb4 0x0f 0x60 0x0f 0x54 0x0f 0xbf 0x0f 0x54 0x0f 0x60>;
		clock-names = "pmif_sys_ck", "pmif_tmr_ck", "pmif_clk_mux", "pmif_clk_osc_d10", "pmif_clk26m", "spmimst_clk_mux", "spmimst_clk26m", "spmimst_clk_osc_d10";
		swinf_ch_start = <0x06>;
		ap_swinf_no = <0x02>;
		grpid = <0x0b>;
		#address-cells = <0x02>;
		#size-cells = <0x00>;
		phandle = <0x89>;

		mt6315@5 {
			compatible = "mediatek,mt6315", "mtk,spmi-pmic";
			reg = <0x05 0x00 0x0b 0x01>;

			extbuck_debug {
				compatible = "mediatek,extbuck-debug";
			};

			mt6315_5_regulator {
				compatible = "mediatek,mt6315_5-regulator";

				5_vbuck1 {
					regulator-compatible = "vbuck1";
					regulator-name = "5_vbuck1";
					regulator-min-microvolt = <0x493e0>;
					regulator-max-microvolt = <0x123716>;
					regulator-allowed-modes = <0x00 0x01 0x02 0x04>;
					regulator-always-on;
				};

				5_vbuck3 {
					regulator-compatible = "vbuck3";
					regulator-name = "5_vbuck3";
					regulator-min-microvolt = <0x493e0>;
					regulator-max-microvolt = <0x123716>;
					regulator-allowed-modes = <0x00 0x01 0x02 0x04>;
					regulator-always-on;
				};
			};
		};

		md1_sim1_hot_plug_eint {
			compatible = "mediatek,md1_sim1_hot_plug_eint-eint";
			interrupts = <0x00 0x08>;
			debounce = <0x00 0x1e8480>;
			dedicated = <0x00 0x00>;
			src_pin = <0x00 0x01>;
			sockettype = <0x00 0x00>;
			status = "okay";
		};

		md1_sim2_hot_plug_eint {
			compatible = "mediatek,md1_sim2_hot_plug_eint-eint";
			interrupts = <0x01 0x08>;
			debounce = <0x01 0x1e8480>;
			dedicated = <0x01 0x00>;
			src_pin = <0x01 0x02>;
			sockettype = <0x01 0x00>;
			status = "okay";
		};

		mt6330 {
			compatible = "mediatek,mt6330";
			reg = <0x04 0x00 0x01 0x01>;
			interrupts = <0x04>;
			#address-cells = <0x01>;
			#size-cells = <0x00>;
			interrupt-controller;
			#interrupt-cells = <0x02>;
			phandle = <0x21>;

			mt-pmic {
				compatible = "mediatek,mt63xx-debug";
			};

			pmic_auxadc {
				compatible = "mediatek,pmic-auxadc", "mediatek,mt6330-auxadc";
				#io-channel-cells = <0x01>;
				phandle = <0x22>;

				batadc {
					channel = <0x00>;
					resistance-ratio = <0x03 0x01>;
					avg-num = <0x80>;
				};

				chip_temp {
					channel = <0x05>;
				};

				vcore_temp {
					channel = <0x06>;
				};

				vproc_temp {
					channel = <0x07>;
				};

				vgpu_temp {
					channel = <0x08>;
				};

				tsx_temp {
					channel = <0x0b>;
					avg-num = <0x80>;
				};

				dcxo_temp {
					channel = <0x0d>;
					avg-num = <0x10>;
				};

				dcxo_ext0 {
					channel = <0x11>;
					avg-num = <0x80>;
				};

				dcxo_ext1 {
					channel = <0x12>;
					avg-num = <0x80>;
				};
			};

			pmic_efuse {
				compatible = "mediatek,mt6330-efuse";
				#address-cells = <0x01>;
				#size-cells = <0x01>;
				phandle = <0x81>;

				t_e_data1@6c {
					reg = <0x6c 0x0c>;
					phandle = <0x23>;
				};
			};

			mt6330regulator {
				compatible = "mediatek,mt6330-regulator";

				buck_vs1 {
					regulator-name = "vs1";
					regulator-min-microvolt = "", "\f5";
					regulator-max-microvolt = <0x2191c0>;
					regulator-enable-ramp-delay = <0xc8>;
					regulator-always-on;
				};

				buck_vmd12 {
					regulator-name = "vmd12";
					regulator-min-microvolt = <0x61a80>;
					regulator-max-microvolt = <0x123428>;
					regulator-enable-ramp-delay = <0xc8>;
				};

				buck_vrfdig {
					regulator-name = "vrfdig";
					regulator-min-microvolt = <0x61a80>;
					regulator-max-microvolt = <0x123428>;
					regulator-enable-ramp-delay = <0xc8>;
				};

				buck_vcore {
					regulator-name = "vcore";
					regulator-min-microvolt = <0x61a80>;
					regulator-max-microvolt = <0x123428>;
					regulator-enable-ramp-delay = <0xc8>;
					regulator-always-on;
					regulator-allowed-modes = <0x00 0x01 0x02>;
					phandle = <0x3b>;
				};

				buck_vs2 {
					regulator-name = "vs2";
					regulator-min-microvolt = "", "\f5";
					regulator-max-microvolt = <0x186a00>;
					regulator-enable-ramp-delay = <0xc8>;
					regulator-always-on;
				};

				buck_vmd11 {
					regulator-name = "vmd11";
					regulator-min-microvolt = <0x61a80>;
					regulator-max-microvolt = <0x123428>;
					regulator-enable-ramp-delay = <0xc8>;
				};

				buck_vsram_md {
					regulator-name = "vsram_md";
					regulator-min-microvolt = <0x61a80>;
					regulator-max-microvolt = <0x123428>;
					regulator-enable-ramp-delay = <0xc8>;
				};

				buck_vs3 {
					regulator-name = "vs3";
					regulator-min-microvolt = <0x61a80>;
					regulator-max-microvolt = <0x123428>;
					regulator-enable-ramp-delay = <0xc8>;
					regulator-always-on;
				};

				ldo_vrfck {
					regulator-name = "vrfck";
					regulator-min-microvolt = <0x12ebc0>;
					regulator-max-microvolt = <0x186a00>;
					regulator-enable-ramp-delay = <0xf0>;
				};

				ldo_vsim1 {
					regulator-name = "vsim1";
					regulator-min-microvolt = <0x19f0a0>;
					regulator-max-microvolt = <0x2dc6c0>;
					regulator-enable-ramp-delay = <0x2d0>;
				};

				ldo_vio18_2 {
					regulator-name = "vio18_2";
					regulator-min-microvolt = <0x186a00>;
					regulator-max-microvolt = <0x1b7740>;
					regulator-enable-ramp-delay = <0x2d0>;
					regulator-always-on;
				};

				ldo_vusb {
					regulator-name = "vusb";
					regulator-min-microvolt = <0x2dc6c0>;
					regulator-max-microvolt = <0x2dc6c0>;
					regulator-enable-ramp-delay = <0x2d0>;
					phandle = <0x53>;
				};

				ldo_vmdd2 {
					regulator-name = "vmdd2";
					regulator-min-microvolt = <0xf4240>;
					regulator-max-microvolt = <0x118c30>;
					regulator-enable-ramp-delay = <0x2d0>;
				};

				ldo_vcn18 {
					regulator-name = "vcn18";
					regulator-min-microvolt = <0x1b7740>;
					regulator-max-microvolt = <0x1b7740>;
					regulator-enable-ramp-delay = <0xf0>;
				};

				ldo_vaux18 {
					regulator-name = "vaux18";
					regulator-min-microvolt = <0x1b7740>;
					regulator-max-microvolt = <0x1b7740>;
					regulator-enable-ramp-delay = <0xf0>;
				};

				ldo_vsram_core {
					regulator-name = "vsram_core";
					regulator-min-microvolt = <0x7a120>;
					regulator-max-microvolt = <0x13bdb6>;
					regulator-enable-ramp-delay = <0xd2>;
				};

				ldo_vrf13 {
					regulator-name = "vrf13";
					regulator-min-microvolt = <0x10c8e0>;
					regulator-max-microvolt = <0x13d620>;
					regulator-enable-ramp-delay = <0xd2>;
				};

				ldo_vsram_proc {
					regulator-name = "vsram_proc";
					regulator-min-microvolt = <0x7a120>;
					regulator-max-microvolt = <0x13bdb6>;
					regulator-enable-ramp-delay = <0xd2>;
				};

				ldo_vxo22 {
					regulator-name = "vxo22";
					regulator-min-microvolt = <0x1b7740>;
					regulator-max-microvolt = <0x2191c0>;
					regulator-enable-ramp-delay = <0xf0>;
					regulator-always-on;
				};

				ldo_vefuse {
					regulator-name = "vefuse";
					regulator-min-microvolt = <0x19f0a0>;
					regulator-max-microvolt = <0x1e8480>;
					regulator-enable-ramp-delay = <0xf0>;
				};

				ldo_vio18_1 {
					regulator-name = "vio18_1";
					regulator-min-microvolt = <0x186a00>;
					regulator-max-microvolt = <0x1b7740>;
					regulator-enable-ramp-delay = <0xf0>;
					regulator-always-on;
				};

				ldo_va12_2 {
					regulator-name = "va12_2";
					regulator-min-microvolt = <0x10c8e0>;
					regulator-max-microvolt = <0x13d620>;
					regulator-enable-ramp-delay = <0x2d0>;
				};

				ldo_vemc {
					regulator-name = "vemc";
					regulator-min-microvolt = <0x2ab980>;
					regulator-max-microvolt = <0x325aa0>;
					regulator-enable-ramp-delay = <0xf0>;
					phandle = <0x69>;
				};

				ldo_vsram_rfdig {
					regulator-name = "vsram_rfdig";
					regulator-min-microvolt = <0x7a120>;
					regulator-max-microvolt = <0x13bdb6>;
					regulator-enable-ramp-delay = <0xd2>;
				};

				ldo_vrf09 {
					regulator-name = "vrf09";
					regulator-min-microvolt = <0xdbba0>;
					regulator-max-microvolt = <0xdbba0>;
					regulator-enable-ramp-delay = <0xd2>;
				};

				ldo_vmddr {
					regulator-name = "vmddr";
					regulator-min-microvolt = <0xaae60>;
					regulator-max-microvolt = "", "\f5";
					regulator-enable-ramp-delay = <0x2d0>;
				};

				ldo_vrf18 {
					regulator-name = "vrf18";
					regulator-min-microvolt = <0x19f0a0>;
					regulator-max-microvolt = <0x1b7740>;
					regulator-enable-ramp-delay = <0xd2>;
				};

				ldo_vmddq {
					regulator-name = "vmddq";
					regulator-min-microvolt = <0x86470>;
					regulator-max-microvolt = <0x9eb10>;
					regulator-enable-ramp-delay = <0x2d0>;
				};

				ldo_vmc {
					regulator-name = "vmc";
					regulator-min-microvolt = <0x1b7740>;
					regulator-max-microvolt = <0x325aa0>;
					regulator-enable-ramp-delay = <0x2d0>;
					phandle = <0x6c>;
				};

				ldo_vbbck {
					regulator-name = "vbbck";
					regulator-min-microvolt = <0x124f80>;
					regulator-max-microvolt = <0x124f80>;
					regulator-enable-ramp-delay = <0xf0>;
				};

				ldo_va12_1 {
					regulator-name = "va12_1";
					regulator-min-microvolt = <0x124f80>;
					regulator-max-microvolt = <0x124f80>;
					regulator-enable-ramp-delay = <0xd2>;
				};

				ldo_vsim2 {
					regulator-name = "vsim2";
					regulator-min-microvolt = <0x19f0a0>;
					regulator-max-microvolt = <0x2dc6c0>;
					regulator-enable-ramp-delay = <0x2d0>;
				};
			};

			mt6330keys {
				compatible = "mediatek,mt6330-keys";
				mediatek,long-press-mode = <0x00>;
				power-off-time-sec = <0x00>;

				power {
					linux,keycodes = <0x74>;
					wakeup-source;
				};
			};

			clock_buffer_ctrl {
				compatible = "mediatek,clock_buffer";
				clkbuf-bring-up = "n";
				n-clkbuf-pmic-dependent = <0x08>;
				clkbuf-pmic-dependent = "pmic-bblpm-hw", "pmic-bblpm-sel", "pmic-ldo-vrfck", "pmic-vrfck-hv-en", "pmic-ldo-vbbck", "pmic-auxout-sel", "pmic-auxout-xo", "pmic-auxout-bblpm-en";
				pmic-dcxo-cw00 = <0x788 0x00 0x78b 0x00>;
				pmic-dcxo-cw08 = <0x79c 0x00 0x79d 0x00>;
				pmic-dcxo-cw09 = <0x79e 0x00 0x7a1 0x00>;
				pmic-dcxo-cw12 = <0x7a8 0x00 0x7a9 0x00>;
				pmic-dcxo-cw13 = <0x7aa 0x00 0x7ab 0x00>;
				pmic-dcxo-cw19 = <0x7b6 0x00 0x7b7 0x00 0x7b8 0x00>;
				pmic-xo-mode = <0x788 0x00 0x788 0x03 0x788 0x06 0x78b 0x01 0xffff 0xffff 0x7a1 0x01 0x7a1 0x04>;
				pmic-xo-en = <0x788 0x02 0x788 0x05 0x78b 0x00 0x78b 0x03 0xffff 0xffff 0x7a1 0x03 0x7a1 0x06>;
				pmic-bblpm-sw = <0x78b 0x04>;
				pmic-srclkeni3 = <0x412 0x00>;
				n-pmic-bblpm-hw = <0x07>;
				pmic-bblpm-hw = <0x7a8 0x01 0x7a8 0x02 0x7a8 0x03 0x7a8 0x04 0xffff 0xffff 0x7a8 0x05 0x7a8 0x06>;
				n-pmic-bblpm-sel = <0x01>;
				pmic-bblpm-sel = <0x7a8 0x00>;
				n-pmic-ldo-vrfck = <0x02>;
				pmic-ldo-vrfck = <0x1bb7 0x00 0x1bbe 0x06>;
				n-pmic-vrfck-hv-en = <0x01>;
				pmic-vrfck-hv-en = <0x1f90 0x04>;
				n-pmic-ldo-vbbck = <0x02>;
				pmic-ldo-vbbck = <0x1ba7 0x00 0x1bae 0x06>;
				n-pmic-auxout-sel = <0x03>;
				pmic-auxout-sel = <0x7b0 0x00 0x7b0 0x06 0x7b0 0x1b>;
				n-pmic-auxout-xo = <0x07>;
				pmic-auxout-xo = <0x7b3 0x05 0x7b3 0x03 0x7b3 0x01 0x7b2 0x07 0xffff 0xffff 0x7b2 0x05 0x7b2 0x03>;
				n-pmic-auxout-bblpm-en = <0x01>;
				pmic-auxout-bblpm-en = <0x7b2 0x00>;
			};

			mt6330rtc {
				compatible = "mediatek,mt6330-rtc";

				fg_init {
					reg = <0x00 0x01>;
					bits = <0x00 0x08>;
				};

				fg_soc {
					reg = <0x01 0x01>;
					bits = <0x00 0x08>;
				};

				ext_32k {
					reg = <0x02 0x01>;
					bits = <0x06 0x01>;
				};
			};

			mt6330-led {
				compatible = "mediatek,mt6330_leds";

				Isink1 {
					reg = <0x01>;
					label = "led9515:green:pmic";
					linux,default-trigger = "none";
					default-state = "off";
				};
			};
		};
	};

	spmi_p@10027000 {
		compatible = "mediatek,mt6880-pmif-p";
		reg = <0x00 0x10027000 0x00 0x8f0 0x00 0x10028000 0x00 0x110>;
		reg-names = "pmif", "spmimst";
		interrupts = <0x00 0xdd 0x04>;
		interrupt-names = "pmif_irq";
		irq_event_en = <0x00 0x00 0x00 0x00 0x00>;
		clocks = <0x0e 0x02 0x0e 0x01 0x0f 0xb4 0x0f 0x60 0x0f 0x54 0x0f 0xc0 0x0f 0x54 0x0f 0x15>;
		clock-names = "pmif_sys_ck", "pmif_tmr_ck", "pmif_clk_mux", "pmif_clk_osc_d10", "pmif_clk26m", "spmimst_clk_mux", "spmimst_clk26m", "spmimst_clk_mainpll_d7_d8";
		swinf_ch_start = <0x06>;
		ap_swinf_no = <0x02>;
		grpid = <0x0b>;
		#address-cells = <0x02>;
		#size-cells = <0x00>;

		mt6330_p_regulator {
			compatible = "mediatek,mt6330_p-regulator";
			reg = <0x04 0x00 0x01 0x01>;
			#address-cells = <0x01>;
			#size-cells = <0x00>;

			buck_vrfdig {
				regulator-name = "vrfdig_p";
				regulator-min-microvolt = <0x61a80>;
				regulator-max-microvolt = <0x123428>;
				regulator-enable-ramp-delay = <0xc8>;
				phandle = <0x4a>;
			};

			buck_vmd11 {
				regulator-name = "vmd11_p";
				regulator-min-microvolt = <0x61a80>;
				regulator-max-microvolt = <0x123428>;
				regulator-enable-ramp-delay = <0xc8>;
				phandle = <0x48>;
			};

			buck_vsram_md {
				regulator-name = "vsram_md_p";
				regulator-min-microvolt = <0x61a80>;
				regulator-max-microvolt = <0x123428>;
				regulator-enable-ramp-delay = <0xc8>;
				phandle = <0x49>;
			};
		};
	};

	atf_logger {
		compatible = "mediatek,atf_logger";
	};

	bcrm_peri_ao@1002a000 {
		compatible = "mediatek,bcrm_peri_ao";
		reg = <0x00 0x1002a000 0x00 0x1000>;
	};

	debug_ao_peri@1002b000 {
		compatible = "mediatek,debug_ao_peri";
		reg = <0x00 0x1002b000 0x00 0x1000>;
	};

	bcrm_peri_ao2@1002d000 {
		compatible = "mediatek,bcrm_peri_ao2";
		reg = <0x00 0x1002d000 0x00 0x1000>;
	};

	debug_ao_peri2@1002e000 {
		compatible = "mediatek,debug_ao_peri2";
		reg = <0x00 0x1002e000 0x00 0x1000>;
	};

	devapc_ao_infra@10030000 {
		compatible = "mediatek,devapc_ao_infra";
		reg = <0x00 0x10030000 0x00 0x4000>;
	};

	devapc_ao_peri@10034000 {
		compatible = "mediatek,devapc_ao_peri";
		reg = <0x00 0x10034000 0x00 0x4000>;
	};

	devapc_ao_peri2@10038000 {
		compatible = "mediatek,devapc_ao_peri2";
		reg = <0x00 0x10038000 0x00 0x4000>;
	};

	devapc_ao_peri_par@1003c000 {
		compatible = "mediatek,devapc_ao_peri_par";
		reg = <0x00 0x1003c000 0x00 0x4000>;
	};

	debug_ao_peri_par@10040000 {
		compatible = "mediatek,debug_ao_peri_par";
		reg = <0x00 0x10040000 0x00 0x1000>;
	};

	bcrm_peri_par_ao@10041000 {
		compatible = "mediatek,bcrm_peri_par_ao";
		reg = <0x00 0x10041000 0x00 0x1000>;
	};

	debug_ao_fmem@10042000 {
		compatible = "mediatek,debug_ao_fmem";
		reg = <0x00 0x10042000 0x00 0x1000>;
	};

	bcrm_fmem_ao@10043000 {
		compatible = "mediatek,bcrm_fmem_ao";
		reg = <0x00 0x10043000 0x00 0x1000>;
	};

	devapc_ao_fmem@10044000 {
		compatible = "mediatek,devapc_ao_fmem";
		reg = <0x00 0x10044000 0x00 0x4000>;
	};

	pwm@10048000 {
		compatible = "mediatek,mt68xx-pwm";
		reg = <0x00 0x10048000 0x00 0x1000>;
		#pwm-cells = <0x02>;
		interrupts = <0x00 0x112 0x04>;
		clocks = <0x0f 0xbe 0x0e 0x16 0x0e 0x11 0x0e 0x12 0x0e 0x13 0x0e 0x14 0x0e 0x15 0x0e 0x41 0x0e 0x42>;
		clock-names = "top", "main", "pwm1", "pwm2", "pwm3", "pwm4", "pwm5", "pwm6", "pwm7";
	};

	sgmii0@10060000 {
		compatible = "mediatek,sgmii0";
		reg = <0x00 0x10060000 0x00 0x8000>;
		interrupts = <0x00 0x16f 0x04>;
	};

	sgmii1@10070000 {
		compatible = "mediatek,sgmii1";
		reg = <0x00 0x10070000 0x00 0x8000>;
		interrupts = <0x00 0x170 0x04>;
	};

	sys_cirq@10204000 {
		compatible = "mediatek,sys_cirq";
		reg = <0x00 0x10204000 0x00 0x1000>;
		interrupts = <0x00 0x1f5 0x04>;
	};

	devapc@10207000 {
		compatible = "mediatek,mt6880-devapc";
		reg = <0x00 0x10207000 0x00 0x1000 0x00 0x10274000 0x00 0x1000 0x00 0x10275000 0x00 0x1000 0x00 0x11020000 0x00 0x1000 0x00 0x10030000 0x00 0x1000 0x00 0x1020e000 0x00 0x1000 0x00 0x10033000 0x00 0x1000>;
		interrupts = <0x00 0xbb 0x04>;
		clocks = <0x0e 0x2b>;
		clock-names = "devapc-infra-clock";
	};

	hwrng {
		compatible = "mediatek,mt67xx-rng";
	};

	bus_dbg@10208000 {
		compatible = "mediatek,bus_dbg-v2";
		reg = <0x00 0x10208000 0x00 0x1000 0x00 0x10001000 0x00 0x1000>;
		mediatek,bus_dbg_con_offset = <0x2fc>;
		interrupt = <0x00 0xc9 0x04>;
	};

	ap_ccif0@10209000 {
		compatible = "mediatek,ap_ccif0";
		reg = <0x00 0x10209000 0x00 0x1000>;
		interrupts = <0x00 0x102 0x04>;
	};

	md_ccif0@1020a000 {
		compatible = "mediatek,md_ccif0";
		reg = <0x00 0x1020a000 0x00 0x1000>;
	};

	ap_ccif1@1020b000 {
		compatible = "mediatek,ap_ccif1";
		reg = <0x00 0x1020b000 0x00 0x1000>;
		interrupts = <0x00 0x104 0x04>;
	};

	md_ccif1@1020c000 {
		compatible = "mediatek,md_ccif1";
		reg = <0x00 0x1020c000 0x00 0x1000>;
	};

	infra_mbist@1020d000 {
		compatible = "mediatek,infra_mbist";
		reg = <0x00 0x1020d000 0x00 0x1000>;
	};

	infracfg@1020e000 {
		compatible = "mediatek,infracfg";
		reg = <0x00 0x1020e000 0x00 0x1000>;
	};

	trng@1020f000 {
		compatible = "mediatek,trng";
		reg = <0x00 0x1020f000 0x00 0x1000>;
		interrupts = <0x00 0x10f 0x04>;
	};

	dxcc_sec@10210000 {
		compatible = "mediatek,dxcc_sec";
		reg = <0x00 0x10210000 0x00 0x1000>;
	};

	cqdma-controller@10212000 {
		compatible = "mediatek,mt6890-cqdma";
		reg = <0x00 0x10212000 0x00 0x80 0x00 0x10212100 0x00 0x80 0x00 0x10212200 0x00 0x80 0x00 0x10212300 0x00 0x80>;
		interrupts = <0x00 0x9a 0x04 0x00 0x9b 0x04 0x00 0x9c 0x04 0x00 0x9d 0x04>;
		clocks = <0x0e 0x48>;
		clock-names = "cqdma";
		dma-channel-mask = <0x3f>;
		dma-channels = <0x04>;
		dma-requests = <0x0a>;
		#dma-cells = <0x01>;
	};

	md2md_md2_ccif0@10213000 {
		compatible = "mediatek,md2md_md2_ccif0";
		reg = <0x00 0x10213000 0x00 0x1000>;
	};

	sramrom@10214000 {
		compatible = "mediatek,sramrom";
		reg = <0x00 0x10214000 0x00 0x1000>;
	};

	bcrm_infra@10215000 {
		compatible = "mediatek,bcrm_infra";
		reg = <0x00 0x10215000 0x00 0x1000>;
	};

	dbg_tracker2@10218000 {
		compatible = "mediatek,dbg_tracker2";
		reg = <0x00 0x10218000 0x00 0x1000>;
	};

	emicen@10219000 {
		compatible = "mediatek,mt6880-emicen", "mediatek,common-emicen";
		reg = <0x00 0x10219000 0x00 0x1000>;
		mediatek,emi-reg = <0x46>;
		phandle = <0x47>;
	};

	infra_device_mpu@1021a000 {
		compatible = "mediatek,infra_device_mpu";
		reg = <0x00 0x1021a000 0x00 0x1000>;
	};

	infra_device_mpu@1021b000 {
		compatible = "mediatek,infra_device_mpu";
		reg = <0x00 0x1021b000 0x00 0x1000>;
	};

	infracfg_mem@1021c000 {
		compatible = "mediatek,infracfg_mem";
		reg = <0x00 0x1021c000 0x00 0x1000>;
	};

	emimpu@10226000 {
		compatible = "mediatek,mt6880-emimpu", "mediatek,common-emimpu";
		reg = <0x00 0x10226000 0x00 0x1000>;
		mediatek,emi-reg = <0x47>;
		interrupts = <0x00 0xbd 0x04>;
		region_cnt = <0x20>;
		domain_cnt = <0x10>;
		addr_align = <0x10>;
		ap_region = <0x1f>;
		ap_apc = <0x00 0x05 0x05 0x05 0x00 0x00 0x06 0x05 0x00 0x00 0x05 0x05 0x05 0x05 0x05 0x05>;
		dump = <0x1f0 0x1f8 0x1fc>;
		clear = <0x160 0xffffffff 0x10 0x200 0x03 0x10 0x1f0 0x80000000 0x01>;
		clear_md = <0x1fc 0x80000000 0x01>;
		ctrl_intf = <0x01>;
		slverr = <0x00>;
	};

	cldma_sys_ap {
		compatible = "mediatek,cldma_sys_ap";
		reg = <0x00 0x1004a000 0x00 0x1000 0x00 0x1021e000 0x00 0x1000>;
		interrupts = <0x00 0x11d 0x04>;
		clocks = <0x0e 0x6c>;
		clock-names = "infra-cldma0-rh";
		mediatek,hif_ids = <0x01>;
	};

	mrdump_ext_rst {
		compatible = "mediatek, mrdump_ext_rst-eint";
		mode = "IRQ";
		status = "okay";
		interrupt-parent = <0x2f>;
		interrupts = <0x00 0x08>;
		deb-gpios = <0x2f 0x00 0x00>;
		debounce = <0x7d000>;
	};

	dpmaif@10014000 {
		compatible = "mediatek,dpmaif";
		reg = <0x00 0x10014000 0x00 0x1000 0x00 0x1022d000 0x00 0x1000 0x00 0x1022c000 0x00 0x1000 0x00 0x1022e000 0x00 0x1000 0x00 0x15b14000 0x00 0x1000 0x00 0x15b38000 0x00 0x1000>;
		interrupts = <0x00 0xd1 0x04 0x00>;
		mediatek,dpmaif_capability = <0x06>;
		clocks = <0x0e 0x61 0x0e 0x34>;
		clock-names = "infra-dpmaif-clk", "infra-dpmaif-blk-clk";
	};

	ccifdriver@10209000 {
		compatible = "mediatek,ccci_ccif";
		reg = <0x00 0x10209000 0x00 0x1000 0x00 0x1020a000 0x00 0x1000>;
		mediatek,sram_size = <0x200>;
		interrupts = <0x00 0xc2 0x04 0x00 0xc3 0x04>;
		clocks = <0x0e 0x2c 0x0e 0x2f 0x0e 0x24 0x0e 0x25 0x0e 0x57 0x0e 0x58 0x0e 0x64>;
		clock-names = "infra-ccif-ap", "infra-ccif-md", "infra-ccif1-ap", "infra-ccif1-md", "infra-ccif2-ap", "infra-ccif2-md", "infra-ccif4-md";
	};

	mddriver {
		compatible = "mediatek,mddriver";
		mediatek,mdhif_type = <0x02>;
		mediatek,md_id = <0x00>;
		mediatek,ap_plat_info = <0x1aea>;
		mediatek,md_generation = <0x1899>;
		mediatek,offset_apon_md1 = <0x2844>;
		mediatek,cldma_capability = <0x02>;
		reg = <0x00 0x10209000 0x00 0x1000 0x00 0x1020a000 0x00 0x1000>;
		interrupts = <0x00 0x4e 0x01 0x00 0xc2 0x04 0x00 0xc3 0x04>;
		vmd11-supply = <0x48>;
		vsram_md-supply = <0x49>;
		vrfdig-supply = <0x4a>;
		power-domains = <0x4b 0x07>;
		ccci-infracfg = <0x0e>;
		phandle = <0x20>;
	};

	gce_mbox@10228000 {
		compatible = "mediatek,mailbox-gce";
		reg = <0x00 0x10228000 0x00 0x4000>;
		interrupts = <0x00 0xcb 0x04>;
		#mbox-cells = <0x03>;
		#gce-event-cells = <0x01>;
		#gce-subsys-cells = <0x02>;
		default_tokens = [02 bc 02 bd 02 be 02 bf 02 c0 02 c6 02 c7];
		clocks = <0x0e 0x09 0x0e 0x1b>;
		clock-names = "gce", "gce-timer";
		phandle = <0x4c>;
	};

	cmdq-test {
		compatible = "mediatek,cmdq-test";
		mediatek,gce = <0x4c>;
		mmsys_config = <0x4d>;
		mediatek,gce-subsys = <0x63 0x01>;
		mboxes = <0x4c 0x17 0x00 0x01 0x4c 0x16 0xffffffff 0x01 0x4c 0x0b 0x00 0x01>;
		token_user0 = [02 89];
		token_gpr_set4 = [02 c0];
	};

	infra_dpmaif@1022c000 {
		compatible = "mediatek,infra_dpmaif";
		reg = <0x00 0x1022c000 0x00 0x10>;
	};

	dramc@10230000 {
		compatible = "mediatek,mt6880-dramc", "mediatek,common-dramc";
		reg = <0x00 0x10230000 0x00 0x2000 0x00 0x10240000 0x00 0x2000 0x00 0x10234000 0x00 0x1000 0x00 0x10244000 0x00 0x1000 0x00 0x10238000 0x00 0x2000 0x00 0x10248000 0x00 0x2000 0x00 0x10236000 0x00 0x1000 0x00 0x10246000 0x00 0x1000 0x00 0x10006000 0x00 0x1000>;
		mr4_version = <0x01>;
		mr4_rg = <0x90 0xffff 0x00>;
		fmeter_version = <0x01>;
		crystal_freq = <0x34>;
		pll_id = <0x50c 0x100 0x08>;
		shu_lv = <0x50c 0x30000 0x10>;
		shu_of = <0x700>;
		sdmpcw = <0x704 0xffff0000 0x10 0x724 0xffff0000 0x10>;
		prediv = <0x708 0xc0000 0x12 0x728 0xc0000 0x12>;
		posdiv = <0x708 0x07 0x00 0x728 0x07 0x00>;
		ckdiv4 = <0x874 0x04 0x02 0x874 0x04 0x02>;
		pll_md = <0x744 0x100 0x08 0x744 0x100 0x08>;
		cldiv2 = <0x8b4 0x02 0x01 0x8b4 0x02 0x01>;
		fbksel = <0x70c 0x40 0x06 0x70c 0x40 0x06>;
		dqopen = <0x870 0x100000 0x14 0x870 0x100000 0x14>;
	};

	emiisu {
		compatible = "mediatek,mt6880-emiisu", "mediatek,common-emiisu";
		ctrl_intf = <0x01>;
	};

	emichn@10235000 {
		compatible = "mediatek,mt6880-emichn", "mediatek,common-emichn";
		reg = <0x00 0x10235000 0x00 0x1000 0x00 0x10245000 0x00 0x1000>;
		phandle = <0x46>;
	};

	dramc_ch0_top0@10230000 {
		compatible = "mediatek,dramc_ch0_top0";
		reg = <0x00 0x10230000 0x00 0x2000>;
	};

	dramc_ch0_top1@10232000 {
		compatible = "mediatek,dramc_ch0_top1";
		reg = <0x00 0x10232000 0x00 0x2000>;
	};

	dramc_ch0_top2@10234000 {
		compatible = "mediatek,dramc_ch0_top2";
		reg = <0x00 0x10234000 0x00 0x1000>;
	};

	dramc_ch0_top3@10235000 {
		compatible = "mediatek,dramc_ch0_top3";
		reg = <0x00 0x10235000 0x00 0x1000>;
	};

	dramc_ch0_top4@10236000 {
		compatible = "mediatek,dramc_ch0_top4";
		reg = <0x00 0x10236000 0x00 0x2000>;
	};

	dramc_ch0_top5@10238000 {
		compatible = "mediatek,dramc_ch0_top5";
		reg = <0x00 0x10238000 0x00 0x2000>;
	};

	dramc_ch0_top6@1023a000 {
		compatible = "mediatek,dramc_ch0_top6";
		reg = <0x00 0x1023a000 0x00 0x2000>;
	};

	ap_ccif2@1023c000 {
		compatible = "mediatek,ap_ccif2";
		reg = <0x00 0x1023c000 0x00 0x1000>;
		interrupts = <0x00 0x106 0x04>;
	};

	md_ccif2@1023d000 {
		compatible = "mediatek,md_ccif2";
		reg = <0x00 0x1023d000 0x00 0x1000>;
	};

	ap_ccif3@1023e000 {
		compatible = "mediatek,ap_ccif3";
		reg = <0x00 0x1023e000 0x00 0x1000>;
		interrupts = <0x00 0x107 0x04>;
	};

	md_ccif3@1023f000 {
		compatible = "mediatek,md_ccif3";
		reg = <0x00 0x1023f000 0x00 0x1000>;
	};

	stmmac-axi-config {
		snps,wr_osr_lmt = <0x07>;
		snps,rd_osr_lmt = <0x07>;
		snps,blen = <0x00 0x00 0x00 0x00 0x10 0x08 0x04>;
		phandle = <0x4f>;
	};

	rx-queues-config {
		snps,rx-queues-to-use = <0x01>;
		snps,rx-sched-sp;
		phandle = <0x50>;

		queue0 {
			snps,dcb-algorithm;
			snps,map-to-dma-channel = <0x00>;
			snps,priority = <0x00>;
		};

		queue1 {
			snps,dcb-algorithm;
			snps,map-to-dma-channel = <0x01>;
			snps,priority = <0x00>;
			snps,route-ptp;
		};

		queue2 {
			snps,dcb-algorithm;
			snps,map-to-dma-channel = <0x02>;
			snps,priority = <0x00>;
			snps,route-multi-broad;
		};
	};

	tx-queues-config {
		snps,tx-queues-to-use = <0x03>;
		snps,tx-sched-wrr;
		phandle = <0x51>;

		queue0 {
			snps,weight = <0x10>;
			snps,dcb-algorithm;
			snps,priority = <0x00>;
		};

		queue1 {
			snps,weight = <0x11>;
			snps,dcb-algorithm;
			snps,priority = <0x01>;
		};

		queue2 {
			snps,weight = <0x12>;
			snps,dcb-algorithm;
			snps,priority = <0x02>;
		};
	};

	ethernet@11021000 {
		compatible = "mediatek,mt2735-gmac";
		reg = <0x00 0x11021000 0x00 0x1300>;
		interrupts = <0x00 0x131 0x04>;
		interrupt-names = "macirq";
		mac-address = [00 55 7b b5 7d f7];
		clock-names = "mac_main", "ptp_ref", "eth_cg", "eth_rmii", "dma";
		mediatek,pericfg = <0x4e>;
		snps,axi-config = <0x4f>;
		snps,mtl-rx-config = <0x50>;
		snps,mtl-tx-config = <0x51>;
		snps,txpbl = <0x01>;
		snps,rxpbl = <0x01>;
		clk_csr = <0x00>;
	};

	i2c@0x11c40000 {
		compatible = "mediatek,mt6890-i2c", "mediatek,mt8192-i2c";
		reg = <0x00 0x11c40000 0x00 0x1000 0x00 0x10217080 0x00 0x80>;
		interrupts = <0x00 0x70 0x04 0x00>;
		clocks = <0x52 0x00 0x0e 0x0f>;
		clock-names = "main", "dma";
		clock-div = <0x01>;
		status = "okay";
		#address-cells = <0x01>;
		#size-cells = <0x00>;
		clock-frequency = <0x61a80>;
		mediatek,use-open-drain;

		fm11@57 {
			status = "okay";
			compatible = "fm11";
			reg = <0x57>;
		};

		nau88c22@1a {
			compatible = "nuvoton,nau88c22";
			reg = <0x1a>;
		};
	};

	i2c@11c41000 {
		compatible = "mediatek,mt6890-i2c", "mediatek,mt8192-i2c";
		reg = <0x00 0x11c41000 0x00 0x1000 0x00 0x10217100 0x00 0x80>;
		interrupts = <0x00 0x71 0x04 0x00>;
		clocks = <0x52 0x01 0x0e 0x0f>;
		clock-names = "main", "dma";
		clock-div = <0x01>;
		#address-cells = <0x01>;
		#size-cells = <0x00>;
		clock-frequency = <0x61a80>;
		mediatek,use-open-drain;

		barometer@76 {
			compatible = "mediatek,barometer";
			reg = <0x76>;
			status = "okay";
		};

		msensor@0c {
			compatible = "mediatek,msensor";
			reg = <0x0c>;
			status = "okay";
		};

		gsensor@6a {
			compatible = "mediatek,gsensor";
			reg = <0x6a>;
			status = "okay";
		};

		alsps@60 {
			compatible = "mediatek,alsps";
			reg = <0x60>;
			status = "okay";
		};
	};

	i2c@11c42000 {
		compatible = "mediatek,mt6890-i2c", "mediatek,mt8192-i2c";
		reg = <0x00 0x11c42000 0x00 0x1000 0x00 0x10217180 0x00 0x80>;
		interrupts = <0x00 0x72 0x04 0x00>;
		clocks = <0x52 0x02 0x0e 0x0f>;
		clock-names = "main", "dma";
		clock-div = <0x01>;
		#address-cells = <0x01>;
		#size-cells = <0x00>;
		clock-frequency = <0x61a80>;
		mediatek,use-open-drain;

		rt9467@5b {
			compatible = "richtek,rt9467";
			reg = <0x5b>;
			rt,intr_gpio_num = <0x14>;
			rt,intr_gpio = <0x2f 0x14 0x00>;
			interrupt-names = "wdtmri";
			status = "disable";
			charger_name = "primary_chg";
			regmap_name = "rt9467_primary";
			en_wdt;
			phandle = <0xab>;

			usb-otg-vbus {
				regulator-compatible = "usb-otg-vbus";
				regulator-name = "usb-otg-vbus";
				regulator-min-microvolt = <0x438528>;
				regulator-max-microvolt = <0x58e1e8>;
				regulator-min-microamp = <0x7a120>;
				regulator-max-microamp = <0x249f00>;
				phandle = <0xaa>;
			};
		};

		slave_charger@5b {
			compatible = "mediatek,slave_charger";
			reg = <0x5b>;
			status = "okay";
		};

		buck_boost@39 {
			compatible = "mediatek,buck_boost";
			reg = <0x39>;
			status = "okay";
		};
	};

	i2c@11c43000 {
		compatible = "mediatek,mt6890-i2c", "mediatek,mt8192-i2c";
		reg = <0x00 0x11c43000 0x00 0x1000 0x00 0x10217200 0x00 0x80>;
		interrupts = <0x00 0x73 0x04 0x00>;
		clocks = <0x52 0x03 0x0e 0x0f>;
		clock-names = "main", "dma";
		clock-div = <0x01>;
		#address-cells = <0x01>;
		#size-cells = <0x00>;
		clock-frequency = <0x61a80>;
		mediatek,use-open-drain;

		usb_type_c@4e {
			compatible = "mediatek,usb_type_c";
			reg = <0x4e>;
			status = "okay";
		};

		direct_charger_1@55 {
			compatible = "mediatek,direct_charger_1";
			reg = <0x55>;
			status = "okay";
		};
	};

	i2c@11c44000 {
		compatible = "mediatek,mt6890-i2c", "mediatek,mt8192-i2c";
		reg = <0x00 0x11c44000 0x00 0x1000 0x00 0x10217280 0x00 0x80>;
		interrupts = <0x00 0x74 0x04 0x00>;
		clocks = <0x52 0x04 0x0e 0x0f>;
		clock-names = "main", "dma";
		clock-div = <0x01>;
		#address-cells = <0x01>;
		#size-cells = <0x00>;
		clock-frequency = <0x61a80>;
		mediatek,use-open-drain;
	};

	i2c@11c45000 {
		compatible = "mediatek,mt6890-i2c", "mediatek,mt8192-i2c";
		reg = <0x00 0x11c45000 0x00 0x1000 0x00 0x10217300 0x00 0x80>;
		interrupts = <0x00 0x75 0x04 0x00>;
		clocks = <0x52 0x05 0x0e 0x0f>;
		clock-names = "main", "dma";
		clock-div = <0x01>;
		#address-cells = <0x01>;
		#size-cells = <0x00>;
		clock-frequency = <0x61a80>;
		mediatek,use-open-drain;

		i2c_lcd_bias@3e {
			compatible = "mediatek,i2c_lcd_bias";
			reg = <0x3e>;
			status = "okay";
		};

		cap_touch@5d {
			compatible = "mediatek,cap_touch";
			reg = <0x5d>;
			status = "okay";
		};
	};

	usb@11201000 {
		compatible = "mediatek,mtu3";
		reg = <0x00 0x11201000 0x00 0x2e00 0x00 0x11203e00 0x00 0x100>;
		reg-names = "mac", "ippc";
		vusb33-supply = <0x53>;
		interrupts = <0x00 0x60 0x04>;
		phy-cells = <0x01>;
		phys = <0x54 0x03 0x55 0x04>;
		plat_type = <0x01>;
		dr_mode = "otg";
		maximum-speed = "super-speed";
		clocks = <0x0e 0x84 0x0e 0x49>;
		clock-names = "sys_ck", "ref_ck";
		power-domains = <0x4b 0x0b>;
		usb-role-switch;
		mediatek,force-vbus;
		mediatek,clk-mgr;
		mediatek,usb3-drd;
		#address-cells = <0x02>;
		#size-cells = <0x02>;
		ranges;

		xhci0@11200000 {
			compatible = "mediatek,mtk-xhci";
			reg = <0x00 0x11200000 0x00 0x1000>;
			reg-names = "mac";
			interrupts = <0x00 0x61 0x04>;
			clocks = <0x39>;
			clock-names = "sys_ck";
		};

		port {

			endpoint@0 {
				remote-endpoint = <0x56>;
				phandle = <0xac>;
			};
		};
	};

	usb-phy {
		compatible = "mediatek,fpga-u3phy";
		mediatek,ippc = <0x11203e00>;
		#address-cells = <0x02>;
		#size-cells = <0x02>;
		fpga_i2c_physical_base = <0x11c42000>;
		status = "disabled";

		usb-phy@0 {
			chip-id = <0xa60931a>;
			port = <0x00>;
			pclk_phase = <0x17>;
			#phy-cells = <0x01>;
		};
	};

	usb-phy@11e30000 {
		compatible = "mediatek,generic-tphy-v2";
		clocks = <0x39>;
		clock-names = "u3phya_ref";
		#address-cells = <0x02>;
		#size-cells = <0x02>;
		ranges;

		usb2-phy0@11e30000 {
			reg = <0x00 0x11e30000 0x00 0x700>;
			#phy-cells = <0x01>;
			mediatek,eye-rev6 = <0x01>;
			mediatek,eye-vrt = <0x05>;
			mediatek,eye-term = <0x05>;
			mediatek,eye-disc = <0x07>;
			mediatek,rx-sqth = <0x05>;
			nvmem-cells = <0x57>;
			nvmem-cell-names = "u2_efuse_data";
			status = "okay";
			phandle = <0x54>;
		};

		usb3-phy0@11e30700 {
			reg = <0x00 0x11e30700 0x00 0x900>;
			#phy-cells = <0x01>;
			nvmem-cells = <0x58>;
			nvmem-cell-names = "u3_efuse_data";
			status = "okay";
			phandle = <0x55>;
		};
	};

	dma-controller@0x10217000 {
		compatible = "mediatek, mt6873-uart-dma", "mediatek,mt6577-uart-dma";
		reg = <0x00 0x10217380 0x00 0x80 0x00 0x10217400 0x00 0x80 0x00 0x10217480 0x00 0x80 0x00 0x10217500 0x00 0x80 0x00 0x10217580 0x00 0x80 0x00 0x10217600 0x00 0x80>;
		interrupts = <0x00 0x84 0x04 0x00 0x85 0x04 0x00 0x86 0x04 0x00 0x87 0x04 0x00 0x88 0x04 0x00 0x89 0x04>;
		dma-requests = <0x06>;
		dma-bits = <0x22>;
		clocks = <0x39>;
		#dma-cells = <0x01>;
		phandle = <0x59>;
	};

	auxadc@11001000 {
		compatible = "mediatek,mt6765-auxadc";
		reg = <0x00 0x11001000 0x00 0x1000>;
		interrupts = <0x00 0x40 0x01>;
		clocks = <0x0e 0x22>;
		clock-names = "main";
		#io-channel-cells = <0x01>;
		mediatek,cali-en-bit = <0x14>;
		mediatek,cali-ge-bit = <0x0a>;
		mediatek,cali-oe-bit = <0x00>;
		mediatek,cali-efuse-reg-offset = <0xf8>;
		nvmem = <0x0b>;
		nvmem-names = "mtk_efuse";
		#interconnect-cells = <0x01>;
	};

	serial@11002000 {
		compatible = "mediatek,mt6873-uart", "mediatek,mt6577-uart";
		reg = <0x00 0x11002000 0x00 0x1000>;
		interrupts = <0x00 0x6d 0x04>;
		clocks = <0x39 0x0e 0x17>;
		clock-names = "baud", "bus";
		dmas = <0x59 0x00 0x59 0x01>;
		dma-names = "tx", "rx";
	};

	serial@11003000 {
		compatible = "mediatek,mt6873-uart", "mediatek,mt6577-uart";
		reg = <0x00 0x11003000 0x00 0x1000>;
		interrupts = <0x00 0x6e 0x04>;
		clocks = <0x39 0x0e 0x18>;
		clock-names = "baud", "bus";
		dmas = <0x59 0x02 0x59 0x03>;
		dma-names = "tx", "rx";
	};

	serial@11004000 {
		compatible = "mediatek,mt6873-uart", "mediatek,mt6577-uart";
		reg = <0x00 0x11004000 0x00 0x1000>;
		interrupts = <0x00 0x6f 0x04>;
		clocks = <0x39 0x0e 0x19>;
		clock-names = "baud", "bus";
		dmas = <0x59 0x04 0x59 0x05>;
		dma-names = "tx", "rx";
	};

	nfi@11005000 {
		compatible = "mediatek,mt6880-nfc";
		reg = <0x00 0x11005000 0x00 0x1000 0x00 0x11006000 0x00 0x1000>;
		interrupts = <0x00 0xc4 0x04 0x00 0xc5 0x04>;
		status = "okay";
		pinctrl-names = "default";
		pinctrl-0 = <0x5a>;
		clocks = <0x0f 0x54 0x0f 0x21 0x0f 0x14 0x0f 0x10 0x0f 0x26 0x0f 0x07 0x0f 0x1d 0x0f 0x0f 0x0f 0xc8 0x0e 0x78 0x0e 0x76>;
		clock-names = "nfi_parent_26m", "nfi_parent124.8m", "nfi_parent78m", "nfi_parent91m", "nfi_parent104m", "nfi_parent136.5m", "nfi_parent156m", "nfi_parent182m", "nfi_clk_sel", "dma_cg", "nfi_cg";
	};

	pd-sgmii_0_phy {
		compatible = "mediatek,sgmii-bring-up";
		mediatek,pwr_id = <0x00>;
		power-domains = <0x4b 0x0d>;
	};

	pd-sgmii_0_top {
		compatible = "mediatek,sgmii-bring-up";
		mediatek,pwr_id = <0x01>;
		power-domains = <0x4b 0x0e>;
	};

	pd-sgmii_1_phy {
		compatible = "mediatek,sgmii-bring-up";
		mediatek,pwr_id = <0x02>;
		power-domains = <0x4b 0x0f>;
	};

	pd-sgmii_1_top {
		compatible = "mediatek,sgmii-bring-up";
		mediatek,pwr_id = <0x03>;
		power-domains = <0x4b 0x10>;
	};

	sgmiisys@10060000 {
		compatible = "mediatek,colgin-sgmiisys_0", "syscon";
		reg = <0x00 0x10060000 0x00 0x1000>;
		#clock-cells = <0x01>;
		mediatek,physpeed = "2500";
		power-domains = <0x4b 0x0e>;
		phandle = <0x5d>;
	};

	sgmiisys@10070000 {
		compatible = "mediatek,colgin-sgmiisys_1", "syscon";
		reg = <0x00 0x10070000 0x00 0x1000>;
		#clock-cells = <0x01>;
		mediatek,physpeed = "2500";
		power-domains = <0x4b 0x10>;
		phandle = <0x5e>;
	};

	sgmiiphy@11ED0000 {
		compatible = "mediatek,colgin-sgmiisys_phy_0", "syscon";
		reg = <0x00 0x11ed0000 0x00 0x1000>;
		#clock-cells = <0x01>;
		power-domains = <0x4b 0x0d>;
		phandle = <0x5f>;
	};

	sgmiiphy@11EE0000 {
		compatible = "mediatek,colgin-sgmiisys_phy_1", "syscon";
		reg = <0x00 0x11ee0000 0x00 0x1000>;
		#clock-cells = <0x01>;
		power-domains = <0x4b 0x0f>;
		phandle = <0x60>;
	};

	ethsys@15000000 {
		#address-cells = <0x01>;
		#size-cells = <0x01>;
		compatible = "mediatek,leopard-ethsys", "syscon", "simple-mfd";
		reg = <0x00 0x15000000 0x00 0x1000>;
		#clock-cells = <0x01>;
		#reset-cells = <0x01>;
		phandle = <0x5b>;

		reset-controller {
			compatible = "ti,syscon-reset";
			#reset-cells = <0x01>;
			ti,reset-bits = <0x34 0x04 0x34 0x04 0x34 0x04 0x28>;
			phandle = <0x0d>;
		};
	};

	wo@15195000 {
		compatible = "mediatek,leopard-ethsys", "syscon", "simple-mfd";
		reg = <0x00 0x15195000 0x00 0x1000>;
		phandle = <0x5c>;
	};

	ethernet@15100000 {
		compatible = "mediatek,mt6890-eth", "syscon";
		reg = <0x00 0x15100000 0x00 0x20000>;
		interrupts-extended = <0x01 0x00 0x189 0x04 0x01 0x00 0x18a 0x04 0x01 0x00 0x192 0x04 0x01 0x00 0x193 0x04 0x01 0x00 0x194 0x04 0x01 0x00 0x195 0x04 0x01 0x00 0x186 0x04 0x01 0x00 0x188 0x04 0x2f 0x3f 0x08>;
		clocks = <0x0f 0xca 0x0f 0xcb 0x0f 0xd3 0x0f 0xd4 0x0f 0xd5 0x0f 0xd6 0x0f 0xd7 0x0f 0xd8>;
		clock-names = "net_sel", "med_sel", "net_500_sel", "med_mcu_sel", "wed_mcu_sel", "net_2x_sel", "sgmii_sel", "sgmii_sbus_sel";
		power-domains = <0x4b 0x10>;
		mediatek,ethsys = <0x5b>;
		mediatek,wo = <0x5c>;
		mediatek,sgmiisys = <0x5d 0x5e>;
		mediatek,sgmiisys_phy = <0x5f 0x60>;
		#address-cells = <0x01>;
		#size-cells = <0x00>;
		status = "okay";
		pinctrl-names = "eth_gpio_default", "eth_smi_mdio_pinctl", "eth_smi_mdc_pinctl";
		pinctrl-0 = <0x61>;
		pinctrl-1 = <0x62>;
		pinctrl-2 = <0x63>;

		mac@0 {
			compatible = "mediatek,eth-mac";
			reg = <0x00>;
			phy-mode = "2500base-x";

			fixed-link {
				speed = <0x9c4>;
				full-duplex;
				pause;
			};
		};

		mac@1 {
			compatible = "mediatek,eth-mac";
			reg = <0x01>;
			phy-mode = "2500base-x";

			fixed-link {
				speed = <0x9c4>;
				full-duplex;
				pause;
			};
		};

		mdio-bus {
			#address-cells = <0x01>;
			#size-cells = <0x00>;
			phy1reset-gpios = <0x2f 0x42 0x00>;
			phy2reset-gpios = <0x2f 0x40 0x00>;
			phandle = <0xa9>;

			phy@1 {
				reg = <0x01>;
				compatible = "ethernet-phy-ieee802.3-c22";
			};

			phy@3 {
				reg = <0x03>;
				compatible = "ethernet-phy-ieee802.3-c22";
			};

			phy@8 {
				reg = <0x08>;
				compatible = "ethernet-phy-ieee802.3-c45";
			};

			phy@31 {
				reg = <0x1f>;
				compatible = "ethernet-phy-ieee802.3-c22";
			};

			phy@15 {
				compatible = "ethernet-phy-id03a2.a411";
				reg = <0x0f>;
				phy-mode = "2500base-x";
				full-duplex;
				pause;
				airoha,polarity = <0x01>;
				airoha,surge = <0x00>;
			};

			phy@14 {
				compatible = "ethernet-phy-id03a2.a411";
				reg = <0x0e>;
				phy-mode = "2500base-x";
				full-duplex;
				pause;
				airoha,polarity = <0x01>;
				airoha,surge = <0x00>;
			};
		};
	};

	crypto@10320000 {
		compatible = "inside-secure,safexcel-eip97";
		reg = <0x00 0x10320000 0x00 0x40000>;
		interrupts = <0x00 0x138 0x04 0x00 0x139 0x04 0x00 0x13a 0x04 0x00 0x13b 0x04 0x00 0x13c 0x04>;
		interrupt-names = "ring0", "ring1", "ring2", "ring3";
		clocks = <0x0f 0xce 0x0f 0x66 0x0f 0x0b>;
		clock-names = "clk-mux", "net2pll", "D5_D2";
		power-domains = <0x4b 0x08>;
	};

	dramc_ch1_top0@10240000 {
		compatible = "mediatek,dramc_ch1_top0";
		reg = <0x00 0x10240000 0x00 0x2000>;
	};

	dramc_ch1_top1@10242000 {
		compatible = "mediatek,dramc_ch1_top1";
		reg = <0x00 0x10242000 0x00 0x2000>;
	};

	dramc_ch1_top2@10244000 {
		compatible = "mediatek,dramc_ch1_top2";
		reg = <0x00 0x10244000 0x00 0x1000>;
	};

	dramc_ch1_top3@10245000 {
		compatible = "mediatek,dramc_ch1_top3";
		reg = <0x00 0x10245000 0x00 0x1000>;
	};

	dramc_ch1_top4@10246000 {
		compatible = "mediatek,dramc_ch1_top4";
		reg = <0x00 0x10246000 0x00 0x2000>;
	};

	dramc_ch1_top5@10248000 {
		compatible = "mediatek,dramc_ch1_top5";
		reg = <0x00 0x10248000 0x00 0x2000>;
	};

	dramc_ch1_top6@1024a000 {
		compatible = "mediatek,dramc_ch1_top6";
		reg = <0x00 0x1024a000 0x00 0x2000>;
	};

	ap_ccif4@1024c000 {
		compatible = "mediatek,ap_ccif4";
		reg = <0x00 0x1024c000 0x00 0x1000>;
	};

	md_ccif4@1024d000 {
		compatible = "mediatek,md_ccif4";
		reg = <0x00 0x1024d000 0x00 0x1000>;
	};

	md_ccif4@1024e000 {
		compatible = "mediatek,md_ccif4";
		reg = <0x00 0x1024e000 0x00 0x1000>;
	};

	dramc_ch2_top0@10250000 {
		compatible = "mediatek,dramc_ch2_top0";
		reg = <0x00 0x10250000 0x00 0x2000>;
	};

	dramc_ch2_top1@10252000 {
		compatible = "mediatek,dramc_ch2_top1";
		reg = <0x00 0x10252000 0x00 0x2000>;
	};

	dramc_ch2_top2@10254000 {
		compatible = "mediatek,dramc_ch2_top2";
		reg = <0x00 0x10254000 0x00 0x1000>;
	};

	dramc_ch2_top3@10255000 {
		compatible = "mediatek,dramc_ch2_top3";
		reg = <0x00 0x10255000 0x00 0x1000>;
	};

	dramc_ch2_top4@10256000 {
		compatible = "mediatek,dramc_ch2_top4";
		reg = <0x00 0x10256000 0x00 0x2000>;
	};

	dramc_ch2_top5@10258000 {
		compatible = "mediatek,dramc_ch2_top5";
		reg = <0x00 0x10258000 0x00 0x2000>;
	};

	dramc_ch2_top6@1025a000 {
		compatible = "mediatek,dramc_ch2_top6";
		reg = <0x00 0x1025a000 0x00 0x2000>;
	};

	ap_ccif5@1025c000 {
		compatible = "mediatek,ap_ccif5";
		reg = <0x00 0x1025c000 0x00 0x1000>;
	};

	md_ccif5@1025d000 {
		compatible = "mediatek,md_ccif5";
		reg = <0x00 0x1025d000 0x00 0x1000>;
	};

	mm_vpu_m0_sub_common@1025e000 {
		compatible = "mediatek,mm_vpu_m0_sub_common";
		reg = <0x00 0x1025e000 0x00 0x1000>;
	};

	mm_vpu_m1_sub_common@1025f000 {
		compatible = "mediatek,mm_vpu_m1_sub_common";
		reg = <0x00 0x1025f000 0x00 0x1000>;
	};

	dramc_ch3_top0@10260000 {
		compatible = "mediatek,dramc_ch3_top0";
		reg = <0x00 0x10260000 0x00 0x2000>;
	};

	dramc_ch3_top1@10262000 {
		compatible = "mediatek,dramc_ch3_top1";
		reg = <0x00 0x10262000 0x00 0x2000>;
	};

	dramc_ch3_top2@10264000 {
		compatible = "mediatek,dramc_ch3_top2";
		reg = <0x00 0x10264000 0x00 0x1000>;
	};

	dramc_ch3_top3@10265000 {
		compatible = "mediatek,dramc_ch3_top3";
		reg = <0x00 0x10265000 0x00 0x1000>;
	};

	dramc_ch3_top4@10266000 {
		compatible = "mediatek,dramc_ch3_top4";
		reg = <0x00 0x10266000 0x00 0x2000>;
	};

	dramc_ch3_top5@10268000 {
		compatible = "mediatek,dramc_ch3_top5";
		reg = <0x00 0x10268000 0x00 0x2000>;
	};

	dramc_ch3_top6@1026a000 {
		compatible = "mediatek,dramc_ch3_top6";
		reg = <0x00 0x1026a000 0x00 0x2000>;
	};

	bcrm_peri@10272000 {
		compatible = "mediatek,bcrm_peri";
		reg = <0x00 0x10272000 0x00 0x1000>;
	};

	bcrm_peri2@10273000 {
		compatible = "mediatek,bcrm_peri2";
		reg = <0x00 0x10273000 0x00 0x1000>;
	};

	devapc_peri@10274000 {
		compatible = "mediatek,devapc_peri";
		reg = <0x00 0x10274000 0x00 0x1000>;
	};

	devapc_peri2@10275000 {
		compatible = "mediatek,devapc_peri2";
		reg = <0x00 0x10275000 0x00 0x1000>;
	};

	bcrm_fmem@10276000 {
		compatible = "mediatek,bcrm_fmem";
		reg = <0x00 0x10276000 0x00 0x1000>;
	};

	mm_vpu_m0_sub_common@10309000 {
		compatible = "mediatek,mm_vpu_m0_sub_common";
		reg = <0x00 0x10309000 0x00 0x1000>;
	};

	mm_vpu_m1_sub_common@1030a000 {
		compatible = "mediatek,mm_vpu_m1_sub_common";
		reg = <0x00 0x1030a000 0x00 0x1000>;
	};

	mm_vpu_m1_sub_common@1030b000 {
		compatible = "mediatek,mm_vpu_m1_sub_common";
		reg = <0x00 0x1030b000 0x00 0x1000>;
	};

	mm_vpu_m1_sub_common@1030c000 {
		compatible = "mediatek,mm_vpu_m1_sub_common";
		reg = <0x00 0x1030c000 0x00 0x1000>;
	};

	mm_vpu_m1_sub_common@1030d000 {
		compatible = "mediatek,mm_vpu_m1_sub_common";
		reg = <0x00 0x1030d000 0x00 0x1000>;
	};

	sys_cirq1@10312000 {
		compatible = "mediatek,sys_cirq1";
		reg = <0x00 0x10312000 0x00 0x1000>;
	};

	sys_cirq2@10313000 {
		compatible = "mediatek,sys_cirq2";
		reg = <0x00 0x10313000 0x00 0x1000>;
	};

	dbg_tracker@10314000 {
		compatible = "mediatek,dbg_tracker";
		reg = <0x00 0x10314000 0x00 0x1000>;
	};

	pwrmcu@10400000 {
		compatible = "mediatek,pwrmcu";
		reg = <0x00 0x10400000 0x00 0x100000>;
	};

	sspm@10400000 {
		compatible = "mediatek,sspm";
		reg = <0x00 0x10400000 0x00 0x28000 0x00 0x10440000 0x00 0x10000 0x00 0x10450000 0x00 0x100 0x00 0x10451000 0x00 0x04 0x00 0x10451004 0x00 0x04 0x00 0x10460000 0x00 0x100 0x00 0x10461000 0x00 0x04 0x00 0x10461004 0x00 0x04 0x00 0x10470000 0x00 0x100 0x00 0x10471000 0x00 0x04 0x00 0x10471004 0x00 0x04 0x00 0x10480000 0x00 0x100 0x00 0x10481000 0x00 0x04 0x00 0x10481004 0x00 0x04 0x00 0x10490000 0x00 0x100 0x00 0x10491000 0x00 0x04 0x00 0x10491004 0x00 0x04>;
		reg-names = "sspm_base", "cfgreg", "mbox0_base", "mbox0_set", "mbox0_clr", "mbox1_base", "mbox1_set", "mbox1_clr", "mbox2_base", "mbox2_set", "mbox2_clr", "mbox3_base", "mbox3_set", "mbox3_clr", "mbox4_base", "mbox4_set", "mbox4_clr";
		interrupts = <0x00 0xf1 0x04 0x00 0xf4 0x04 0x00 0xf5 0x04 0x00 0xf6 0x04 0x00 0xf7 0x04 0x00 0xf8 0x04>;
		interrupt-names = "ipc", "mbox0", "mbox1", "mbox2", "mbox3", "mbox4";
	};

	tinsys@10500000 {
		compatible = "mediatek,tinsys";
		reg = <0x00 0x10500000 0x00 0x00>;
	};

	dramc_ch1_rsv0@10900000 {
		compatible = "mediatek,dramc_ch1_rsv0";
		reg = <0x00 0x10900000 0x00 0x40000>;
	};

	dramc_ch1_rsv1@10940000 {
		compatible = "mediatek,dramc_ch1_rsv1";
		reg = <0x00 0x10940000 0x00 0xc0000>;
	};

	mali@13000000 {
		compatible = "mediatek,mali", "arm,mali-midgard", "arm,mali-bifrost";
		reg = <0x00 0x13000000 0x00 0x4000>;
		interrupts = <0x00 0x16b 0x04 0x00 0x16c 0x04 0x00 0x16d 0x04 0x00 0x16e 0x04>;
		interrupt-names = "GPU", "MMU", "JOB", "EVENT";
		operating-points-v2 = <0x64>;
		#cooling-cells = <0x02>;
		gpufreq-supply = <0x65>;
	};

	opp-table0 {
		compatible = "operating-points-v2";
		phandle = <0x64>;

		opp00 {
			opp-hz = <0x00 0x2e7ddb00>;
			opp-microvolt = <0xb71b0>;
		};

		opp01 {
			opp-hz = <0x00 0x21f98280>;
			opp-microvolt = <0x9eb10>;
		};

		opp02 {
			opp-hz = <0x00 0x15752a00>;
			opp-microvolt = <0x927c0>;
		};

		opp03 {
			opp-hz = <0x00 0x11e1a300>;
			opp-microvolt = <0x86470>;
		};
	};

	gpufreq {
		compatible = "mediatek,gpufreq";
		clocks = <0x0f 0xa9 0x0f 0x02 0x0f 0xa8 0x66 0x00>;
		clock-names = "clk_mux", "clk_main_parent", "clk_sub_parent", "cg_bg3d";
		power-domains = <0x4b 0x00>;
		phandle = <0x65>;
	};

	mmc@11230000 {
		compatible = "mediatek,mt6880-mmc";
		reg = <0x00 0x11230000 0x00 0x1000 0x00 0x11f10000 0x00 0x1000>;
		interrupts = <0x00 0x63 0x04>;
		clocks = <0x0f 0xac 0x0e 0x1e 0x0e 0x83>;
		clock-names = "source", "hclk", "source_cg";
		power-domains = <0x4b 0x0a>;
		status = "okay";
		index = <0x00>;
		pinctrl-names = "default", "state_uhs";
		pinctrl-0 = <0x67>;
		pinctrl-1 = <0x68>;
		bus-width = <0x08>;
		max-frequency = <0xbebc200>;
		cap-mmc-highspeed;
		mmc-hs200-1_8v;
		mmc-hs400-1_8v;
		cap-mmc-hw-reset;
		no-sdio;
		no-sd;
		hs400-ds-delay = <0x12814>;
		supports-cqe;
		vmmc-supply = <0x69>;
		non-removable;
	};

	mmc@11240000 {
		compatible = "mediatek,mt6880-mmc";
		reg = <0x00 0x11240000 0x00 0x1000 0x00 0x11f20000 0x00 0x1000>;
		interrupts = <0x00 0x67 0x04>;
		clocks = <0x0f 0xad 0x0e 0x1f 0x0e 0x28>;
		clock-names = "source", "hclk", "source_cg";
		power-domains = <0x4b 0x0a>;
		status = "okay";
		index = <0x01>;
		pinctrl-names = "default", "state_uhs";
		pinctrl-0 = <0x6a>;
		pinctrl-1 = <0x6b>;
		bus-width = <0x04>;
		max-frequency = <0xbebc200>;
		cap-sd-highspeed;
		sd-uhs-sdr12;
		sd-uhs-sdr25;
		sd-uhs-sdr50;
		sd-uhs-sdr104;
		cd-gpios = <0x2f 0x0b 0x01>;
		vqmmc-supply = <0x6c>;
		no-mmc;
		no-sdio;
	};

	lvts@1100b000 {
		compatible = "mediatek,mt6880-lvts";
		reg = <0x00 0x1100b000 0x00 0x1000 0x00 0x11278000 0x00 0x1000 0x00 0x10001000 0x00 0x1000>;
		interrupts = <0x00 0xa9 0x04 0x00 0xaa 0x04>;
		clocks = <0x0e 0x0b>;
		clock-names = "lvts_clk";
		resets = <0x6d 0x00 0x6d 0x01>;
		nvmem-cells = <0x6e>;
		nvmem-cell-names = "e_data1";
		#thermal-sensor-cells = <0x01>;
		phandle = <0x24>;
	};

	disp_pwm0@1100e000 {
		compatible = "mediatek,disp_pwm0", "mediatek,mt6890-disp-pwm";
		reg = <0x00 0x1100e000 0x00 0x1000>;
		interrupts = <0x00 0xab 0x04>;
		#pwm-cells = <0x02>;
		clocks = <0x0e 0x33 0x0f 0xb8 0x0f 0x5d>;
		clock-names = "main", "mm", "pwm_src";
		phandle = <0x02>;
	};

	pcie_ep@11280000 {
		compatible = "mediatek,mt6880-pcie-ep";
		reg = <0x00 0x11280000 0x00 0x2000>;
		reg-names = "pcie-ep";
		interrupts = <0x00 0x145 0x04>;
		status = "disabled";
		clocks = <0x0e 0x27 0x0e 0x29 0x0e 0x62 0x0e 0x56 0x0e 0x71>;
		phys = <0x6f>;
		phy-names = "pcie-phy";
		power-domains = <0x4b 0x01>;
	};

	pcie@11280000 {
		compatible = "mediatek,mt6880-pcie";
		reg = <0x00 0x11280000 0x00 0x2000>;
		reg-names = "pcie-mac";
		linux,pci-domain = <0x00>;
		#address-cells = <0x03>;
		#size-cells = <0x02>;
		interrupts = <0x00 0x145 0x04>;
		bus-range = <0x00 0xff>;
		ranges = <0x82000000 0x00 0x00 0x00 0x30000000 0x00 0x10000000>;
		status = "okay";
		clocks = <0x0e 0x27 0x0e 0x29 0x0e 0x62 0x0e 0x56 0x0e 0x71>;
		phys = <0x6f>;
		phy-names = "pcie-phy";
		power-domains = <0x4b 0x01>;
		#interrupt-cells = <0x01>;
		interrupt-map-mask = <0x00 0x00 0x00 0x07>;
		interrupt-map = <0x00 0x00 0x00 0x01 0x70 0x00 0x00 0x00 0x00 0x02 0x70 0x01 0x00 0x00 0x00 0x03 0x70 0x02 0x00 0x00 0x00 0x04 0x70 0x03>;
		max-link-speed = <0x02>;
		pinctrl-names = "default";
		pinctrl-0 = <0x71>;

		legacy-interrupt-controller {
			interrupt-controller;
			#address-cells = <0x00>;
			#interrupt-cells = <0x01>;
			phandle = <0x70>;
		};
	};

	pcie@11288000 {
		compatible = "mediatek,mt6880-pcie";
		reg = <0x00 0x11288000 0x00 0x2000>;
		reg-names = "pcie-mac";
		linux,pci-domain = <0x01>;
		#address-cells = <0x03>;
		#size-cells = <0x02>;
		interrupts = <0x00 0x69 0x04>;
		bus-range = <0x00 0xff>;
		ranges = <0x82000000 0x00 0x00 0x00 0xc0000000 0x00 0x4000000>;
		status = "okay";
		clocks = <0x0e 0x27 0x0e 0x29 0x0e 0x62 0x0e 0x72 0x0e 0x7d>;
		phys = <0x72>;
		phy-names = "pcie-phy";
		power-domains = <0x4b 0x02>;
		#interrupt-cells = <0x01>;
		interrupt-map-mask = <0x00 0x00 0x00 0x07>;
		interrupt-map = <0x00 0x00 0x00 0x01 0x73 0x00 0x00 0x00 0x00 0x02 0x73 0x01 0x00 0x00 0x00 0x03 0x73 0x02 0x00 0x00 0x00 0x04 0x73 0x03>;
		max-link-speed = <0x02>;
		pinctrl-names = "default";
		pinctrl-0 = <0x74>;

		legacy-interrupt-controller {
			interrupt-controller;
			#address-cells = <0x00>;
			#interrupt-cells = <0x01>;
			phandle = <0x73>;
		};
	};

	pcie@11290000 {
		compatible = "mediatek,mt6880-pcie";
		reg = <0x00 0x11290000 0x00 0x2000>;
		reg-names = "pcie-mac";
		linux,pci-domain = <0x02>;
		#address-cells = <0x03>;
		#size-cells = <0x02>;
		interrupts = <0x00 0x6a 0x04>;
		bus-range = <0x00 0xff>;
		ranges = <0x82000000 0x00 0x00 0x00 0xc4000000 0x00 0x4000000>;
		status = "okay";
		clocks = <0x0e 0x27 0x0e 0x29 0x0e 0x62 0x0e 0x73 0x0e 0x7e>;
		phys = <0x75>;
		phy-names = "pcie-phy";
		power-domains = <0x4b 0x03>;
		#interrupt-cells = <0x01>;
		interrupt-map-mask = <0x00 0x00 0x00 0x07>;
		interrupt-map = <0x00 0x00 0x00 0x01 0x76 0x00 0x00 0x00 0x00 0x02 0x76 0x01 0x00 0x00 0x00 0x03 0x76 0x02 0x00 0x00 0x00 0x04 0x76 0x03>;
		max-link-speed = <0x03>;
		pinctrl-names = "default";
		pinctrl-0 = <0x77>;

		legacy-interrupt-controller {
			interrupt-controller;
			#address-cells = <0x00>;
			#interrupt-cells = <0x01>;
			phandle = <0x76>;
		};
	};

	pcie@11298000 {
		compatible = "mediatek,mt6880-pcie";
		reg = <0x00 0x11298000 0x00 0x2000>;
		reg-names = "pcie-mac";
		linux,pci-domain = <0x03>;
		#address-cells = <0x03>;
		#size-cells = <0x02>;
		interrupts = <0x00 0x6b 0x04>;
		bus-range = <0x00 0xff>;
		ranges = <0x82000000 0x00 0x00 0x00 0xc8000000 0x00 0x4000000>;
		status = "okay";
		clocks = <0x0e 0x27 0x0e 0x29 0x0e 0x62 0x0e 0x74 0x0e 0x7f>;
		phys = <0x78>;
		phy-names = "pcie-phy";
		power-domains = <0x4b 0x03>;
		#interrupt-cells = <0x01>;
		interrupt-map-mask = <0x00 0x00 0x00 0x07>;
		interrupt-map = <0x00 0x00 0x00 0x01 0x79 0x00 0x00 0x00 0x00 0x02 0x79 0x01 0x00 0x00 0x00 0x03 0x79 0x02 0x00 0x00 0x00 0x04 0x79 0x03>;
		max-link-speed = <0x03>;
		pinctrl-names = "default";
		pinctrl-0 = <0x7a>;

		legacy-interrupt-controller {
			interrupt-controller;
			#address-cells = <0x00>;
			#interrupt-cells = <0x01>;
			phandle = <0x79>;
		};
	};

	phy0@11e40000 {
		compatible = "mediatek,mt6880-pcie-phy";
		#address-cells = <0x02>;
		#size-cells = <0x02>;
		#phy-cells = <0x00>;
		reg = <0x00 0x11e40000 0x00 0x10000 0x00 0x11e50000 0x00 0x10000>;
		reg-names = "phy-sif", "phy-ckm";
		nvmem = <0x0b>;
		nvmem-names = "mtk_efuse";
		nvmem-cells = <0x0c>;
		nvmem-cell-names = "efuse_segment_cell";
		power-domains = <0x4b 0x11>;
		phandle = <0x6f>;
	};

	phy1@11e60000 {
		compatible = "mediatek,mt6880-pcie-phy";
		#address-cells = <0x02>;
		#size-cells = <0x02>;
		#phy-cells = <0x00>;
		reg = <0x00 0x11e60000 0x00 0x10000 0x00 0x11e70000 0x00 0x10000>;
		reg-names = "phy-sif", "phy-ckm";
		nvmem = <0x0b>;
		nvmem-names = "mtk_efuse";
		nvmem-cells = <0x0c>;
		nvmem-cell-names = "efuse_segment_cell";
		power-domains = <0x4b 0x12>;
		phandle = <0x72>;
	};

	phy2@11e80000 {
		compatible = "mediatek,mt6880-pcie-phy";
		#address-cells = <0x02>;
		#size-cells = <0x02>;
		#phy-cells = <0x00>;
		reg = <0x00 0x11e80000 0x00 0x10000 0x00 0x11e90000 0x00 0x10000>;
		reg-names = "phy-sif", "phy-ckm";
		nvmem = <0x0b>;
		nvmem-names = "mtk_efuse";
		nvmem-cells = <0x0c>;
		nvmem-cell-names = "efuse_segment_cell";
		power-domains = <0x4b 0x13>;
		phandle = <0x75>;
	};

	phy3@11ea0000 {
		compatible = "mediatek,mt6880-pcie-phy";
		#address-cells = <0x02>;
		#size-cells = <0x02>;
		#phy-cells = <0x00>;
		reg = <0x00 0x11ea0000 0x00 0x10000 0x00 0x11eb0000 0x00 0x10000>;
		reg-names = "phy-sif", "phy-ckm";
		nvmem = <0x0b>;
		nvmem-names = "mtk_efuse";
		nvmem-cells = <0x0c>;
		nvmem-cell-names = "efuse_segment_cell";
		power-domains = <0x4b 0x14>;
		phandle = <0x78>;
	};

	efuse@11ec0000 {
		compatible = "mediatek,devinfo";
		reg = <0x00 0x11ec0000 0x00 0x10000>;
		#address-cells = <0x01>;
		#size-cells = <0x01>;
		phandle = <0x0b>;

		segment@78 {
			reg = <0x78 0x04>;
			phandle = <0x0c>;
		};

		data1 {
			reg = <0x1e0 0x24>;
			phandle = <0x6e>;
		};

		u2data {
			reg = <0x98 0x04>;
			phandle = <0x57>;
		};

		u3data {
			reg = <0x9c 0x04>;
			phandle = <0x58>;
		};
	};

	dfd@13e00000 {
		compatible = "mediatek,dfd";
		reg = <0x00 0x13e00000 0x00 0x40000>;
	};

	g3d_dvfs@13fbc000 {
		compatible = "mediatek,g3d_dvfs";
		reg = <0x00 0x13fbc000 0x00 0x1000>;
	};

	g3d_testbench@13fbd000 {
		compatible = "mediatek,g3d_testbench";
		reg = <0x00 0x13fbd000 0x00 0x1000>;
	};

	g3d_config@13fbf000 {
		compatible = "mediatek,g3d_config";
		reg = <0x00 0x13fbf000 0x00 0x1000>;
	};

	mmsys_config@14000000 {
		compatible = "mediatek,mt6890-mmsys";
		reg = <0x00 0x14000000 0x00 0x1000>;
		mediatek,larb = <0x7b>;
		power-domains = <0x4b 0x05>;
		mediatek,gce = <0x4c>;
		mediatek,mailbox-gce = <0x4c>;
		gce-cpr-range = <0x00 0x520>;
		mboxes = <0x4c 0x00 0x00 0x04 0x4c 0x01 0x00 0x04 0x4c 0x02 0x00 0x04 0x4c 0x03 0xffffffff 0x02 0x4c 0x05 0xffffffff 0x02 0x4c 0x04 0x00 0x04 0x4c 0x06 0x00 0x03>;
		gce-client-names = "CLIENT_CFG0", "CLIENT_CFG1", "CLIENT_CFG2", "CLIENT_TRIG_LOOP0", "CLIENT_TRIG_LOOP1", "CLIENT_SUB_CFG0", "CLIENT_DSI_CFG0";
		phandle = <0x4d>;
	};

	dbi_panel@0 {
		compatible = "sitronix,st7796s";
		reg = <0x00>;
		pm-enable-gpios = <0x2f 0x08 0x00>;
		reset-gpios = <0x2f 0xd6 0x00>;
		bias-gpios = <0x2f 0x0a 0x00>;
	};

	disp_mutex0@14001000 {
		compatible = "mediatek,mt6890-disp-mutex0";
		reg = <0x00 0x14001000 0x00 0x1000>;
		interrupts = <0x00 0xfc 0x04>;
		clocks = <0x10 0x00>;
	};

	mdp_rdma0@14002000 {
		compatible = "mediatek,mdp_rdma0";
		reg = <0x00 0x14002000 0x00 0x1000>;
	};

	mdp_rsz0@14003000 {
		compatible = "mediatek,mdp_rsz0";
		reg = <0x00 0x14003000 0x00 0x1000>;
	};

	mdp_wrot0@14004000 {
		compatible = "mediatek,mdp_wrot0";
		reg = <0x00 0x14004000 0x00 0x1000>;
	};

	mdp_tdshp0@14005000 {
		compatible = "mediatek,mdp_tdshp0";
		reg = <0x00 0x14005000 0x00 0x1000>;
	};

	disp_ovl0@14006000 {
		compatible = "mediatek,mt6890-disp-ovl0";
		reg = <0x00 0x14006000 0x00 0x1000>;
		interrupts = <0x00 0x101 0x04>;
		mediatek,larb = <0x7b>;
		clocks = <0x10 0x0e>;
		gce-subsys = <0x4c 0x14006000 0x01>;
		#gce-subsys-cells = <0x02>;
		iommus = <0x7c 0x02>;
	};

	disp_rdma0@14007000 {
		compatible = "mediatek,mt6890-disp-rdma0";
		reg = <0x00 0x14007000 0x00 0x1000>;
		interrupts = <0x00 0x102 0x04>;
		mediatek,larb = <0x7b>;
		clocks = <0x10 0x08>;
		gce-subsys = <0x4c 0x14007000 0x01>;
		#gce-subsys-cells = <0x02>;
	};

	disp_color0@14008000 {
		compatible = "mediatek,disp_color0";
		reg = <0x00 0x14008000 0x00 0x1000>;
		interrupts = <0x00 0x103 0x04>;
	};

	disp_ccorr0@14009000 {
		compatible = "mediatek,disp_ccorr0";
		reg = <0x00 0x14009000 0x00 0x1000>;
		interrupts = <0x00 0x104 0x04>;
	};

	disp_aal0@1400a000 {
		compatible = "mediatek,disp_aal0";
		reg = <0x00 0x1400a000 0x00 0x1000>;
		interrupts = <0x00 0x105 0x04>;
	};

	disp_gamma0@1400b000 {
		compatible = "mediatek,disp_gamma0";
		reg = <0x00 0x1400b000 0x00 0x1000>;
		interrupts = <0x00 0x106 0x04>;
	};

	disp_dither0@1400c000 {
		compatible = "mediatek,disp_dither0";
		reg = <0x00 0x1400c000 0x00 0x1000>;
		interrupts = <0x00 0x107 0x04>;
	};

	disp_wdma0@1400d000 {
		compatible = "mediatek,disp_wdma0";
		reg = <0x00 0x1400d000 0x00 0x1000>;
		interrupts = <0x00 0x108 0x04>;
		mediatek,larb = <0x7b>;
	};

	dsi0@1400e000 {
		compatible = "mediatek,mt6890-dsi0";
		reg = <0x00 0x1400e000 0x00 0x1000>;
		interrupts = <0x00 0x109 0x04>;
		clocks = <0x10 0x10 0x10 0x11 0x10 0x13 0x7d 0x7e>;
		clock-names = "CLK_DSI0_MM_CK", "CLK_MMSYS_SMI_COMMON", "CLK_32K", "CLK_MM_DSI", "hs";
		phys = <0x7e>;
		phy-names = "dphy";
	};

	iocfg_tl@0x11f00000 {
		compatible = "mediatek,iocfg_tl";
		reg = <0x00 0x11f00000 0x00 0x1000>;
	};

	nli_arb@0x11f30000 {
		compatible = "mediatek,nli_arb";
		reg = <0x00 0x11f30000 0x00 0x1000>;
	};

	dbi0@1400f000 {
		compatible = "mediatek,mt6890-dbi0";
		reg = <0x00 0x1400f000 0x00 0x1000>;
		interrupts = <0x00 0x10a 0x04>;
		clocks = <0x10 0x0f 0x0e 0x76 0x0f 0xc8 0x0f 0x54 0x0f 0x21 0x0f 0x14 0x0f 0x10 0x0f 0x26 0x0f 0x07 0x0f 0x1d 0x0f 0x0f 0x10 0x11 0x10 0x14>;
		clock-names = "clk_mm_dbpi", "clk_infra_nfi", "clk_engine", "clk_top_26", "clk_top_125", "clk_top_78", "clk_top_91", "clk_top_104", "clk_top_137", "clk_top_156", "clk_top_182", "clk_smi_common", "clk_mm_dbi";
	};

	dsi_te {
		compatible = "mediatek, dsi_te-eint";
		status = "disabled";
	};

	dispsys {
		compatible = "mediatek,dispsys";
		power-domains = <0x4b 0x05>;
		clocks = <0x10 0x00 0x10 0x01 0x10 0x02 0x10 0x03 0x10 0x04 0x10 0x05 0x10 0x06 0x10 0x07 0x10 0x08 0x10 0x09 0x10 0x0a 0x10 0x0b 0x10 0x0c 0x10 0x0d 0x10 0x0e 0x10 0x0f 0x10 0x10 0x10 0x11 0x39 0x7d>;
		clock-names = "CLK_MMSYS_MUTEX0", "CLK_MMSYS_APB_BUS", "CLK_DISP_RSZ", "CLK_DISP_GAMMA0", "CLK_MM_MDP_WROT0", "CLK_DISP_COLOR0", "CLK_DISP_CCORR0", "CLK_DISP_AAL0", "CLK_DISP_RDMA0", "CLK_MM_MDP_RDMA0", "CLK_MMSYS_FAKE_ENG0", "CLK_DISP_DITHER0", "CLK_DISP_WDMA0", "CLK_MM_MDP_TDSHP0", "CLK_DISP_OVL0", "CLK_MM_DBPI0", "CLK_DSI0_MM_CK", "CLK_MMSYS_SMI_COMMON", "CLK_26M", "CLK_32K";
	};

	mipi-dphy@11C30000 {
		compatible = "mediatek,mt6890-mipi-tx0";
		reg = <0x00 0x11c30000 0x00 0x1000>;
		clocks = <0x39>;
		clock-output-names = "mipi_tx0_pll";
		#clock-cells = <0x00>;
		#phy-cells = <0x00>;
		phandle = <0x7e>;
	};

	smi_sub_common0@14010000 {
		compatible = "mediatek,mt6880-smi-common";
		reg = <0x00 0x14010000 0x00 0x1000>;
	};

	smi@14016000 {
		compatible = "mediatek,mt6880-smi-common";
		reg = <0x00 0x14016000 0x00 0x1000>;
		phandle = <0x7f>;
	};

	smi_larb0@14017000 {
		compatible = "mediatek,mt6880-smi-larb";
		mediatek,smi = <0x7f>;
		reg = <0x00 0x14017000 0x00 0x1000>;
		mediatek,larb-id = <0x00>;
		phandle = <0x7b>;
	};

	spi0@1100a000 {
		compatible = "mediatek,mt6765-spi";
		mediatek,pad-select = <0x00>;
		reg = <0x00 0x1100a000 0x00 0x100>;
		interrupts = <0x00 0x9f 0x04>;
		clocks = <0x0f 0x25 0x0f 0xc5 0x0e 0x1d>;
		clock-names = "parent-clk", "sel-clk", "spi-clk";
		#address-cells = <0x01>;
		#size-cells = <0x00>;
		status = "okay";

		spi0@0 {
			compatible = "rohm,dh2228fv";
			reg = <0x00>;
			spi-max-frequency = <0x5b8d80>;
		};
	};

	spi1@11010000 {
		compatible = "mediatek,mt6765-spi";
		mediatek,pad-select = <0x00>;
		reg = <0x00 0x11010000 0x00 0x100>;
		interrupts = <0x00 0xa0 0x04>;
		clocks = <0x0f 0x25 0x0f 0xc5 0x0e 0x37>;
		clock-names = "parent-clk", "sel-clk", "spi-clk";
	};

	spi2@11012000 {
		compatible = "mediatek,mt6765-spi";
		mediatek,pad-select = <0x00>;
		reg = <0x00 0x11012000 0x00 0x100>;
		interrupts = <0x00 0xa1 0x04>;
		clocks = <0x0f 0x25 0x0f 0xc5 0x0e 0x39>;
		clock-names = "parent-clk", "sel-clk", "spi-clk";
	};

	spi3@11013000 {
		compatible = "mediatek,mt6765-spi";
		mediatek,pad-select = <0x00>;
		reg = <0x00 0x11013000 0x00 0x100>;
		interrupts = <0x00 0xa2 0x04>;
		clocks = <0x0f 0x25 0x0f 0xc5 0x0e 0x3a>;
		clock-names = "parent-clk", "sel-clk", "spi-clk";
		status = "okay";
		#address-cells = <0x01>;
		#size-cells = <0x00>;

		proslic_spi@0 {
			compatible = "silabs,proslic_spi";
			#sound-dai-cells = <0x00>;
			reg = <0x00>;
			spi-max-frequency = <0x16e3600>;
			spi-cpha = <0x01>;
			spi-cpol = <0x01>;
			channel_count = <0x01>;
			debug_level = <0x07>;
			reset_gpio = <0x2f 0x17 0x00>;
			ig,enable-spi = <0x01>;
			phandle = <0xa7>;
		};
	};

	spi@11014000 {
		compatible = "mediatek,mt6765-spi-slave", "mediatek,mt8512-spi-slave";
		reg = <0x00 0x11014000 0x00 0x100>;
		interrupts = <0x00 0xa3 0x04>;
		clocks = <0x0e 0x79 0x0e 0x55>;
		clock-names = "spi", "axi";
		assigned-clocks = <0x0f 0xc6>;
		assigned-clock-parents = <0x0f 0x24>;
		status = "disabled";
	};

	iommu@14011000 {
		compatible = "mediatek,mt6880-m4u";
		reg = <0x00 0x14011000 0x00 0x1000>;
		mediatek,larbs = <0x7b>;
		interrupts = <0x00 0x12c 0x04>;
		#iommu-cells = <0x01>;
		phandle = <0x7c>;
	};

	amms_control {
		compatible = "mediatek,amms";
		interrupts = <0x00 0x1a9 0x01>;
	};

	mtk_iommu_debug {
		compatible = "mediatek,mt6880-iommu-debug";
	};

	reserved@14018000 {
		compatible = "mediatek,reserved";
		reg = <0x00 0x14018000 0x00 0x1000>;
	};

	reserved@14019000 {
		compatible = "mediatek,reserved";
		reg = <0x00 0x14019000 0x00 0x1000>;
	};

	reserved@1401a000 {
		compatible = "mediatek,reserved";
		reg = <0x00 0x1401a000 0x00 0x1000>;
	};

	reserved@1401b000 {
		compatible = "mediatek,reserved";
		reg = <0x00 0x1401b000 0x00 0x1000>;
	};

	reserved@1401c000 {
		compatible = "mediatek,reserved";
		reg = <0x00 0x1401c000 0x00 0x1000>;
	};

	reserved@1401d000 {
		compatible = "mediatek,reserved";
		reg = <0x00 0x1401d000 0x00 0x1000>;
	};

	reserved@1401e000 {
		compatible = "mediatek,reserved";
		reg = <0x00 0x1401e000 0x00 0x1000>;
	};

	reserved@1401f000 {
		compatible = "mediatek,reserved";
		reg = <0x00 0x1401f000 0x00 0x1000>;
	};

	reserved@14020000 {
		compatible = "mediatek,reserved";
		reg = <0x00 0x14020000 0x00 0x1000>;
	};

	reserved@14021000 {
		compatible = "mediatek,reserved";
		reg = <0x00 0x14021000 0x00 0x1000>;
	};

	reserved@14022000 {
		compatible = "mediatek,reserved";
		reg = <0x00 0x14022000 0x00 0x1000>;
	};

	reserved@14023000 {
		compatible = "mediatek,reserved";
		reg = <0x00 0x14023000 0x00 0x1000>;
	};

	reserved@14024000 {
		compatible = "mediatek,reserved";
		reg = <0x00 0x14024000 0x00 0x1000>;
	};

	reserved@14025000 {
		compatible = "mediatek,reserved";
		reg = <0x00 0x14025000 0x00 0x1000>;
	};

	reserved@14026000 {
		compatible = "mediatek,reserved";
		reg = <0x00 0x14026000 0x00 0xda000>;
	};

	medmcu@15f00000 {
		compatible = "mediatek,medmcu";
		status = "okay";
		reg = <0x00 0x15d00000 0x00 0x20000 0x00 0x15f24000 0x00 0x1000 0x00 0x15f21000 0x00 0x1000 0x00 0x15f30000 0x00 0x1000 0x00 0x15f40000 0x00 0x1000 0x00 0x15f52000 0x00 0x1000 0x00 0x15f60000 0x00 0x40000 0x00 0x15fa5000 0x00 0x04 0x00 0x15ffb000 0x00 0x100 0x00 0x15ffb100 0x00 0x04 0x00 0x15ffb10c 0x00 0x04 0x00 0x15fa5020 0x00 0x04 0x00 0x15ffc000 0x00 0x100 0x00 0x15ffc100 0x00 0x04 0x00 0x15ffc10c 0x00 0x04 0x00 0x15fa5024 0x00 0x04 0x00 0x15ffd000 0x00 0x100 0x00 0x15ffd100 0x00 0x04 0x00 0x15ffd10c 0x00 0x04 0x00 0x15fa5028 0x00 0x04 0x00 0x15ffe000 0x00 0x100 0x00 0x15ffe100 0x00 0x04 0x00 0x15ffe10c 0x00 0x04 0x00 0x15fa502c 0x00 0x04 0x00 0x15fff000 0x00 0x100 0x00 0x15fff100 0x00 0x04 0x00 0x15fff10c 0x00 0x04 0x00 0x15fa5030 0x00 0x04>;
		reg-names = "scp_sram_base", "scp_cfgreg", "scp_clkreg", "scp_cfgreg_core0", "scp_cfgreg_core1", "scp_bus_tracker", "scp_l1creg", "scp_cfgreg_sec", "mbox0_base", "mbox0_set", "mbox0_clr", "mbox0_init", "mbox1_base", "mbox1_set", "mbox1_clr", "mbox1_init", "mbox2_base", "mbox2_set", "mbox2_clr", "mbox2_init", "mbox3_base", "mbox3_set", "mbox3_clr", "mbox3_init", "mbox4_base", "mbox4_set", "mbox4_clr", "mbox4_init";
		interrupts = <0x00 0x1a4 0x04 0x00 0x1a5 0x04 0x00 0x1a6 0x04 0x00 0x1a7 0x04 0x00 0x1a8 0x04>;
		interrupt-names = "mbox0", "mbox1", "mbox2", "mbox3", "mbox4";
		core_0 = "enable";
		scp_sramSize = <0x20000>;
		mbox_count = <0x05>;
		send_table = <0x00 0x00 0x07 0x03 0x01 0x02 0x04 0x01 0x01 0x05 0x01 0x01 0x06 0x01 0x01 0x0b 0x02 0x12 0x0d 0x02 0x01 0x0f 0x03 0x02 0x10 0x03 0x01 0x11 0x03 0x01 0x12 0x03 0x01 0x13 0x03 0x01 0x14 0x03 0x01 0x15 0x03 0x02 0x16 0x03 0x02 0x17 0x03 0x02 0x1e 0x04 0x22>;
		recv_table = <0x01 0x00 0x02 0x00 0x02 0x00 0x14 0x00 0x07 0x01 0x02 0x00 0x08 0x01 0x0a 0x00 0x09 0x01 0x01 0x00 0x0a 0x01 0x02 0x00 0x05 0x01 0x01 0x01 0x0c 0x02 0x02 0x00 0x0e 0x02 0x02 0x00 0x18 0x03 0x02 0x00 0x19 0x03 0x0a 0x00 0x1a 0x03 0x01 0x00 0x1b 0x03 0x05 0x00 0x1c 0x03 0x01 0x00 0x1d 0x03 0x02 0x00 0x11 0x03 0x01 0x01 0x1f 0x04 0x1e 0x00>;
	};

	consys@18000000 {
		compatible = "mediatek,mt6880-consys";
		#thermal-sensor-cells = <0x00>;
		reg = <0x00 0x18000000 0x00 0x1000 0x00 0x18001000 0x00 0x1000 0x00 0x18060000 0x00 0x10000 0x00 0x10001000 0x00 0x1000 0x00 0x10007000 0x00 0x1000 0x00 0x10006000 0x00 0x1000 0x00 0x1020e000 0x00 0x1000 0x00 0x18005000 0x00 0x1000 0x00 0x18003000 0x00 0x1000 0x00 0x10005000 0x00 0x1000 0x00 0x18004000 0x00 0x1000 0x00 0x18070000 0x00 0x10000 0x00 0x18002000 0x00 0x1000 0x00 0x11d10000 0x00 0x1000 0x00 0x1800f000 0x00 0x1000 0x00 0x18009000 0x00 0x1000 0x00 0x1800e000 0x00 0x400 0x00 0x1802f000 0x00 0x430>;
		power-domains = <0x4b 0x09>;
		phandle = <0x2e>;
	};

	gps@18C00000 {
		compatible = "mediatek,connac2-gps";
		reg = <0x00 0x18000000 0x00 0x100000 0x00 0x18c00000 0x00 0x100000 0x00 0x10003304 0x00 0x04 0x00 0x1001c000 0x00 0x04 0x00 0x1001c030 0x00 0x04>;
		reg-names = "conn_infra_base", "conn_gps_base", "status_dummy_cr", "tia2_gps_on", "tia2_gps_rc_sel";
		interrupts = <0x00 0x179 0x04 0x00 0x17a 0x04 0x00 0x17b 0x04 0x00 0x17c 0x04 0x00 0x17d 0x04 0x00 0x17e 0x04 0x00 0x17f 0x04>;
		memory-region = <0x80>;
		pmic = <0x81>;
		mtk-vcore-supply = <0x3c>;
		pinctrl-names = "default", "gps_l1_lna_disable", "gps_l1_lna_dsp_ctrl", "gps_l1_lna_enable", "gps_l5_lna_disable", "gps_l5_lna_dsp_ctrl", "gps_l5_lna_enable";
		pinctrl-0 = <0x82>;
		pinctrl-1 = <0x83>;
		pinctrl-2 = <0x84>;
		pinctrl-3 = <0x85>;
		pinctrl-4 = <0x86>;
		pinctrl-5 = <0x87>;
		pinctrl-6 = <0x88>;
		status = "okay";
	};

	odm {
		compatible = "simple-bus";
	};

	pmic_clock_buffer_ctrl {
		compatible = "mediatek,pmic_clock_buffer";
		mediatek,clkbuf-quantity = <0x07>;
		mediatek,clkbuf-config = <0x02 0x01 0x01 0x02 0x00 0x00 0x01>;
		mediatek,clkbuf-output-impedance = <0x03 0x04 0x03 0x04 0x00 0x00 0x03>;
		mediatek,clkbuf-controls-for-desense = <0x00 0x04 0x00 0x03 0x00 0x00 0x00>;
		mediatek,bblpm-support = "enable";
		pwrap-dcxo-en = <0x24 0x04 0x28 0x01 0x28 0x00>;
		pwrap-dcxo-conn = <0x5c 0x00 0x5c 0x10 0x60 0x00 0x60 0x10>;
		pwrap-dcxo-nfc = <0x64 0x00 0x64 0x10 0x68 0x00 0x68 0x10>;
		spm-pwr-status = <0x16c 0x00 0x16c 0x01>;
		spm-io-en = <0x2c 0x07>;
		spm-power-on-val = <0x08 0x15 0x08 0x0e>;
		spm-sck-con = <0x0c 0x18>;
		pcm-reg7-rf = <0x10c 0x15>;
		pwrap = <0x89>;
		sleep = <0x8a>;
		status = "okay";
	};

	mt6880-afe-pcm@11210000 {
		compatible = "mediatek,mt6880-sound";
		reg = <0x00 0x11210000 0x00 0x1000>;
		interrupts = <0x00 0xca 0x04>;
		i2s3-share = "I2S0";
		topckgen = <0x0f>;
		power-domains = <0x4b 0x06>;
		clocks = <0x8b 0x00 0x8b 0x07 0x8b 0x08 0x8b 0x06 0x8b 0x01 0x8b 0x02 0x8b 0x04 0x8b 0x03 0x8b 0x05 0x8b 0x09 0x0e 0x2e 0x0e 0x35 0x0f 0xae 0x0f 0xaf 0x0f 0x40 0x0f 0xb2 0x0f 0x34 0x0f 0xb3 0x0f 0x38 0x0f 0xb0 0x0f 0x37 0x0f 0xb1 0x0f 0x3b 0x0f 0xd9 0x0f 0xda 0x0f 0xdb 0x0f 0xdc 0x0f 0xdd 0x0f 0xde 0x0f 0xdf 0x0f 0xe0 0x0f 0xe1 0x0f 0xe2 0x0f 0xe3 0x0f 0xe4 0x0f 0xe5 0x0f 0xe6 0x0f 0xe7 0x0f 0x54>;
		clock-names = "aud_afe_clk", "aud_dac_clk", "aud_dac_predis_clk", "aud_adc_clk", "aud_apll22m_clk", "aud_apll24m_clk", "aud_apll1_tuner_clk", "aud_apll2_tuner_clk", "aud_tdm_clk", "aud_tml_clk", "aud_infra_clk", "mtkaif_26m_clk", "top_mux_audio", "top_mux_audio_int", "top_mainpll_d2_d4", "top_mux_aud_1", "top_apll1_ck", "top_mux_aud_2", "top_apll2_ck", "top_mux_aud_eng1", "top_apll1_d8", "top_mux_aud_eng2", "top_apll2_d8", "top_i2s0_m_sel", "top_i2s1_m_sel", "top_i2s2_m_sel", "top_i2s4_m_sel", "top_tdm_m_sel", "top_i2s5_m_sel", "top_i2s6_m_sel", "top_apll12_div0", "top_apll12_div1", "top_apll12_div2", "top_apll12_div4", "top_apll12_divm", "top_apll12_divb", "top_apll12_div5", "top_apll12_div6", "top_clk26m_clk";
		pinctrl-names = "aud_dat_miso_off", "aud_dat_miso_on", "aud_dat_mosi_off", "aud_dat_mosi_on", "aud_gpio_i2s0_off", "aud_gpio_i2s0_on", "aud_gpio_i2s1_off", "aud_gpio_i2s1_on", "aud_gpio_i2s2_off", "aud_gpio_i2s2_on", "aud_gpio_i2s3_off", "aud_gpio_i2s3_on", "aud_gpio_i2s4_off", "aud_gpio_i2s4_on", "aud_gpio_i2s5_off", "aud_gpio_i2s5_on", "aud_gpio_i2s6_off", "aud_gpio_i2s6_on", "vow_dat_miso_off", "vow_dat_miso_on", "vow_clk_miso_off", "vow_clk_miso_on", "aud_gpio_proslic_off", "aud_gpio_proslic_on", "aud_gpio_tdm_off", "aud_gpio_tdm_on";
		pinctrl-0 = <0x8c>;
		pinctrl-1 = <0x8d>;
		pinctrl-2 = <0x8e>;
		pinctrl-3 = <0x8f>;
		pinctrl-4 = <0x90>;
		pinctrl-5 = <0x91>;
		pinctrl-6 = <0x92>;
		pinctrl-7 = <0x93>;
		pinctrl-8 = <0x94>;
		pinctrl-9 = <0x95>;
		pinctrl-10 = <0x96>;
		pinctrl-11 = <0x97>;
		pinctrl-12 = <0x98>;
		pinctrl-13 = <0x99>;
		pinctrl-14 = <0x9a>;
		pinctrl-15 = <0x9b>;
		pinctrl-16 = <0x9c>;
		pinctrl-17 = <0x9d>;
		pinctrl-18 = <0x9e>;
		pinctrl-19 = <0x9f>;
		pinctrl-20 = <0xa0>;
		pinctrl-21 = <0xa1>;
		pinctrl-22 = <0xa2>;
		pinctrl-23 = <0xa3>;
		pinctrl-24 = <0xa4>;
		pinctrl-25 = <0xa5>;
		status = "okay";
		phandle = <0xa6>;
	};

	sound {
		compatible = "mediatek,mt6880-mt6359-sound";
		mediatek,platform = <0xa6>;

		mediatek,ext-codec {
			sound-dai = <0xa7>;
		};
	};

	audio_sram@11211000 {
		compatible = "mediatek,audio_sram";
		reg = <0x00 0x11211000 0x00 0x10000>;
		prefer_mode = <0x01>;
		mode_size = <0xc000 0x10000>;
		block_size = <0x1000>;
	};

	smart_pa {
	};

	slic_irq_ext_eint_pin {
		compatible = "fg360,slic_irq";
		interrupt-parent = <0x2f>;
		interrupts = <0x18 0x03>;
		gpio_id = <0x2f 0x18 0x00>;
		status = "okay";
	};

	rt1711_type_c_port0 {
		tcpc-dual,supported_modes = <0x00>;
		rt-tcpc,name = "type_c_port0";
		rt-tcpc,role_def = <0x04>;
		rt-tcpc,rp_level = <0x00>;
		rt-tcpc,vconn_supply = <0x01>;
		rt-tcpc,notifier_supply_num = <0x02>;
		rt1711pd,intr_gpio = <0x2f 0x28 0x00>;
		rt1711pd,intr_gpio_num = <0x28>;

		pd-data {
			pd,vid = <0x29cf>;
			pd,pid = <0x1711>;
			pd,source-cap-ext = <0x171129cf 0x00 0x00 0x00 0x00 0x2000000>;
			pd,mfrs = "RichtekTCPC";
			pd,charging_policy = <0x31>;
			pd,source-pdo-size = <0x01>;
			pd,source-pdo-data = <0x19032>;
			pd,sink-pdo-size = <0x01>;
			pd,sink-pdo-data = <0x190c8>;
			pd,id-vdo-size = <0x03>;
			pd,id-vdo-data = <0xd10029cf 0x00 0x17110000>;
			bat,nr = <0x01>;
			pd,country_nr = <0x00>;

			bat-info0 {
				bat,vid = <0x29cf>;
				bat,pid = <0x1711>;
				bat,mfrs = "bat1";
				bat,design_cap = <0xbb8>;
			};
		};

		dpm_caps {
			local_dr_power;
			local_dr_data;
			local_usb_comm;
			local_no_suspend;
			local_vconn_supply;
			attemp_enter_dp_mode;
			attemp_discover_cable;
			attemp_discover_id;
			pr_check = <0x00>;
			dr_check = <0x00>;
		};

		displayport {
			1st_connection = "dfp_d";
			2nd_connection = "dfp_d";
			signal,dp_v13;
			usbr20_not_used;
			typec,receptacle;

			ufp_d {
			};

			dfp_d {
				pin_assignment,mode_c;
				pin_assignment,mode_d;
				pin_assignment,mode_e;
				pin_assignment,mode_f;
			};
		};

		port {

			endpoint@0 {
				remote-endpoint = <0xa8>;
				phandle = <0xad>;
			};
		};
	};

	ptn5150a_type_c_port0 {
		tcpc-dual,supported_modes = <0x00>;
		rt-tcpc,name = "type_c_port0";
		rt-tcpc,role_def = <0x04>;
		rt-tcpc,rp_level = <0x00>;
		rt-tcpc,vconn_supply = <0x01>;
		rt-tcpc,notifier_supply_num = <0x02>;
		ptn5150a,intr_gpio = <0x2f 0x15 0x00>;
		ptn5150a,pwr_gpio = <0x2f 0x29 0x00>;
	};

	memory@40000000 {
		device_type = "memory";
		reg = <0x00 0x40000000 0x00 0x1e800000>;
	};

	gsw@0 {
		compatible = "mediatek,mt753x";
		mediatek,ethsys = <0x5b>;
		#address-cells = <0x01>;
		#size-cells = <0x00>;
		mediatek,mdio = <0xa9>;
		mediatek,portmap = "llllw";
		mediatek,mdio_master_pinmux = <0x00>;
		reset-gpios = <0x2f 0x42 0x00>;
		interrupt-parent = <0x2f>;
		interrupts = <0x41 0x04>;
		status = "okay";

		port@5 {
			compatible = "mediatek,mt753x-port";
			reg = <0x05>;
			phy-mode = "sgmii";

			fixed-link {
				speed = <0x9c4>;
				full-duplex;
			};
		};
	};

	subpmic_pmu_eint {
		interrupt-parent = <0x2f>;
		interrupts = <0x14 0x02>;
		status = "okay";
	};

	tcpc_pd_eint {
		interrupt-parent = <0x2f>;
		interrupts = <0x28 0x02>;
		status = "okay";
	};

	extcon_usb {
		compatible = "mediatek,extcon-usb";
		vbus-supply = <0xaa>;
		vbus-volt = <0x4c4b40>;
		charger = <0xab>;
		vbus-current = <0x1b7740>;

		port {

			endpoint@0 {
				remote-endpoint = <0xac>;
				phandle = <0x56>;
			};
		};
	};

	typec_mux_switch {
		compatible = "mediatek,typec_mux_switch";
		status = "okay";
		orientation-switch;

		port {

			endpoint@0 {
				remote-endpoint = <0xad>;
				phandle = <0xa8>;
			};
		};
	};

	fusb304 {
		compatible = "mediatek,fusb304";
		pinctrl-names = "sel_up", "sel_down", "enable", "disable";
		pinctrl-0 = <0xae>;
		pinctrl-1 = <0xaf>;
		pinctrl-2 = <0xb0>;
		pinctrl-3 = <0xb1>;
		status = "okay";
	};

	ptn36241g {
		compatible = "mediatek,ptn36241g";
		pinctrl-names = "c1_active", "c1_sleep", "c2_active", "c2_sleep";
		pinctrl-0 = <0xb2>;
		pinctrl-1 = <0xb3>;
		pinctrl-2 = <0xb4>;
		pinctrl-3 = <0xb5>;
		status = "okay";
	};

	tz_gpio_leds {
		compatible = "tozed,tz_gpio_leds";
		gpios = <0x2f 0x06 0x00 0x2f 0x05 0x00 0x2f 0x08 0x00 0x2f 0xd3 0x00 0x2f 0xd5 0x00 0x2f 0xaf 0x00 0x2f 0xd2 0x00>;
		leds-type = <0x20 0x40 0x30 0x70 0x0b 0x0c 0x06>;
		leds-status = <0x00 0x00 0x00 0x01 0x00 0x00 0x00>;
		pinctrl-names = "tz_leds_pin";
		pinctrl-0 = <0xb6>;
		status = "okay";
	};

	tz_gpio_keys {
		compatible = "tozed,tz_gpio_keys";
		gpios = <0x2f 0x07 0x01 0x2f 0x14 0x01>;
		keys-type = <0x01 0x02>;
		pinctrl-names = "tz_keys_pin";
		pinctrl-0 = <0xb7>;
		status = "okay";
	};
};
